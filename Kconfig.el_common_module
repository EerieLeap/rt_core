## src/domain/logging_domain/Kconfig.logging_domain
```kconfig
config EERIE_LEAP_DOMAIN_LOGGING
    depends on EERIE_LEAP_CONFIGURATION
    select EERIE_LEAP_EVENT_BUS
    select EERIE_LEAP_MDF
    bool "EerieLeap Logging Domain"
    help
      Add EerieLeap Logging Domain. The log writer publishes its status on
      the logging_events channel, hence the event bus, and writes MDF 4.

menu "EerieLeap Logging Domain config"
    depends on EERIE_LEAP_DOMAIN_LOGGING

    config EERIE_LEAP_LOG_DATA_FILES_DIR
        string "Log data files directory"
        default "data_logs"

    config EERIE_LEAP_LOG_DATA_FILE_PREFIX
        string "Log data files prefix"
        default "log_data"

    config EERIE_LEAP_LOG_WRITER_STACK_SIZE
        int "Log writer stack size"
        default 8192

    config EERIE_LEAP_LOG_SYNC_INTERVAL_MS
        int "Log file sync interval"
        range 0 3600000
        default 1000
        help
          How often the log writer flushes its stream buffer and syncs the log
          file, in milliseconds, checked at the end of each logging tick. A
          sync puts the file size and the allocation on the card, so a power
          loss costs at most this interval plus one stream buffer
          (EERIE_LEAP_FS_STREAM_WRITE_BUFFER_SIZE) of records. Each sync is a
          few sector writes; 0 syncs only when logging stops.

    config EERIE_LEAP_LOG_MIN_FREE_SPACE_MB
        int "Minimum free space to start or rotate a log file"
        range 0 1048576
        default 16
        help
          Free space, in MiB, the log volume must have when logging starts
          and before each rotation to the next file. A start without it
          fails; a rotation without it ends the session with the reason
          NoSpace. Checked through the file system's free cluster count,
          which FatFs computes by scanning the FAT on a large card, so it is
          never checked per tick. 0 disables the check.

    config EERIE_LEAP_DOMAIN_LOGGING_STATS
        bool "Log writer statistics log"
        help
          Logs one line per EERIE_LEAP_LOG_STATS_LOG_PERIOD_S with the log
          writer's counters: ticks, readings, frames, dropped frames, bytes,
          stream writes, syncs, rotations, overruns, write errors and tick
          duration. The counters themselves are always kept and readable
          through LogWriterService::GetStats().

    config EERIE_LEAP_LOG_STATS_LOG_PERIOD_S
        int "Log writer statistics log period"
        range 1 3600
        default 10
        help
          Period of the statistics log line, and the shortest interval
          between two warnings about raw CAN frames dropped before the log
          writer could drain them; the warning is logged whether or not the
          statistics log is on.
endmenu
```

## src/domain/sensor_domain/Kconfig.sensor_domain
```kconfig
config EERIE_LEAP_DOMAIN_SENSOR
    depends on EERIE_LEAP_CONFIGURATION && EERIE_LEAP_ADC
    bool "EerieLeap Sensor Domain"
    # The pipeline builder registers the Lua sensor functions of the script domain.
    select EERIE_LEAP_DOMAIN_SCRIPT
    # Analog readers take their calibration from the ADC domain's configuration.
    select EERIE_LEAP_DOMAIN_ADC
    help
      Add EerieLeap Sensor Domain.

menu "EerieLeap Sensor Domain config"
    depends on EERIE_LEAP_DOMAIN_SENSOR

    config EERIE_LEAP_DOMAIN_SENSOR_PROCESSING_SERVICE_STACK_SIZE
        int "Sensor processing service stack size"
        default 8192

    config EERIE_LEAP_DOMAIN_SENSOR_PROCESSING_SERVICE_PRIORITY
        int "Sensor processing service priority"
        default 6

    config EERIE_LEAP_DOMAIN_SENSOR_PROCESSING_STATS
        bool "Log rate group statistics"
        help
          Logs one line per rate group every
          EERIE_LEAP_DOMAIN_SENSOR_PROCESSING_STATS_LOG_PERIOD_S seconds: ticks,
          overruns, the last and longest tick, and the delivered period between
          tick starts (average, minimum and maximum since the previous line,
          from the cycle counter), followed by the latest result of each ADC
          channel the group samples, named by its global channel index
          ("ch0 0.898 V ch1 0.000 V"). The tick and overrun counters are kept
          either way and read through GetRateGroupStats(); this adds the period
          measurement and the log. The log runs on the processing thread after
          the due groups, so its own time shows in the next line's period
          maximum. A measurement aid for the sampling path; off in production
          builds.

    config EERIE_LEAP_DOMAIN_SENSOR_PROCESSING_STATS_LOG_PERIOD_S
        int "Seconds between rate group statistics log lines"
        depends on EERIE_LEAP_DOMAIN_SENSOR_PROCESSING_STATS
        range 1 3600
        default 10

    config EERIE_LEAP_DOMAIN_SENSOR_EVENTS_PUBLISHER_PERIOD_MS
        int "Sensor events publisher period in ms"
        depends on EERIE_LEAP_EVENT_BUS
        range 1 10000
        default 30
        help
          Delay between two ticks of SensorEventsPublisher. A tick publishes
          the readings processed since the previous one on sensor_events; a
          sensor committed several times within one period is published once,
          with its latest value, so a pulse shorter than the period can be
          missed.

    config EERIE_LEAP_DOMAIN_SENSOR_EVENTS_PUBLISHER_STACK_SIZE
        int "Sensor events publisher stack size"
        depends on EERIE_LEAP_EVENT_BUS
        default 4096
        help
          Stack of the publisher's work queue. A tick also runs the filters of
          the sensor_events subscribers (Accepts()), once per sensor and
          subscription change. A filter that throws is caught there, but
          unwinding needs more stack than a tick: 4096 overflowed on
          qemu_cortex_a53.

    config EERIE_LEAP_DOMAIN_SENSOR_EVENTS_PUBLISHER_PRIORITY
        int "Sensor events publisher priority"
        depends on EERIE_LEAP_EVENT_BUS
        default 6

    config EERIE_LEAP_DOMAIN_SENSOR_MAX_COUNT
        int "Maximum number of configured sensors"
        range 1 65535
        default 64
        help
          A sensors configuration with more sensors is rejected at validation.
          Every sensor holds its readings and runtime objects in internal RAM,
          so size this for the unit's memory rather than for the configuration.

    config EERIE_LEAP_DOMAIN_SENSOR_RAW_CAN_QUEUE_SIZE
        int "Raw CAN frames queued for the log writer"
        range 1 1024
        default 32
        help
          Frames of CANBUS_RAW sensors are queued for the log writer so every
          frame is logged, not only the latest one at each logging tick. Frames
          arriving while the queue is full are dropped and counted. Each entry
          takes about 90 bytes of internal RAM; the queue only exists while an
          enabled CANBUS_RAW sensor is configured.
endmenu
```

## src/domain/system_domain/Kconfig.system_domain
```kconfig
config EERIE_LEAP_DOMAIN_SYSTEM
    depends on EERIE_LEAP_CONFIGURATION
    bool "EerieLeap System Domain"
    help
      Add EerieLeap System Domain.

menu "EerieLeap System Domain config"
    depends on EERIE_LEAP_DOMAIN_SYSTEM

    config EERIE_LEAP_PRODUCT_ID
        int "Product ID (16-bit)"
        range 0 65535
        default 0

    config EERIE_LEAP_REVISION
        int "Revision (8-bit)"
        range 0 255
        default 0

    config EERIE_LEAP_HW_VERSION_MAJOR
        int "Hardware version major (8-bit)"
        range 0 255
        default 0

    config EERIE_LEAP_HW_VERSION_MINOR
        int "Hardware version minor (8-bit)"
        range 0 255
        default 0

    config EERIE_LEAP_HW_VERSION_PATCH
        int "Hardware version patch (16-bit)"
        range 0 65535
        default 0

    config EERIE_LEAP_SW_VERSION_MAJOR
        int "Software version major (8-bit)"
        range 0 255
        default 0

    config EERIE_LEAP_SW_VERSION_MINOR
        int "Software version minor (8-bit)"
        range 0 255
        default 0

    config EERIE_LEAP_SW_VERSION_PATCH
        int "Software version patch (16-bit)"
        range 0 65535
        default 0

endmenu

menu "EerieLeap unit features"

    # The 16-bit ProductFeature mask a unit reports (SMP device group, BLE advertisement, CDMP).
    # Each follows the domains the build contains; a board can turn one off. DISPLAY, and STORAGE on a
    # unit that does not log, are set by hand.
    config EERIE_LEAP_FEATURES_ANALOG_INPUTS
        bool "Analog inputs feature"
        default y if EERIE_LEAP_CONTROLLER_ADC
    config EERIE_LEAP_FEATURES_DIGITAL_INPUTS
        bool "Digital inputs feature"
        default y if EERIE_LEAP_DOMAIN_SENSOR && EERIE_LEAP_GPIO
    config EERIE_LEAP_FEATURES_CANBUS
        bool "CANBus feature"
        default y if EERIE_LEAP_DOMAIN_CANBUS
    config EERIE_LEAP_FEATURES_LOGGING
        bool "Logging feature"
        default y if EERIE_LEAP_DOMAIN_LOGGING
        help
          A unit that can write logs. On CDMP the bit is sent only while a log writer is available.
    config EERIE_LEAP_FEATURES_BLUETOOTH
        bool "Bluetooth feature"
        default y if EERIE_LEAP_DOMAIN_BLE
    config EERIE_LEAP_FEATURES_DISPLAY
        bool "Display feature"
        default n
    config EERIE_LEAP_FEATURES_STORAGE
        bool "Storage feature"
        default y if EERIE_LEAP_DOMAIN_LOGGING
        help
          A unit with an SD service: it runs the Lua scripts a script_path names and its SMP files
          group lists the card. Not whether a card is mounted, which the files group reports. A unit
          that logs writes to the card, so it has one; another unit with an SD service sets it by hand.

endmenu
```

## src/subsys/adc/Kconfig.adc
```kconfig
config EERIE_LEAP_ADC
    bool "EerieLeap ADC"
    help
      Add EerieLeap ADC.

menu "EerieLeap ADC config"
    depends on EERIE_LEAP_ADC

    config EERIE_LEAP_ADC_SAMPLES_MAX
        int "Maximum conversions averaged per channel"
        range 1 65535
        default 4096
        help
          Upper bound for the samples of a sample request; a request asking
          for more is clamped. Every conversion blocks the sampling thread,
          so size this for the slowest driver on the unit rather than for
          the configuration.

    config EERIE_LEAP_ADC_BURST_CHUNK
        int "Samplings per driver call"
        range 1 1024
        default 64
        help
          How many samplings one adc_read() performs on a driver that
          accepts extra_samplings. Each ADC keeps a buffer of this many
          samples per channel in internal RAM; a request for more samples
          is served in several calls.

    config EERIE_LEAP_ADC_RANDOMIZER
        bool "Random ADC channels (bench and development aid)"
        help
          Adds an ADC whose channels are random but plausible voltages, after
          the device tree ADCs (hardware channels keep their numbers), so a
          PHYSICAL_ANALOG sensor can be connected to one by its channel
          number like to a real input. Each channel eases to a random target
          between 0 V and the ADC pin voltage that maps to the full sensor
          input, holds for a while and moves on. Without any device tree ADC
          it replaces the white-noise simulator. A bench and development
          aid: leave it off in a shipped build.

    config EERIE_LEAP_ADC_RANDOMIZER_CHANNELS
        int "Random ADC channels"
        depends on EERIE_LEAP_ADC_RANDOMIZER
        range 1 16
        default 4
        help
          Number of random channels; they are numbered after the hardware
          channels.

    config EERIE_LEAP_ADC_RANDOMIZER_MOVE_MIN_MS
        int "Shortest move to a new voltage (ms)"
        depends on EERIE_LEAP_ADC_RANDOMIZER
        range 1 600000
        default 200
        help
          A channel takes a random time between this and the longest move to
          ease to its next voltage.

    config EERIE_LEAP_ADC_RANDOMIZER_MOVE_MAX_MS
        int "Longest move to a new voltage (ms)"
        depends on EERIE_LEAP_ADC_RANDOMIZER
        range 1 600000
        default 4000
        help
          Upper bound of the move time; a value below the shortest move is
          treated as equal to it.

    config EERIE_LEAP_ADC_RANDOMIZER_HOLD_MAX_MS
        int "Longest hold at a voltage (ms)"
        depends on EERIE_LEAP_ADC_RANDOMIZER
        range 0 600000
        default 2000
        help
          After a move a channel holds its voltage for a random time between
          0 and this before it picks the next target.
endmenu
```

## src/subsys/assets/Kconfig.assets
```kconfig
config EERIE_LEAP_ASSETS
    bool "EerieLeap Assets"
    select EERIE_LEAP_FS
    help
      Add EerieLeap Assets.

menu "EerieLeap Assets config"
    depends on EERIE_LEAP_ASSETS

    config EERIE_LEAP_ASSETS_MAX_NAME_LENGTH
        int "Longest asset name"
        range 8 128
        default 64
        help
          Longest asset name, in bytes.
endmenu
```

## src/subsys/canbus/Kconfig.canbus
```kconfig
config EERIE_LEAP_CANBUS
    bool "EerieLeap CANBus"
    depends on CAN
    help
      Add EerieLeap CANBus.

menu "EerieLeap CANBus config"
    depends on EERIE_LEAP_CANBUS

    config EERIE_LEAP_CANBUS_AUTO_DETECT_INTERVAL_MS
        int "Canbus auto detect activity check interval ms"
        default 5000

    config EERIE_LEAP_CANBUS_RX_QUEUE_SIZE
        int "Canbus receive queue depth in frames"
        default 32
        range 1 1024
        help
          Number of received frames buffered between the RX callback and the
          bottom half thread. Frames arriving on a full queue are dropped and
          counted by Canbus::GetRxDroppedCount().

    config EERIE_LEAP_CAN_MONITOR_TX_SLOTS
        int "Frames in flight the CAN monitor's echo can follow"
        default 16
        range 1 64
        help
          Frames in flight the CAN monitor's echo can follow. While a tap is set, each
          frame the unit sends takes a slot from a pool of this size until the controller
          completes it, so the tap sees it as a transmitted frame. A frame sent with no
          free slot goes out as usual but has no echo, and is counted by
          Canbus::GetTxEchoLostCount(). The pool is allocated at the first
          Canbus::SetTap(), and costs about 80 bytes a slot.

    module = EERIE_LEAP_CANBUS
    module-str = eerie_leap_canbus
    source "subsys/logging/Kconfig.template.log_config"
endmenu
```
