## Kconfig.el_common_module
```kconfig
menu "EerieLeap Common"

config EERIE_LEAP_COMMON
    bool "EerieLeap Common Module"
    help
      Add EerieLeap common code.

config EERIE_LEAP_CFB
    bool "EerieLeap CFB"
    help
      Add EerieLeap CFB.

config EERIE_LEAP_DBC
    bool "EerieLeap DBC"
    help
      Add EerieLeap DBC.

config EERIE_LEAP_GPIO
    bool "EerieLeap GPIO"
    help
      Add EerieLeap GPIO.

config EERIE_LEAP_LUA_SCRIPT
    bool "EerieLeap Lua Script"
    select LUA
    help
      Add EerieLeap Lua Script.

config EERIE_LEAP_MATH_PARSER
    bool "EerieLeap Math Parser"
    help
      Add EerieLeap Math Parser.

config EERIE_LEAP_MDF
    bool "EerieLeap MDF"
    help
      Add EerieLeap MDF.

config EERIE_LEAP_RANDOM
    bool "EerieLeap Random"
    help
      Add EerieLeap Random.

config EERIE_LEAP_THREADING
    bool "EerieLeap Threading"
    help
      Add EerieLeap Threading.

config EERIE_LEAP_TIME
    bool "EerieLeap Time"
    help
      Add EerieLeap Time.

config EERIE_LEAP_DOMAIN_CANBUS
    depends on EERIE_LEAP_CONFIGURATION
    bool "EerieLeap CANBus Domain"
    help
      Add EerieLeap CANBus Domain.

config EERIE_LEAP_DOMAIN_SCRIPT
    bool "EerieLeap Script Domain"
    help
      Add EerieLeap Script Domain.

config EERIE_LEAP_DOMAIN_SYSTEM
    depends on EERIE_LEAP_CONFIGURATION
    bool "EerieLeap System Domain"
    help
      Add EerieLeap System Domain.

module = EERIE_LEAP_COMMON
module-str = eerie_leap_common

source "subsys/logging/Kconfig.template.log_config"

rsource "src/configuration/Kconfig.configuration"
rsource "src/subsys/adc/Kconfig.adc"
rsource "src/subsys/canbus/Kconfig.canbus"
rsource "src/subsys/cdmp/Kconfig.cdmp"
rsource "src/subsys/fs/Kconfig.fs"
rsource "src/subsys/modbus/Kconfig.modbus"

rsource "src/domain/canbus_com_domain/Kconfig.canbus_com_domain"
rsource "src/domain/sensor_domain/Kconfig.sensor_domain"
endmenu
```

## Kconfig.rt_core_module
```kconfig
menu "EerieLeap Core Module"

config EERIE_LEAP_RT_CORE
    bool "EerieLeap Common Module"
    help
      Add EerieLeap common code.

config EERIE_LEAP_BLUETOOTH
    bool "EerieLeap Bluetooth"
    depends on BT
    select EERIE_LEAP_THREADING
    help
      Add EerieLeap Bluetooth.

config EERIE_LEAP_CFB
    bool "EerieLeap CFB"
    help
      Add EerieLeap CFB.

config EERIE_LEAP_EVENT_BUS
    bool "EerieLeap Event Bus"
    select EERIE_LEAP_THREADING
    help
      Add EerieLeap Event Bus.

config EERIE_LEAP_LUA_SCRIPT
    bool "EerieLeap Lua Script"
    select LUA
    help
      Add EerieLeap Lua Script.

config EERIE_LEAP_LUA_SCRIPT_MEMORY_LIMIT_KB
    int "Memory limit of one Lua state in KiB (0 = unlimited)"
    depends on EERIE_LEAP_LUA_SCRIPT
    default 256
    help
      Allocations of a Lua state created on the external heap are counted and
      refused past this limit, so a script that leaks or allocates without bound
      fails its own call instead of exhausting the heap for the rest of the unit.

config EERIE_LEAP_EXPRESSION_ENGINE
    bool "EerieLeap Expression Engine"
    select EXPRESSION_ENGINE
    help
      Add the sensor expression evaluator, built on the EerieLeap expression
      engine module (modules/expression_engine).

config EERIE_LEAP_MDF
    bool "EerieLeap MDF"
    help
      Add EerieLeap MDF.

config EERIE_LEAP_RANDOM
    bool "EerieLeap Random"
    help
      Add EerieLeap Random.

config EERIE_LEAP_THREADING
    bool "EerieLeap Threading"
    help
      Add EerieLeap Threading.

config EERIE_LEAP_TIME
    bool "EerieLeap Time"
    help
      Add EerieLeap Time.

config EERIE_LEAP_DOMAIN_BLE
    depends on EERIE_LEAP_BLUETOOTH && EERIE_LEAP_DOMAIN_SENSOR && EERIE_LEAP_DOMAIN_SYSTEM
    select EERIE_LEAP_SMP_BLE
    bool "EerieLeap BLE Domain"
    help
      Add EerieLeap BLE Domain.

config EERIE_LEAP_DOMAIN_CANBUS
    depends on EERIE_LEAP_CONFIGURATION && EERIE_LEAP_CANBUS
    bool "EerieLeap CANBus Domain"
    help
      Add EerieLeap CANBus Domain.

config EERIE_LEAP_DOMAIN_SCRIPT
    bool "EerieLeap Script Domain"
    help
      Add EerieLeap Script Domain.

module = EERIE_LEAP_RT_CORE
module-str = eerie_leap_rt_core

source "subsys/logging/Kconfig.template.log_config"

rsource "src/configuration/Kconfig.configuration"
rsource "src/subsys/adc/Kconfig.adc"
rsource "src/subsys/assets/Kconfig.assets"
rsource "src/subsys/canbus/Kconfig.canbus"
rsource "src/subsys/cdmp/Kconfig.cdmp"
rsource "src/subsys/device_tree/Kconfig.device_tree"
rsource "src/subsys/fs/Kconfig.fs"
rsource "src/subsys/gpio/Kconfig.gpio"
rsource "src/subsys/smp/Kconfig.smp"

rsource "src/domain/system_domain/Kconfig.system_domain"
rsource "src/domain/canbus_com_domain/Kconfig.canbus_com_domain"
rsource "src/domain/sensor_domain/Kconfig.sensor_domain"
rsource "src/domain/logging_domain/Kconfig.logging_domain"

rsource "src/controllers/Kconfig.controllers"
endmenu
```

## src/controllers/Kconfig.controllers
```kconfig
config EERIE_LEAP_CONTROLLER_SYSTEM
    bool "EerieLeap System Controller"
    depends on EERIE_LEAP_DOMAIN_SYSTEM && EERIE_LEAP_FS
    select EERIE_LEAP_THREADING
    help
      Add EerieLeap System Controller.

config EERIE_LEAP_CONTROLLER_MANAGEMENT
    bool "EerieLeap Management Controller"
    depends on EERIE_LEAP_SMP && EERIE_LEAP_DOMAIN_SYSTEM
    select EERIE_LEAP_THREADING
    help
      Add EerieLeap Management Controller, serving the config and device SMP groups.

config EERIE_LEAP_CONTROLLER_CANBUS
    bool "EerieLeap CANBus Controller"
    depends on EERIE_LEAP_DOMAIN_CANBUS && EERIE_LEAP_DOMAIN_CANBUS_COM
    depends on EERIE_LEAP_DEVICE_TREE && EERIE_LEAP_FS
    select EERIE_LEAP_THREADING
    help
      Add EerieLeap CANBus Controller.

config EERIE_LEAP_CONTROLLER_CANBUS_RECONFIGURE_DELAY_MS
    int "Delay before a new CAN bus configuration takes effect"
    depends on EERIE_LEAP_CONTROLLER_CANBUS
    default 250
    help
      Restarting the CAN bus services drops what the SMP CAN transport has
      yet to send, so the request that stored the configuration, which may
      have come over the CAN bus, is answered first. Each update restarts
      the delay.

config EERIE_LEAP_CONTROLLER_SENSORS
    bool "EerieLeap Sensors Controller"
    depends on EERIE_LEAP_DOMAIN_SENSOR && EERIE_LEAP_DOMAIN_CANBUS
    depends on EERIE_LEAP_GPIO && EERIE_LEAP_RANDOM && EERIE_LEAP_FS
    select EERIE_LEAP_THREADING
    help
      Add EerieLeap Sensors Controller.

config EERIE_LEAP_CONTROLLER_BLE
    bool "EerieLeap BLE Controller"
    depends on EERIE_LEAP_DOMAIN_BLE
    help
      Add EerieLeap BLE Controller.
```

## src/domain/adc_domain/Kconfig.adc_domain
```kconfig
config EERIE_LEAP_DOMAIN_ADC
    depends on EERIE_LEAP_ADC && EERIE_LEAP_CONFIGURATION
    bool "EerieLeap ADC Domain"
    help
      Add EerieLeap ADC Domain: the user's ADC configuration (samples and
      a calibration per channel), its validation and storage.

menu "EerieLeap ADC Domain config"
    depends on EERIE_LEAP_DOMAIN_ADC

    config EERIE_LEAP_ADC_VOLTAGE_MAX_MV
        int "ADC voltage max"
        range 1 100000
        default 3100
        help
          ADC pin voltage that corresponds to
          EERIE_LEAP_SENSOR_VOLTAGE_MAX_MV at the sensor input.

    config EERIE_LEAP_SENSOR_VOLTAGE_MAX_MV
        int "Sensor voltage max"
        range 1 100000
        default 5000

    config EERIE_LEAP_ADC_CALIBRATION_SAMPLES_COUNT
        int "ADC calibration samples count"
        range 1 65535
        default 2048
        help
          Conversions averaged per calibration reading; at most
          EERIE_LEAP_ADC_SAMPLES_MAX.

    config EERIE_LEAP_ADC_CALIBRATION_SAMPLING_RATE_MS
        int "ADC calibration sampling rate ms"
        default 100
endmenu
```

## src/domain/can_monitor_domain/Kconfig.can_monitor_domain
```kconfig
config EERIE_LEAP_DOMAIN_CAN_MONITOR
    bool "EerieLeap CAN monitor domain"
    depends on EERIE_LEAP_DOMAIN_CANBUS
    select EERIE_LEAP_THREADING
    # The canmon group's requests nest lists in lists in the request map (OPEN's and FILTER's
    # filters, SEND's frames, PERIODIC's list of maps): four levels of zcbor decoding state.
    select MCUMGR_SMP_CBOR_MIN_DECODING_LEVEL_4 if EERIE_LEAP_SMP
    help
      Sessions that stream the frames of a CAN port to a client: the
      records, the ring they wait in, the sender and, with EERIE_LEAP_SMP,
      the canmon SMP group (74). The domain does not depend on a transport:
      CanMonitorController gives it the BLE access point's `bus`
      characteristic.

menu "EerieLeap CAN monitor domain config"
    depends on EERIE_LEAP_DOMAIN_CAN_MONITOR

    config EERIE_LEAP_CAN_MONITOR_MAX_SESSIONS
        int "Sessions at once"
        range 1 8
        default 2
        help
          Sessions open at the same time, at most one a port.

    config EERIE_LEAP_CAN_MONITOR_LEASE_MS
        int "Session lease in milliseconds"
        range 100 600000
        default 5000
        help
          A session that no request carrying its token renews for this long
          ends.

    config EERIE_LEAP_CAN_MONITOR_RING_SIZE
        int "Bytes of each session's ring"
        range 1024 16777216
        default 262144
        help
          The records a session has not sent yet wait in a ring of this many
          bytes, allocated from the external memory resource (PSRAM where the
          board has it) when the session opens. A power of two.

    config EERIE_LEAP_CAN_MONITOR_FLUSH_MS
        int "Longest a record waits for its notification to fill, in ms"
        range 1 1000
        default 20

    config EERIE_LEAP_CAN_MONITOR_IN_FLIGHT
        int "Notifications awaiting completion"
        range 1 16
        default 4
        help
          The rest of the link's ATT buffers stay for SMP and the live values.

    config EERIE_LEAP_CAN_MONITOR_SENDER_PRIORITY
        int "Priority of the sender thread (preemptible)"
        range 0 127
        default 4
        help
          Below the cooperative CAN bus threads, and above a renderer the
          stream must not wait for.

    config EERIE_LEAP_CAN_MONITOR_SENDER_STACK_SIZE
        int "Stack size of the sender thread"
        default 2048

    config EERIE_LEAP_CAN_MONITOR_MAX_FILTERS
        int "Unit filters a session takes"
        range 1 64
        default 16

    config EERIE_LEAP_CAN_MONITOR_DELTA
        bool "Changed-bytes records"
        help
          A frame whose identifier the session has seen is sent as the bytes
          that changed since its last payload (record kind 1), when OPEN asks
          for it.

    config EERIE_LEAP_CAN_MONITOR_DELTA_IDS
        int "Identifiers whose last payload a session keeps"
        depends on EERIE_LEAP_CAN_MONITOR_DELTA
        range 1 4096
        default 256

    config EERIE_LEAP_CAN_MONITOR_TX
        bool "Transmit and replay"
        help
          ARM, SEND, PERIODIC and REPLAY in the canmon group. Without it they
          answer TX_UNSUPPORTED.

    config EERIE_LEAP_CAN_MONITOR_TX_SHARE_PERCENT
        int "Cap on the bus time a session transmits, in percent"
        depends on EERIE_LEAP_CAN_MONITOR_TX
        range 1 100
        default 50

    config EERIE_LEAP_CAN_MONITOR_TX_BURST_FRAMES
        int "Frames sent back to back after idle"
        depends on EERIE_LEAP_CAN_MONITOR_TX
        range 1 64
        default 8

    config EERIE_LEAP_CAN_MONITOR_PERIODIC_SLOTS
        int "Periodic frames a session sends"
        depends on EERIE_LEAP_CAN_MONITOR_TX
        range 1 64
        default 16

    config EERIE_LEAP_CAN_MONITOR_REPLAY_BUFFER_SIZE
        int "Bytes of the replay buffer"
        depends on EERIE_LEAP_CAN_MONITOR_TX
        range 1024 16777216
        default 65536
        help
          Allocated from the external memory resource while a replay runs.

    config EERIE_LEAP_CAN_MONITOR_REPLAY_LATE_MS
        int "A replayed frame later than this is counted late, in ms"
        depends on EERIE_LEAP_CAN_MONITOR_TX
        range 1 10000
        default 10

    config EERIE_LEAP_CAN_MONITOR_SYNTHETIC
        bool "Synthetic source"
        help
          OPEN with `synthetic` streams generated frames with no bus (port
          255), to measure the link. For debug and bench builds.

    module = EERIE_LEAP_CAN_MONITOR
    module-str = eerie_leap_can_monitor
    source "subsys/logging/Kconfig.template.log_config"
endmenu
```

## src/domain/canbus_com_domain/Kconfig.canbus_com_domain
```kconfig
config EERIE_LEAP_DOMAIN_CANBUS_COM
    bool "EerieLeap CANBus COM Domain"
    select EERIE_LEAP_SMP_CAN
    help
      Add EerieLeap CANBus COM Domain.
```

## src/domain/canbus_domain/Kconfig.canbus_domain
```kconfig
config EERIE_LEAP_DOMAIN_CANBUS
    depends on EERIE_LEAP_CONFIGURATION && EERIE_LEAP_CANBUS
    bool "EerieLeap CANBus Domain"
    help
      Add EerieLeap CANBus Domain.

menu "EerieLeap CANBus Domain config"
    depends on EERIE_LEAP_DOMAIN_CANBUS

    config EERIE_LEAP_CAN_SCRIPT_MAX_SIZE
        int "Largest CAN message script that can be uploaded"
        range 1 1048576
        default 65536
        help
          Largest Lua script, in bytes, that the CAN scripts of the assets SMP
          group take; a larger upload is refused. A script is read into memory
          whole when the CAN configuration is applied, and the Lua states that
          run scripts are limited by EERIE_LEAP_LUA_SCRIPT_MEMORY_LIMIT_KB.
endmenu
```
