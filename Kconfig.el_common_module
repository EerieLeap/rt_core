## src/subsys/cdmp/Kconfig.cdmp
```kconfig
config EERIE_LEAP_CDMP
    bool "EerieLeap CDMP"
    select CRC
    select HWINFO
    select EERIE_LEAP_RANDOM
    help
      Add EerieLeap CDMP.

menu "EerieLeap CDMP config"
    depends on EERIE_LEAP_CDMP

    config EERIE_LEAP_CDMP_SERVICE_THREAD_PRIORITY
        int "EerieLeap CDMP Service Thread Priority"
        default 5
        help
          Add EerieLeap CDMP Service Thread Priority.

    config EERIE_LEAP_CDMP_SERVICE_THREAD_STACK_SIZE
        int "EerieLeap CDMP Service Thread Stack Size"
        default 4096
        help
          Add EerieLeap CDMP Service Thread Stack Size.

    config EERIE_LEAP_CDMP_WORK_QUEUE_PRIORITY
        int "EerieLeap CDMP Work Queue Priority"
        default 5
        help
          Add EerieLeap CDMP Work Queue Priority.

    config EERIE_LEAP_CDMP_WORK_QUEUE_STACK_SIZE
        int "EerieLeap CDMP Work Queue Stack Size"
        default 4096
        help
          Add EerieLeap CDMP Work Queue Stack Size.

    config EERIE_LEAP_CDMP_CMD_TRANSACTION_TIMEOUT_MS
        int "EerieLeap CDMP Command Transaction Timeout"
        default 500
        help
          Add EerieLeap CDMP Command Transaction Timeout.

    config EERIE_LEAP_CDMP_STATE_MAX_LOCAL_RECORDS
        int "Shared state records of this unit"
        default 8
        range 1 32
        help
          State types this unit can share at once. A withdrawn record keeps its
          slot until every online peer has acknowledged the withdrawal, unless a
          new type needs the slot first.

    config EERIE_LEAP_CDMP_STATE_MAX_REMOTE_RECORDS
        int "Shared state records of other units"
        default 32
        range 1 1024
        help
          Records of other units this unit keeps, about 10 bytes each. The
          records of a source that do not fit are dropped, and that source's
          heartbeat digest is not checked until room frees up.
endmenu
```

## src/subsys/device_tree/Kconfig.device_tree
```kconfig
config EERIE_LEAP_DEVICE_TREE
    bool "EerieLeap Device Tree"
    help
      Add EerieLeap device tree accessors.
```

## src/subsys/fs/Kconfig.fs
```kconfig
config EERIE_LEAP_FS
    bool "EerieLeap FS"
    # SdmmcService, built with DISK_ACCESS, polls the card on its own thread.
    select EERIE_LEAP_THREADING if DISK_ACCESS
    help
      Add EerieLeap FS.

menu "EerieLeap FS config"
    depends on EERIE_LEAP_FS

    config EERIE_LEAP_FS_SD_THREAD_STACK_SIZE
        int "SD thread stack size"
        default 3072

    config EERIE_LEAP_SD_CHECK_INTERVAL_MS
        int "SD check interval ms"
        default 1000

    config EERIE_LEAP_FS_STREAM_WRITE_BUFFER_SIZE
        int "Stream write buffer size"
        range 0 65536
        default 4096
        help
          Bytes FsServiceStreamBuf collects before issuing one fs_write() in
          write and append modes; 0 hands every write straight to the file
          system. A larger buffer means fewer, larger writes, not a larger
          loss window: the buffer is flushed on every sync, seek and close, so
          what a power loss can take is bounded by how often the writer syncs
          (EERIE_LEAP_LOG_SYNC_INTERVAL_MS for the log writer) plus at most
          one buffer of records.
endmenu
```

## src/subsys/gpio/Kconfig.gpio
```kconfig
config EERIE_LEAP_GPIO
    bool "EerieLeap GPIO"
    help
      Add EerieLeap GPIO.

menu "EerieLeap GPIO config"
    depends on EERIE_LEAP_GPIO

    config EERIE_LEAP_GPIO_RANDOMIZER
        bool "Random GPIO channels (bench and development aid)"
        help
          Adds GPIO channels whose level flips after random hold times,
          after the device tree channels (hardware channels keep their
          numbers), so a PHYSICAL_INDICATOR sensor can be connected to one
          by its channel number like to a real input. The channels raise
          edges to registered handlers like hardware. Without any device
          tree GPIO it replaces the white-noise simulator, which raises no
          edges. A bench and development aid: leave it off in a shipped
          build.

    config EERIE_LEAP_GPIO_RANDOMIZER_CHANNELS
        int "Random GPIO channels"
        depends on EERIE_LEAP_GPIO_RANDOMIZER
        range 1 32
        default 4
        help
          Number of random channels; they are numbered after the hardware
          channels.

    config EERIE_LEAP_GPIO_RANDOMIZER_HOLD_MIN_MS
        int "Shortest hold of a level (ms)"
        depends on EERIE_LEAP_GPIO_RANDOMIZER
        range 1 600000
        default 100
        help
          A channel holds a level for a random time between this and the
          longest hold, then flips.

    config EERIE_LEAP_GPIO_RANDOMIZER_HOLD_MAX_MS
        int "Longest hold of a level (ms)"
        depends on EERIE_LEAP_GPIO_RANDOMIZER
        range 1 600000
        default 5000
        help
          Upper bound of the hold time; a value below the shortest hold is
          treated as equal to it.
endmenu
```

## src/subsys/smp/Kconfig.smp
```kconfig
config EERIE_LEAP_SMP
    bool "EerieLeap SMP"
    select CRC
    select NET_BUF
    select ZCBOR
    select MCUMGR
    select MCUMGR_GRP_OS
    select MCUMGR_GRP_OS_MCUMGR_PARAMS
    select MCUMGR_SMP_CBOR_MIN_DECODING_LEVEL_2
    select MCUMGR_SMP_CBOR_MIN_ENCODING_LEVEL_3 if ZCBOR_CANONICAL
    select EERIE_LEAP_RANDOM
    select EERIE_LEAP_THREADING
    help
      MCUmgr SMP server with the os group (echo, mcumgr params, reset) and
      the config, device and network groups of the enabled domains.

menu "EerieLeap SMP groups config"
    depends on EERIE_LEAP_SMP

    config EERIE_LEAP_SMP_CONFIG_SESSION_TIMEOUT_MS
        int "Idle time after which a config transfer is abandoned"
        default 5000
        help
          Frees the staging buffer of a write, or the snapshot of a read,
          that the client stopped sending requests for.

    config EERIE_LEAP_SMP_NETWORK_MAX_DEVICES
        int "Devices the network group can list"
        default 32
        range 1 254
endmenu

config EERIE_LEAP_SMP_CAN
    bool "EerieLeap SMP over CAN"
    depends on EERIE_LEAP_CANBUS
    select EERIE_LEAP_SMP
    select EERIE_LEAP_THREADING
    help
      SMP transport over CAN, as specified in the CDMP README.

menu "EerieLeap SMP over CAN config"
    depends on EERIE_LEAP_SMP_CAN

    config EERIE_LEAP_SMP_CAN_RX_SLOTS
        int "Sources that can send a packet at the same time"
        default 2
        range 1 8

    config EERIE_LEAP_SMP_CAN_RX_TIMEOUT_MS
        int "Inter-frame timeout after which a partial packet is dropped"
        default 100

    config EERIE_LEAP_SMP_CAN_TX_BURST_FRAMES
        int "Frames that may be sent back to back after an idle period"
        default 8
        range 1 64
        help
          The sender sleeps until half of them are available again. The burst
          should cover a few system ticks of frames at the paced rate,
          otherwise tick granularity lowers the achieved rate.
endmenu

config EERIE_LEAP_SMP_BLE
    bool "EerieLeap SMP router for a BLE access point"
    select EERIE_LEAP_SMP
    help
      Routes SMP packets between a BLE central and the local SMP server or,
      through a forwarder such as the CAN transport, other units.

menu "EerieLeap SMP over BLE config"
    depends on EERIE_LEAP_SMP_BLE

    config EERIE_LEAP_SMP_BLE_RX_TIMEOUT_MS
        int "Gap between writes after which a partial packet is dropped"
        default 1000

    config EERIE_LEAP_SMP_BLE_MAX_FIRST_FRAGMENT_SIZE
        int "Largest first notification of a packet"
        default 244
        range 20 512
        help
          The first notification of each packet carries the route byte, so it
          is assembled in a buffer of this size. 244 fills an ATT MTU of 247.

    config EERIE_LEAP_SMP_BLE_REQUESTS_IN_FLIGHT
        int "Requests a client should keep in flight"
        default 2
        range 1 16
        help
          Reported by the info characteristic. The SMP buffer pool is shared
          with the other transports, so this stays below its size.
endmenu

# Defaults for the MCUmgr core; boards may override them.
if EERIE_LEAP_SMP

config MCUMGR_TRANSPORT_NETBUF_COUNT
    default 6

config MCUMGR_TRANSPORT_NETBUF_SIZE
    default 1024

# Below the sensor processing service (6).
config MCUMGR_TRANSPORT_WORKQUEUE_THREAD_PRIO
    default 7

endif
```

## tests/functional/domain/canbus_com_domain/testcase.yaml
```yaml
common:
  tags:
    - functional
    - domain.canbus_com
  platform_allow:
    - native_sim
    - qemu_cortex_a9
    - qemu_cortex_a53
    - qemu_riscv64
    - qemu_malta

tests:
  functional.canbus_com_domain: {}
```
