## CMakeLists.txt
```
cmake_minimum_required(VERSION 3.20.0)

set(RT_CORE_TEST_SIM_FLASH ON)
include(${CMAKE_CURRENT_SOURCE_DIR}/../../rt_core_test.cmake)

find_package(Zephyr REQUIRED HINTS $ENV{ZEPHYR_BASE})
project(functional_configuration)

# CBOR configs are pulled in directly: the owning domains are not enabled here.
file(GLOB_RECURSE RT_CORE_CBOR_SOURCES
  ${RT_CORE_DIR}/src/configuration/cbor/traits/system_config_trait.cpp
  ${RT_CORE_DIR}/src/configuration/cbor/cbor_system_config/*.c
  ${RT_CORE_DIR}/src/configuration/cbor/traits/adc_config_trait.cpp
  ${RT_CORE_DIR}/src/configuration/cbor/cbor_adc_config/*.cpp
  ${RT_CORE_DIR}/src/configuration/cbor/traits/sensors_config_trait.cpp
  ${RT_CORE_DIR}/src/configuration/cbor/cbor_sensors_config/*.cpp
  ${RT_CORE_DIR}/src/configuration/cbor/traits/canbus_config_trait.cpp
  ${RT_CORE_DIR}/src/configuration/cbor/cbor_canbus_config/*.cpp
)

file(GLOB_RECURSE TEST_SOURCES src/*.c src/*.cpp)

target_sources(app PRIVATE
  ${RT_CORE_CBOR_SOURCES}
  ${TEST_SOURCES}
)
```

## prj.conf
```kconfig
CONFIG_ZTEST=y

# Language and Compiler
CONFIG_CPP=y
CONFIG_PICOLIBC=y
CONFIG_STD_CPP23=y
CONFIG_REQUIRES_FULL_LIBCPP=y
CONFIG_CPP_EXCEPTIONS=y
CONFIG_CPP_RTTI=y

# Logging And Debugging
CONFIG_LOG=y
CONFIG_TEST_RANDOM_GENERATOR=y
CONFIG_THREAD_ANALYZER=y
CONFIG_THREAD_ANALYZER_USE_LOG=y
CONFIG_THREAD_NAME=y
CONFIG_SYS_HEAP_RUNTIME_STATS=y
CONFIG_THREAD_ANALYZER_ISR_STACK_USAGE=n

# Memory
CONFIG_HEAP_MEM_POOL_SIZE=200000

# C++ exception unwinding needs considerably more stack than the ztest defaults.
CONFIG_MAIN_STACK_SIZE=8192
CONFIG_ZTEST_STACK_SIZE=8192

# ThreadBase::InitializeStack() falls back to k_thread_stack_alloc().
CONFIG_THREAD_STACK_INFO=y
CONFIG_DYNAMIC_THREAD=y
CONFIG_DYNAMIC_THREAD_ALLOC=y

# FS Config
CONFIG_FLASH=y
CONFIG_FLASH_MAP=y
CONFIG_FILE_SYSTEM=y
CONFIG_FILE_SYSTEM_LITTLEFS=y
CONFIG_FILE_SYSTEM_MKFS=y

# CBOR
CONFIG_ZCBOR=y

CONFIG_CRC=y

CONFIG_EERIE_LEAP_RT_CORE=y
CONFIG_EERIE_LEAP_CONFIGURATION=y
CONFIG_EERIE_LEAP_DEVICE_TREE=y
CONFIG_EERIE_LEAP_FS=y
CONFIG_EERIE_LEAP_GPIO=y
CONFIG_EERIE_LEAP_LUA_SCRIPT=y
CONFIG_EERIE_LEAP_RANDOM=y
CONFIG_EERIE_LEAP_TIME=y
```

## src/configuration_service.cpp
```c
#include <memory>
#include <optional>
#include <zephyr/ztest.h>

#include "configuration/cbor/cbor_canbus_config/cbor_canbus_config.h"
#include "configuration/cbor/cbor_sensors_config/cbor_sensors_config.h"
#include "configuration/cbor/cbor_system_config/cbor_system_config.h"
#include "configuration/services/cbor_configuration_service.h"
#include "utilities/cbor/cbor_helpers.hpp"

#include "subsys/device_tree/dt_fs.h"
#include "subsys/fs/services/fs_service.h"
#include "subsys/fs/services/i_fs_service.h"
#include "subsys/threading/work_queue_thread.h"

using namespace eerie_leap::utilities::cbor;
using namespace eerie_leap::configuration::services;
using namespace eerie_leap::subsys::fs::services;
using namespace eerie_leap::subsys::device_tree;

using eerie_leap::subsys::threading::WorkQueueThread;

namespace {

constexpr int CONFIG_QUEUE_STACK_SIZE = 8192;
constexpr int CONFIG_QUEUE_PRIORITY = 5;
constexpr int SYNC_TIMEOUT_MS = 2000;

} // namespace

ZTEST_SUITE(configuration_service, NULL, NULL, NULL, NULL, NULL);

ZTEST(configuration_service, test_CborSystemConfig_Save_config_successfully_saved) {
    CborSystemConfig system_config{};
    memset(&system_config, 0, sizeof(system_config));

    system_config.device_id = 12;
    system_config.build_number = 22;

    DtFs::InitInternalFs();
    const auto fs_service = std::make_shared<FsService>(DtFs::GetInternalFsMp());

    fs_service->Format();
    auto system_config_service = std::make_unique<CborConfigurationService<CborSystemConfig>>(
        "system_config", fs_service
    );

    const auto save_res = system_config_service->Save(&system_config);
    zassert_true(save_res);
}

ZTEST(configuration_service, test_CborSystemConfig_Load_config_successfully_saved_and_loaded) {
    CborSystemConfig system_config{};
    memset(&system_config, 0, sizeof(system_config));

    system_config.device_id = 14;
    system_config.build_number = 46;

    DtFs::InitInternalFs();
    const auto fs_service = std::make_shared<FsService>(DtFs::GetInternalFsMp());

    fs_service->Format();
    auto system_config_service = std::make_unique<CborConfigurationService<CborSystemConfig>>(
        "system_config", fs_service
    );

    const auto save_res = system_config_service->Save(&system_config);
    zassert_true(save_res);

    auto loaded_config = system_config_service->Load();
    zassert_true(loaded_config.has_value());
    zassert_equal(loaded_config.value().config->device_id, 14);
    zassert_equal(loaded_config.value().config->build_number, 46);
}

ZTEST(configuration_service, test_CborSystemConfig_Save_and_Load_are_delegated_to_the_supplied_work_queue) {
    CborSystemConfig system_config{};
    memset(&system_config, 0, sizeof(system_config));

    system_config.device_id = 21;
    system_config.build_number = 55;

    DtFs::InitInternalFs();
    const auto fs_service = std::make_shared<FsService>(DtFs::GetInternalFsMp());

    fs_service->Format();

    const auto work_queue_thread = std::make_shared<WorkQueueThread>(
        "config_wq_delegated", CONFIG_QUEUE_STACK_SIZE, CONFIG_QUEUE_PRIORITY
    );
    zassert_true(work_queue_thread->Initialize());

    auto system_config_service = std::make_unique<CborConfigurationService<CborSystemConfig>>(
        "system_config", fs_service, work_queue_thread
    );

    zassert_true(system_config_service->Save(&system_config));

    auto loaded_config = system_config_service->Load();
    zassert_true(loaded_config.has_value());
    zassert_equal(loaded_config.value().config->device_id, 21);
    zassert_equal(loaded_config.value().config->build_number, 55);

    work_queue_thread->Stop();
}

ZTEST(configuration_service, test_CborSystemConfig_Save_and_Load_do_not_deadlock_on_their_own_work_queue) {
    CborSystemConfig system_config{};
    memset(&system_config, 0, sizeof(system_config));

    system_config.device_id = 33;
    system_config.build_number = 77;

    DtFs::InitInternalFs();
    const auto fs_service = std::make_shared<FsService>(DtFs::GetInternalFsMp());

    fs_service->Format();

    const auto work_queue_thread = std::make_shared<WorkQueueThread>(
        "config_wq_reentrant", CONFIG_QUEUE_STACK_SIZE, CONFIG_QUEUE_PRIORITY
    );
    zassert_true(work_queue_thread->Initialize());

    auto system_config_service = std::make_unique<CborConfigurationService<CborSystemConfig>>(
        "system_config", fs_service, work_queue_thread
    );

    bool saved = false;
    std::optional<LoadedConfig<CborSystemConfig>> loaded_config;
    k_sem done{};
    k_sem_init(&done, 0, K_SEM_MAX_LIMIT);

    // Save and Load hand their work to this very queue, so waiting for it from a
    // task already running on it used to park the queue thread on itself.
    work_queue_thread->Run([&] {
        saved = system_config_service->Save(&system_config);
        loaded_config = system_config_service->Load();

        k_sem_give(&done);
    });

    zassert_equal(
        k_sem_take(&done, K_MSEC(SYNC_TIMEOUT_MS)), 0,
        "Save/Load deadlocked when called from their own work queue thread"
    );
    zassert_true(saved);
    zassert_true(loaded_config.has_value());
    zassert_equal(loaded_config.value().config->device_id, 33);
    zassert_equal(loaded_config.value().config->build_number, 77);

    work_queue_thread->Stop();
}

namespace {

K_THREAD_STACK_DEFINE(contending_saver_stack, 4096);

struct ContendingSave {
    CborConfigurationService<CborSystemConfig>* service;
    CborSystemConfig* config;
    bool saved;
};

void SaveFromAnotherThread(void* context, void*, void*) {
    auto* save = static_cast<ContendingSave*>(context);
    save->saved = save->service->Save(save->config);
}

} // namespace

ZTEST(configuration_service, test_CborSystemConfig_Save_on_the_work_queue_does_not_wait_for_a_thread_waiting_for_it) {
    CborSystemConfig queue_config{};
    memset(&queue_config, 0, sizeof(queue_config));
    queue_config.device_id = 41;

    CborSystemConfig thread_config{};
    memset(&thread_config, 0, sizeof(thread_config));
    thread_config.device_id = 42;

    DtFs::InitInternalFs();
    const auto fs_service = std::make_shared<FsService>(DtFs::GetInternalFsMp());

    fs_service->Format();

    const auto work_queue_thread = std::make_shared<WorkQueueThread>(
        "config_wq_contended", CONFIG_QUEUE_STACK_SIZE, CONFIG_QUEUE_PRIORITY
    );
    zassert_true(work_queue_thread->Initialize());

    auto system_config_service = std::make_unique<CborConfigurationService<CborSystemConfig>>(
        "system_config", fs_service, work_queue_thread
    );

    bool queue_saved = false;
    k_sem started{};
    k_sem release{};
    k_sem done{};
    k_sem_init(&started, 0, 1);
    k_sem_init(&release, 0, 1);
    k_sem_init(&done, 0, 1);

    // Holds the queue until another thread is inside Save(), waiting for the queue.
    work_queue_thread->Run([&] {
        k_sem_give(&started);
        k_sem_take(&release, K_FOREVER);
        queue_saved = system_config_service->Save(&queue_config);
        k_sem_give(&done);
    });
    zassert_equal(k_sem_take(&started, K_MSEC(SYNC_TIMEOUT_MS)), 0);

    ContendingSave contending{ .service = system_config_service.get(), .config = &thread_config, .saved = false };
    k_thread saver;
    k_thread_create(
        &saver, contending_saver_stack, K_THREAD_STACK_SIZEOF(contending_saver_stack), SaveFromAnotherThread,
        &contending, nullptr, nullptr, CONFIG_QUEUE_PRIORITY, 0, K_NO_WAIT
    );
    k_msleep(50);

    k_sem_give(&release);

    zassert_equal(
        k_sem_take(&done, K_MSEC(SYNC_TIMEOUT_MS)), 0,
        "Save() on the work queue waited for a thread that was waiting for the queue"
    );
    zassert_equal(k_thread_join(&saver, K_MSEC(SYNC_TIMEOUT_MS)), 0);
    zassert_true(queue_saved);
    zassert_true(contending.saved);

    // The queued save ran after the one on the queue.
    auto loaded_config = system_config_service->Load();
    zassert_true(loaded_config.has_value());
    zassert_equal(loaded_config.value().config->device_id, 42);

    work_queue_thread->Stop();
}

ZTEST(configuration_service, test_CborSensorsConfig_Save_config_successfully_saved) {
    // Create first sensor config
    const std::string sensor_1_name = "name 1";
    const std::string sensor_1_unit = "km/h";
    const std::string sensor_1_description;
    const CborSensorMetadataConfig metadata_config_1 = { .name = CborHelpers::ToZcborString(sensor_1_name),
        .unit = CborHelpers::ToZcborString(sensor_1_unit),
        .description = CborHelpers::ToZcborString(sensor_1_description) };

    const std::string sensor_1_expression = "({var_d} + {y}) * 4";
    CborSensorConfigurationConfig configuration_config_1(std::allocator_arg, Mrm::GetDefaultPmr());
    configuration_config_1.type = 1;
    configuration_config_1.sampling_rate_ms = 210;
    configuration_config_1.interpolation_method = 1;
    configuration_config_1.channel = 6;
    configuration_config_1.channel_present = true;
    configuration_config_1.calibration_table_present = false;
    configuration_config_1.expression = CborHelpers::ToZcborString(sensor_1_expression);
    configuration_config_1.expression_present = true;

    const std::string sensor_1_id = "sensor_1";
    CborSensorConfig sensor_config_1(std::allocator_arg, Mrm::GetDefaultPmr());
    sensor_config_1.id = CborHelpers::ToZcborString(sensor_1_id);
    sensor_config_1.metadata = metadata_config_1;
    sensor_config_1.configuration = configuration_config_1;

    // Create second sensor config
    const std::string sensor_2_name = "name 2";
    const std::string sensor_2_unit = "m/s";
    const std::string sensor_2_description;
    const CborSensorMetadataConfig metadata_config_2 = { .name = CborHelpers::ToZcborString(sensor_2_name),
        .unit = CborHelpers::ToZcborString(sensor_2_unit),
        .description = CborHelpers::ToZcborString(sensor_2_description) };

    CborSensorCalibrationDataMap calibration_data_map_2(std::allocator_arg, Mrm::GetDefaultPmr());
    calibration_data_map_2.float32float = { { 1.0, 2.0 }, { 1.1, 2.1 }, { 1.2, 2.2 }, { 1.3, 2.3 } };

    const std::string sensor_2_expression = "({x} - 8 * {var_d}) / {f}";
    CborSensorConfigurationConfig configuration_config_2(std::allocator_arg, Mrm::GetDefaultPmr());
    configuration_config_2.type = 1;
    configuration_config_2.sampling_rate_ms = 250;
    configuration_config_2.interpolation_method = 1;
    configuration_config_2.channel = 6;
    configuration_config_2.channel_present = true;
    configuration_config_2.calibration_table = calibration_data_map_2;
    configuration_config_2.calibration_table_present = true;
    configuration_config_2.expression = CborHelpers::ToZcborString(sensor_2_expression);
    configuration_config_2.expression_present = true;

    const std::string sensor_2_id = "sensor_2";
    CborSensorConfig sensor_config_2(std::allocator_arg, Mrm::GetDefaultPmr());
    sensor_config_2.id = CborHelpers::ToZcborString(sensor_2_id);
    sensor_config_2.metadata = metadata_config_2;
    sensor_config_2.configuration = configuration_config_2;

    CborSensorsConfig sensors_config(std::allocator_arg, Mrm::GetDefaultPmr());
    sensors_config.CborSensorConfig_m.push_back(std::move(sensor_config_1));
    sensors_config.CborSensorConfig_m.push_back(std::move(sensor_config_2));

    DtFs::InitInternalFs();
    const auto fs_service = std::make_shared<FsService>(DtFs::GetInternalFsMp());

    fs_service->Format();
    auto cbor_sensors_config_service = std::make_unique<CborConfigurationService<CborSensorsConfig>>(
        "sensors_config", fs_service
    );

    const auto save_res = cbor_sensors_config_service->Save(&sensors_config);
    zassert_true(save_res);
}

ZTEST(configuration_service, test_CborSensorsConfig_Load_config_successfully_saved_and_loaded) {
    // Create first sensor config
    const std::string sensor_1_name = "name 3";
    const std::string sensor_1_unit = "km/h";
    const std::string sensor_1_description;
    const CborSensorMetadataConfig metadata_config_1 = { .name = CborHelpers::ToZcborString(sensor_1_name),
        .unit = CborHelpers::ToZcborString(sensor_1_unit),
        .description = CborHelpers::ToZcborString(sensor_1_description) };

    const std::string sensor_1_expression = "({var_d} + {y}) * 4";
    CborSensorConfigurationConfig configuration_config_1(std::allocator_arg, Mrm::GetDefaultPmr());
    configuration_config_1.type = 1;
    configuration_config_1.sampling_rate_ms = 210;
    configuration_config_1.interpolation_method = 1;
    configuration_config_1.channel = 6;
    configuration_config_1.channel_present = true;
    configuration_config_1.calibration_table_present = false;
    configuration_config_1.expression = CborHelpers::ToZcborString(sensor_1_expression);
    configuration_config_1.expression_present = true;
    configuration_config_1.debounce_ms = 30;
    configuration_config_1.input_mode = 1;

    const std::string sensor_1_id = "sensor_3";
    CborSensorConfig sensor_config_1(std::allocator_arg, Mrm::GetDefaultPmr());
    sensor_config_1.id = CborHelpers::ToZcborString(sensor_1_id);
    sensor_config_1.metadata = metadata_config_1;
    sensor_config_1.configuration = configuration_config_1;

    // Create second sensor config
    const std::string sensor_2_name = "name 4";
    const std::string sensor_2_unit = "m/s";
    const std::string sensor_2_description = "Some description 4";
    const CborSensorMetadataConfig metadata_config_2 = { .name = CborHelpers::ToZcborString(sensor_2_name),
        .unit = CborHelpers::ToZcborString(sensor_2_unit),
        .description = CborHelpers::ToZcborString(sensor_2_description) };

    CborSensorCalibrationDataMap calibration_data_map_2(std::allocator_arg, Mrm::GetDefaultPmr());
    calibration_data_map_2.float32float = { { 1.0, 2.0 }, { 1.1, 2.1 }, { 1.2, 2.2 }, { 1.3, 2.3 } };

    const std::string sensor_2_expression = "({x} - 8 * {var_d}) / {f}";
    CborSensorConfigurationConfig configuration_config_2(std::allocator_arg, Mrm::GetDefaultPmr());
    configuration_config_2.type = 1;
    configuration_config_2.sampling_rate_ms = 250;
    configuration_config_2.interpolation_method = 1;
    configuration_config_2.channel = 6;
    configuration_config_2.channel_present = true;
    configuration_config_2.calibration_table = calibration_data_map_2;
    configuration_config_2.calibration_table_present = true;
    configuration_config_2.expression = CborHelpers::ToZcborString(sensor_2_expression);
    configuration_config_2.expression_present = true;

    const std::string sensor_2_id = "sensor_4";
    CborSensorConfig sensor_config_2(std::allocator_arg, Mrm::GetDefaultPmr());
    sensor_config_2.id = CborHelpers::ToZcborString(sensor_2_id);
    sensor_config_2.is_enabled = false;
    sensor_config_2.metadata = metadata_config_2;
    sensor_config_2.configuration = configuration_config_2;

    // Create sensors config with both sensors
    CborSensorsConfig sensors_config(std::allocator_arg, Mrm::GetDefaultPmr());
    sensors_config.CborSensorConfig_m.push_back(std::move(sensor_config_1));
    sensors_config.CborSensorConfig_m.push_back(std::move(sensor_config_2));

    // Initialize services
    DtFs::InitInternalFs();
    const auto fs_service = std::make_shared<FsService>(DtFs::GetInternalFsMp());

    fs_service->Format();
    auto sensors_config_service = std::make_unique<CborConfigurationService<CborSensorsConfig>>(
        "sensors_config", fs_service
    );

    // Save config
    const auto save_res = sensors_config_service->Save(&sensors_config);
    zassert_true(save_res);

    // Load config and verify
    auto loaded_config = sensors_config_service->Load();
    zassert_true(loaded_config.has_value());

    auto loaded_sensors_config = std::move(loaded_config.value().config);
    zassert_equal(loaded_sensors_config->CborSensorConfig_m.size(), 2);

    // Verify first sensor
    zassert_str_equal(
        CborHelpers::ToStdString(loaded_sensors_config->CborSensorConfig_m[0].id).c_str(), sensor_1_id.c_str()
    );
    zassert_true(loaded_sensors_config->CborSensorConfig_m[0].is_enabled);

    zassert_str_equal(
        CborHelpers::ToStdString(loaded_sensors_config->CborSensorConfig_m[0].metadata.name).c_str(),
        sensor_1_name.c_str()
    );
    zassert_str_equal(
        CborHelpers::ToStdString(loaded_sensors_config->CborSensorConfig_m[0].metadata.unit).c_str(),
        sensor_1_unit.c_str()
    );

    zassert_equal(loaded_sensors_config->CborSensorConfig_m[0].configuration.type, 1);
    zassert_equal(loaded_sensors_config->CborSensorConfig_m[0].configuration.channel, 6);
    zassert_true(loaded_sensors_config->CborSensorConfig_m[0].configuration.channel_present);
    zassert_equal(loaded_sensors_config->CborSensorConfig_m[0].configuration.sampling_rate_ms, 210);
    zassert_false(loaded_sensors_config->CborSensorConfig_m[0].configuration.calibration_table_present);
    zassert_equal(loaded_sensors_config->CborSensorConfig_m[0].configuration.interpolation_method, 1);
    zassert_true(loaded_sensors_config->CborSensorConfig_m[0].configuration.expression_present);
    zassert_str_equal(
        CborHelpers::ToStdString(loaded_sensors_config->CborSensorConfig_m[0].configuration.expression).c_str(),
        sensor_1_expression.c_str()
    );
    zassert_equal(loaded_sensors_config->CborSensorConfig_m[0].configuration.debounce_ms, 30);
    zassert_equal(loaded_sensors_config->CborSensorConfig_m[0].configuration.input_mode, 1);

    // Verify second sensor
    zassert_str_equal(
        CborHelpers::ToStdString(loaded_sensors_config->CborSensorConfig_m[1].id).c_str(), sensor_2_id.c_str()
    );
    zassert_false(loaded_sensors_config->CborSensorConfig_m[1].is_enabled);

    zassert_str_equal(
        CborHelpers::ToStdString(loaded_sensors_config->CborSensorConfig_m[1].metadata.name).c_str(),
        sensor_2_name.c_str()
    );
    zassert_str_equal(
        CborHelpers::ToStdString(loaded_sensors_config->CborSensorConfig_m[1].metadata.unit).c_str(),
        sensor_2_unit.c_str()
    );
    zassert_str_equal(
        CborHelpers::ToStdString(loaded_sensors_config->CborSensorConfig_m[1].metadata.description).c_str(),
        sensor_2_description.c_str()
    );

    zassert_equal(loaded_sensors_config->CborSensorConfig_m[1].configuration.type, 1);
    zassert_equal(loaded_sensors_config->CborSensorConfig_m[1].configuration.channel, 6);
    zassert_true(loaded_sensors_config->CborSensorConfig_m[1].configuration.channel_present);
    zassert_equal(loaded_sensors_config->CborSensorConfig_m[1].configuration.sampling_rate_ms, 250);
    zassert_true(loaded_sensors_config->CborSensorConfig_m[1].configuration.calibration_table_present);
    zassert_equal(loaded_sensors_config->CborSensorConfig_m[1].configuration.calibration_table.float32float.size(), 4);
    zassert_equal(
        loaded_sensors_config->CborSensorConfig_m[1].configuration.calibration_table.float32float[0].float32float_key,
        1.0F
    );
    zassert_equal(
        loaded_sensors_config->CborSensorConfig_m[1].configuration.calibration_table.float32float[0].float32float, 2.0F
    );
    zassert_between_inclusive(
        loaded_sensors_config->CborSensorConfig_m[1].configuration.calibration_table.float32float[1].float32float_key,
        1.09F, 1.11F
    );
    zassert_between_inclusive(
        loaded_sensors_config->CborSensorConfig_m[1].configuration.calibration_table.float32float[1].float32float,
        2.09F, 2.11F
    );
    zassert_between_inclusive(
        loaded_sensors_config->CborSensorConfig_m[1].configuration.calibration_table.float32float[2].float32float_key,
        1.19F, 1.21F
    );
    zassert_between_inclusive(
        loaded_sensors_config->CborSensorConfig_m[1].configuration.calibration_table.float32float[2].float32float,
        2.19F, 2.21F
    );
    zassert_between_inclusive(
        loaded_sensors_config->CborSensorConfig_m[1].configuration.calibration_table.float32float[3].float32float_key,
        1.29F, 1.31F
    );
    zassert_between_inclusive(
        loaded_sensors_config->CborSensorConfig_m[1].configuration.calibration_table.float32float[3].float32float,
        2.29F, 2.31F
    );
    zassert_equal(loaded_sensors_config->CborSensorConfig_m[1].configuration.interpolation_method, 1);
    zassert_true(loaded_sensors_config->CborSensorConfig_m[1].configuration.expression_present);
    zassert_str_equal(
        CborHelpers::ToStdString(loaded_sensors_config->CborSensorConfig_m[1].configuration.expression).c_str(),
        sensor_2_expression.c_str()
    );
    zassert_equal(loaded_sensors_config->CborSensorConfig_m[1].configuration.debounce_ms, 0);
    zassert_equal(loaded_sensors_config->CborSensorConfig_m[1].configuration.input_mode, 0);
}

ZTEST(configuration_service, test_CborCanbusConfig_Load_config_successfully_saved_and_loaded) {
    const std::string message_name = "EL_FRAME_0";
    const std::string script_path;
    CborCanMessageConfig message_config(std::allocator_arg, Mrm::GetDefaultPmr());
    message_config.frame_id = 0x123;
    message_config.is_enabled = false;
    message_config.send_interval_ms = 100;
    message_config.script_path = CborHelpers::ToZcborString(script_path);
    message_config.name = CborHelpers::ToZcborString(message_name);
    message_config.message_size = 8;

    CborCanChannelConfig channel_config(std::allocator_arg, Mrm::GetDefaultPmr());
    channel_config.type = 1;
    channel_config.bus_channel = 0;
    channel_config.bitrate = 500000;
    channel_config.CborCanMessageConfig_m.push_back(std::move(message_config));

    CborCanbusConfig canbus_config(std::allocator_arg, Mrm::GetDefaultPmr());
    canbus_config.CborCanChannelConfig_m.push_back(std::move(channel_config));
    canbus_config.com_config = {
        .bus_channel = -1, .cdmp_base_can_id = 0x600, .smp_can_id_base = 0x1E000000, .smp_bus_share_percent = 40
    };

    DtFs::InitInternalFs();
    const auto fs_service = std::make_shared<FsService>(DtFs::GetInternalFsMp());

    fs_service->Format();
    auto canbus_config_service = std::make_unique<CborConfigurationService<CborCanbusConfig>>(
        "canbus_config", fs_service
    );

    zassert_true(canbus_config_service->Save(&canbus_config));

    auto loaded_config = canbus_config_service->Load();
    zassert_true(loaded_config.has_value());

    const auto& loaded_canbus_config = *loaded_config.value().config;
    zassert_equal(loaded_canbus_config.CborCanChannelConfig_m.size(), 1);
    zassert_equal(loaded_canbus_config.CborCanChannelConfig_m[0].bitrate, 500000);
    zassert_equal(loaded_canbus_config.CborCanChannelConfig_m[0].CborCanMessageConfig_m.size(), 1);
    zassert_equal(loaded_canbus_config.CborCanChannelConfig_m[0].CborCanMessageConfig_m[0].frame_id, 0x123);
    zassert_false(loaded_canbus_config.CborCanChannelConfig_m[0].CborCanMessageConfig_m[0].is_enabled);
    zassert_equal(
        loaded_canbus_config.CborCanChannelConfig_m[0].CborCanMessageConfig_m[0].send_interval_ms, 100,
        "A disabled message keeps its send interval"
    );

    zassert_equal(loaded_canbus_config.com_config.bus_channel, -1, "An unset COM channel is stored as -1");
    zassert_equal(loaded_canbus_config.com_config.cdmp_base_can_id, 0x600);
    zassert_equal(loaded_canbus_config.com_config.smp_can_id_base, 0x1E000000);
    zassert_equal(loaded_canbus_config.com_config.smp_bus_share_percent, 40);
}
```

## src/configuration_stored_handler.cpp
```c
#include <cstdint>
#include <memory>
#include <stdexcept>
#include <string>
#include <utility>
#include <vector>

#include <zephyr/kernel.h>
#include <zephyr/ztest.h>

#include <eerie_memory.hpp>

#include "configuration/cbor/cbor_system_config/cbor_system_config.h"
#include "configuration/cbor/cbor_system_config/cbor_system_config_cbor_encode.h"
#include "configuration/services/cbor_configuration_service.h"
#include "subsys/device_tree/dt_fs.h"
#include "subsys/fs/services/fs_service.h"
#include "subsys/threading/scoped_mutex.h"
#include "subsys/threading/work_queue_thread.h"
#include "utilities/memory/memory_resource_manager.h"

#include "domain/configuration_domain/services/configuration_service.h"
#include "domain/configuration_domain/utilities/cbor_configuration_manager_base.h"

using namespace eerie_memory;

using eerie_leap::configuration::services::CborConfigurationService;
using eerie_leap::domain::configuration_domain::services::ConfigurationService;
using eerie_leap::domain::configuration_domain::utilities::CborConfigurationManagerBase;
using eerie_leap::subsys::device_tree::DtFs;
using eerie_leap::subsys::fs::services::FsService;
using eerie_leap::subsys::threading::ScopedMutex;
using eerie_leap::utilities::memory::Mrm;

namespace {

using Type = ConfigurationService::Type;

struct TestConfiguration {
    uint64_t device_id = 0;
    uint32_t build_number = 0;
};

constexpr uint64_t REJECTED_DEVICE_ID = 0xBAD;

// A manager over the system configuration's codec: the base's store paths and nothing else.
class TestManager : public CborConfigurationManagerBase<TestConfiguration, CborSystemConfig> {
private:
    PmrUniquePtr<CborSystemConfig> Serialize(const TestConfiguration& configuration) override {
        auto cbor_config = make_unique_pmr<CborSystemConfig>(Mrm::GetDefaultPmr());
        cbor_config->device_id = configuration.device_id;
        cbor_config->build_number = configuration.build_number;

        return cbor_config;
    }

    PmrUniquePtr<TestConfiguration> Deserialize(const CborSystemConfig& cbor_config) override {
        auto configuration = make_unique_pmr<TestConfiguration>(Mrm::GetDefaultPmr());
        configuration->device_id = cbor_config.device_id;
        configuration->build_number = cbor_config.build_number;

        return configuration;
    }

    bool CreateDefaultConfiguration() override {
        return Update(TestConfiguration{ .device_id = 1, .build_number = 0 });
    }

    void ValidateApply(const TestConfiguration& configuration) override {
        if(configuration.device_id == REJECTED_DEVICE_ID)
            throw std::invalid_argument("The device ID is refused.");
    }

public:
    explicit TestManager(std::unique_ptr<CborConfigurationService<CborSystemConfig>> cbor_configuration_service) :
        CborConfigurationManagerBase("Test", std::move(cbor_configuration_service)) {

        LoadOrCreateDefault();
    }

    bool AdoptForTest(uint64_t device_id) {
        return Adopt(std::make_shared<TestConfiguration>(TestConfiguration{ .device_id = device_id }));
    }
};

// What a stored handler saw, in order: the type and the thread.
struct Recorder {
    struct Entry {
        Type type;
        k_tid_t thread;
    };

    k_mutex lock{};
    std::vector<Entry> entries;

    Recorder() {
        k_mutex_init(&lock);
    }

    std::vector<Entry> Get() {
        ScopedMutex guard(lock);

        return entries;
    }

    ConfigurationService::ConfigurationStoredHandler Handler() {
        return [this](Type type) {
            ScopedMutex guard(lock);
            entries.push_back({ type, k_current_get() });
        };
    }
};

std::vector<uint8_t> Encode(uint64_t device_id, uint32_t build_number = 0) {
    const CborSystemConfig config{ .device_id = device_id, .build_number = build_number };
    std::vector<uint8_t> bytes(64);
    size_t size = 0;
    zassert_equal(cbor_encode_CborSystemConfig(bytes.data(), bytes.size(), &config, &size), 0);
    bytes.resize(size);

    return bytes;
}

// The internal file system, formatted, a service with a recorder, and a registered manager.
struct Fixture {
    std::shared_ptr<FsService> fs_service;
    std::shared_ptr<ConfigurationService> service = std::make_shared<ConfigurationService>();
    std::shared_ptr<Recorder> recorder = std::make_shared<Recorder>();
    int next_name = 0;

    Fixture() {
        DtFs::InitInternalFs();
        fs_service = std::make_shared<FsService>(DtFs::GetInternalFsMp());
        zassert_true(fs_service->Format());
    }

    Fixture(const Fixture&) = delete;
    Fixture& operator=(const Fixture&) = delete;
    Fixture(Fixture&&) = delete;
    Fixture& operator=(Fixture&&) = delete;

    ~Fixture() {
        if(service != nullptr)
            service->RegisterConfigurationStoredHandler(nullptr);
    }

    std::shared_ptr<TestManager> MakeManager() {
        return std::make_shared<TestManager>(std::make_unique<CborConfigurationService<CborSystemConfig>>(
            "stored_handler_" + std::to_string(next_name++), fs_service
        ));
    }

    // A manager registered under @p type, with the recorder as the service's handler.
    std::shared_ptr<TestManager> Register(Type type = Type::System) {
        auto manager = MakeManager();
        service->RegisterCborConfigurationManager(type, manager);
        service->RegisterConfigurationStoredHandler(recorder->Handler());

        return manager;
    }
};

Fixture*& Current() {
    static Fixture* fixture = nullptr;

    return fixture;
}

void Before(void*) {
    Current() = new Fixture();
}

void After(void*) {
    delete Current();
    Current() = nullptr;
}

Fixture& F() {
    return *Current();
}

} // namespace

ZTEST_SUITE(configuration_stored_handler, NULL, NULL, Before, After, NULL);

ZTEST(configuration_stored_handler, test_AnUpdateReportsItsTypeOnTheStoringThread) {
    const auto manager = F().Register(Type::Canbus);

    zassert_true(manager->Update(TestConfiguration{ .device_id = 7, .build_number = 1 }));

    const auto entries = F().recorder->Get();
    zassert_equal(entries.size(), 1U);
    zassert_equal(entries[0].type, Type::Canbus, "The type the manager is registered under");
    zassert_equal(entries[0].thread, k_current_get(), "on the thread that stored it");
    zassert_equal(manager->Get()->device_id, 7U);
}

ZTEST(configuration_stored_handler, test_TheStoreIsDoneWhenTheHandlerRuns) {
    auto manager = F().MakeManager();
    F().service->RegisterCborConfigurationManager(Type::System, manager);

    uint64_t seen = 0;
    F().service->RegisterConfigurationStoredHandler([&seen, &manager](Type) {
        seen = manager->Get()->device_id;
    });

    zassert_true(manager->Update(TestConfiguration{ .device_id = 21 }));
    zassert_equal(seen, 21U, "A handler reads the configuration it was told about");
}

ZTEST(configuration_stored_handler, test_AnApplyThroughTheServiceReportsItsType) {
    const auto manager = F().Register(Type::Adc);

    zassert_true(F().service->ApplyCborConfiguration(Type::Adc, Encode(9)));

    const auto entries = F().recorder->Get();
    zassert_equal(entries.size(), 1U);
    zassert_equal(entries[0].type, Type::Adc);
    zassert_equal(manager->Get()->device_id, 9U);
}

// rt_daq's `logging reapply-sensors` applies through the manager, not the service.
ZTEST(configuration_stored_handler, test_AnApplyThatBypassesTheServiceReportsItsType) {
    const auto manager = F().Register(Type::Sensors);

    zassert_true(manager->ApplyCborConfiguration(Encode(10)));

    const auto entries = F().recorder->Get();
    zassert_equal(entries.size(), 1U);
    zassert_equal(entries[0].type, Type::Sensors);
}

ZTEST(configuration_stored_handler, test_AnAdoptReportsItsType) {
    const auto manager = F().Register(Type::Ui);

    zassert_true(manager->AdoptForTest(11));

    const auto entries = F().recorder->Get();
    zassert_equal(entries.size(), 1U);
    zassert_equal(entries[0].type, Type::Ui);
    zassert_equal(manager->Get()->device_id, 11U);
}

ZTEST(configuration_stored_handler, test_UpdateOwnSettingStoresAndReportsNothing) {
    const auto manager = F().Register(Type::Display);

    zassert_true(manager->UpdateOwnSetting(TestConfiguration{ .device_id = 12 }));

    zassert_equal(manager->Get()->device_id, 12U, "The setting is stored");
    zassert_equal(F().recorder->Get().size(), 0U, "and no update is reported");

    // It is stored, not only held: a reload reads it.
    zassert_equal(manager->Get(true)->device_id, 12U);
}

ZTEST(configuration_stored_handler, test_ARejectedApplyReportsNothing) {
    const auto manager = F().Register();

    const std::vector<uint8_t> malformed = { 0xFF, 0x01, 0x02 };
    zassert_false(F().service->ApplyCborConfiguration(Type::System, malformed), "Malformed CBOR");

    char reason[64] = {};
    zassert_false(
        F().service->ApplyCborConfiguration(Type::System, Encode(REJECTED_DEVICE_ID), reason),
        "A configuration the manager's validator refuses"
    );

    zassert_equal(F().recorder->Get().size(), 0U, "A rejected write is not an update");
    zassert_equal(manager->Get()->device_id, 1U, "and the configuration is as it was");
}

ZTEST(configuration_stored_handler, test_LoadingAndTheDefaultReportNothing) {
    const auto manager = F().Register();

    zassert_not_null(manager->Get(true).get(), "The stored default loads");
    zassert_not_null(manager->Get().get());

    zassert_equal(
        F().recorder->Get().size(), 0U, "A load, and the default made while the manager was built, are no updates"
    );
}

ZTEST(configuration_stored_handler, test_TheSameBytesStoredAgainReportAgain) {
    const auto manager = F().Register();
    const auto bytes = Encode(5);

    zassert_true(manager->ApplyCborConfiguration(bytes));
    zassert_true(manager->ApplyCborConfiguration(bytes));

    zassert_equal(F().recorder->Get().size(), 2U, "Every successful store counts, even of unchanged bytes");
}

ZTEST(configuration_stored_handler, test_AManagerRegisteredAfterTheHandlerReports) {
    F().service->RegisterConfigurationStoredHandler(F().recorder->Handler());

    const auto manager = F().MakeManager();
    F().service->RegisterCborConfigurationManager(Type::LoggingControl, manager);

    zassert_true(manager->Update(TestConfiguration{ .device_id = 3 }));

    const auto entries = F().recorder->Get();
    zassert_equal(entries.size(), 1U);
    zassert_equal(entries[0].type, Type::LoggingControl);
}

ZTEST(configuration_stored_handler, test_ARefusedSecondManagerOfATypeIsNotWired) {
    const auto first = F().Register(Type::System);
    const auto second = F().MakeManager();
    F().service->RegisterCborConfigurationManager(Type::System, second);

    zassert_true(second->Update(TestConfiguration{ .device_id = 2 }));
    zassert_equal(F().recorder->Get().size(), 0U, "The service keeps the first manager, so the second reports nothing");

    zassert_true(first->Update(TestConfiguration{ .device_id = 4 }));
    zassert_equal(F().recorder->Get().size(), 1U);
}

ZTEST(configuration_stored_handler, test_AClearedHandlerIsNotCalledAndASecondReplacesTheFirst) {
    const auto manager = F().Register();
    const auto second = std::make_shared<Recorder>();

    F().service->RegisterConfigurationStoredHandler(second->Handler());
    zassert_true(manager->Update(TestConfiguration{ .device_id = 6 }));
    zassert_equal(F().recorder->Get().size(), 0U, "A second handler replaces the first");
    zassert_equal(second->Get().size(), 1U);

    F().service->RegisterConfigurationStoredHandler(nullptr);
    zassert_true(manager->Update(TestConfiguration{ .device_id = 8 }));
    zassert_equal(second->Get().size(), 1U, "and a cleared one is not called");
}

ZTEST(configuration_stored_handler, test_AHandlerThatThrowsDoesNotFailTheStore) {
    const auto manager = F().MakeManager();
    F().service->RegisterCborConfigurationManager(Type::System, manager);
    F().service->RegisterConfigurationStoredHandler([](Type) {
        throw std::runtime_error("The handler failed.");
    });

    zassert_true(
        manager->Update(TestConfiguration{ .device_id = 13 }),
        "The configuration is stored by then: the store must not turn into a failure a client retries"
    );
    zassert_equal(manager->Get()->device_id, 13U);

    zassert_true(F().service->ApplyCborConfiguration(Type::System, Encode(14)));
    zassert_equal(manager->Get()->device_id, 14U);
}

// A manager that is not registered reports to nobody: the gauge's System manager is such a one.
ZTEST(configuration_stored_handler, test_AManagerThatIsNotRegisteredReportsNothing) {
    F().service->RegisterConfigurationStoredHandler(F().recorder->Handler());

    const auto manager = F().MakeManager();
    zassert_true(manager->Update(TestConfiguration{ .device_id = 15 }));

    zassert_equal(F().recorder->Get().size(), 0U);
}

// The handler a manager holds reaches the service's slot, not the service.
ZTEST(configuration_stored_handler, test_AManagerThatOutlivesItsServiceStillStores) {
    const auto manager = F().Register();
    F().service->RegisterConfigurationStoredHandler(nullptr);
    F().service.reset();

    zassert_true(manager->Update(TestConfiguration{ .device_id = 16 }));
    zassert_equal(manager->Get()->device_id, 16U);
}

// A preview shows a configuration and keeps none: it is checked as an upload is, and stores nothing.
ZTEST(configuration_stored_handler, test_AParseReturnsTheModelAndLeavesEverythingAsItWas) {
    const auto manager = F().Register(Type::Ui);
    zassert_true(manager->Update(TestConfiguration{ .device_id = 40 }));
    F().recorder->entries.clear();

    const auto stored_info = manager->GetCborConfigurationInfo();
    const auto stored_bytes = manager->GetCborConfiguration();
    zassert_true(stored_info.size > 0);

    char reason[64] = {};
    const auto parsed = manager->ParseCborConfiguration(Encode(41, 2), reason);

    zassert_not_null(parsed.get());
    zassert_equal(parsed->device_id, 41U);
    zassert_equal(parsed->build_number, 2U);

    const auto info = manager->GetCborConfigurationInfo();
    zassert_equal(info.size, stored_info.size, "The stored file's size is as it was");
    zassert_equal(info.crc, stored_info.crc, "and its CRC");
    zassert_true(manager->GetCborConfiguration() == stored_bytes, "and its bytes");
    zassert_equal(manager->Get()->device_id, 40U, "The configuration in effect stays");
    zassert_equal(F().recorder->Get().size(), 0U, "No stored handler is called");
}

ZTEST(configuration_stored_handler, test_AParseRefusesWhatAnApplyRefusesWithTheSameReason) {
    const auto manager = F().Register(Type::Ui);
    const auto stored_info = manager->GetCborConfigurationInfo();

    char parse_reason[64] = {};
    char apply_reason[64] = {};
    const std::vector<uint8_t> malformed = { 0xFF, 0x01, 0x02 };

    zassert_is_null(manager->ParseCborConfiguration(malformed, parse_reason).get());
    zassert_false(manager->ApplyCborConfiguration(malformed, apply_reason));
    zassert_equal(std::string(parse_reason), std::string(apply_reason));
    zassert_equal(std::string(parse_reason), "Malformed CBOR");

    parse_reason[0] = '\0';
    apply_reason[0] = '\0';
    zassert_is_null(manager->ParseCborConfiguration(Encode(REJECTED_DEVICE_ID), parse_reason).get());
    zassert_false(manager->ApplyCborConfiguration(Encode(REJECTED_DEVICE_ID), apply_reason));
    zassert_equal(std::string(parse_reason), "The device ID is refused.");
    zassert_equal(std::string(parse_reason), std::string(apply_reason));

    zassert_equal(manager->GetCborConfigurationInfo().crc, stored_info.crc, "Nothing was stored");
    zassert_equal(F().recorder->Get().size(), 0U);
}

// What a preview accepts a store of the same bytes then stores, and reports.
ZTEST(configuration_stored_handler, test_WhatAParseAcceptsAnApplyStores) {
    const auto manager = F().Register(Type::Ui);
    const auto bytes = Encode(50);

    zassert_not_null(manager->ParseCborConfiguration(bytes, {}).get());
    zassert_equal(F().recorder->Get().size(), 0U);

    zassert_true(manager->ApplyCborConfiguration(bytes));
    zassert_equal(manager->Get()->device_id, 50U);
    zassert_equal(F().recorder->Get().size(), 1U);
}
```
