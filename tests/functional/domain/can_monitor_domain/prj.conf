## CMakeLists.txt
```
cmake_minimum_required(VERSION 3.20.0)

set(RT_CORE_TEST_SIM_FLASH ON)
# Two CAN controllers on every board: can0, which the stored configuration runs, and can1, which it doesn't.
list(APPEND EXTRA_DTC_OVERLAY_FILE "${CMAKE_CURRENT_SOURCE_DIR}/can_monitor.overlay")
# Transmit and replay, unless the scenario without them says so.
if(NOT RT_CORE_NO_TX)
    list(APPEND EXTRA_CONF_FILE "${CMAKE_CURRENT_SOURCE_DIR}/tx.conf")
endif()

include(${CMAKE_CURRENT_SOURCE_DIR}/../../../rt_core_test.cmake)

find_package(Zephyr REQUIRED HINTS $ENV{ZEPHYR_BASE})
project(functional_can_monitor_domain)

file(GLOB_RECURSE TEST_SOURCES src/*.c src/*.cpp)

target_sources(app PRIVATE ${TEST_SOURCES})

# The test client injects requests with smp_rx_req().
target_include_directories(app PRIVATE
  ${RT_CORE_DIR}/tests/common
  ${ZEPHYR_BASE}/subsys/mgmt/mcumgr/transport/include
)
```

## Kconfig
```
menu "Zephyr"
source "Kconfig.zephyr"
endmenu

config EERIE_LEAP_HW_VERSION_MAJOR
        int "Hardware version major"
        range 0 255
        default 0

config EERIE_LEAP_HW_VERSION_MINOR
        int "Hardware version minor"
        range 0 255
        default 0

config EERIE_LEAP_HW_VERSION_PATCH
        int "Hardware version patch"
        range 0 65535
        default 0

config EERIE_LEAP_SW_VERSION_MAJOR
        int "Software version major"
        range 0 255
        default 0

config EERIE_LEAP_SW_VERSION_MINOR
        int "Software version minor"
        range 0 255
        default 0

config EERIE_LEAP_SW_VERSION_PATCH
        int "Software version patch"
        range 0 65535
        default 0

config EERIE_LEAP_SW_VERSION_BUILD
        int "Software build number"
        range 0 255
        default 0

config EERIE_LEAP_ADC_VOLTAGE_MAX_MV
        int "ADC voltage max"
        default 3100

config EERIE_LEAP_SENSOR_VOLTAGE_MAX_MV
        int "Sensor voltage max"
        default 5000

config EERIE_LEAP_CANBUS_AUTO_DETECT_INTERVAL_MS
        int "Canbus auto detect activity check interval ms"
        default 5000

config EERIE_LEAP_FS_SD_THREAD_STACK_SIZE
        int "SD thread stack size"
        default 3072

config EERIE_LEAP_SD_CHECK_INTERVAL_MS
        int "SD check interval ms"
        default 1000
```

## prj.conf
```kconfig
CONFIG_ZTEST=y

# Language and Compiler
CONFIG_CPP=y
CONFIG_PICOLIBC=y
CONFIG_STD_CPP23=y
CONFIG_REQUIRES_FULL_LIBCPP=y
CONFIG_CPP_EXCEPTIONS=y
CONFIG_CPP_RTTI=y

# Memory: two rings, the notifications the fake keeps, and the threads' stacks.
CONFIG_HEAP_MEM_POOL_SIZE=200000

# C++ exception unwinding needs considerably more stack than the ztest defaults.
CONFIG_MAIN_STACK_SIZE=8192
CONFIG_ZTEST_STACK_SIZE=12288

# Logging And Debugging
CONFIG_LOG=y
CONFIG_TEST_RANDOM_GENERATOR=y
CONFIG_THREAD_NAME=y

# ThreadBase::InitializeStack() falls back to k_thread_stack_alloc() for the CAN, sender and source threads.
CONFIG_THREAD_STACK_INFO=y
CONFIG_DYNAMIC_THREAD=y
CONFIG_DYNAMIC_THREAD_ALLOC=y

# FS Config
CONFIG_FLASH=y
CONFIG_FLASH_MAP=y
CONFIG_FILE_SYSTEM=y
CONFIG_FILE_SYSTEM_LITTLEFS=y
CONFIG_FILE_SYSTEM_MKFS=y

CONFIG_ZCBOR=y

CONFIG_CRC=y

# CANBus: the tap's two accept-all filters and a consumer's, on each of the two controllers.
CONFIG_CAN=y
CONFIG_CAN_FD_MODE=y
CONFIG_CAN_LOOPBACK=y
CONFIG_CAN_LOOPBACK_MAX_FILTERS=16
CONFIG_CAN_ACCEPT_RTR=y

# The 512 byte default overflows on the 64-bit QEMU targets.
CONFIG_CAN_LOOPBACK_TX_THREAD_STACK_SIZE=2048

CONFIG_EERIE_LEAP_RT_CORE=y
CONFIG_EERIE_LEAP_CONFIGURATION=y
CONFIG_EERIE_LEAP_CANBUS=y
CONFIG_EERIE_LEAP_DEVICE_TREE=y
CONFIG_EERIE_LEAP_FS=y
CONFIG_EERIE_LEAP_LUA_SCRIPT=y
CONFIG_EERIE_LEAP_EXPRESSION_ENGINE=y
CONFIG_EERIE_LEAP_RANDOM=y
CONFIG_EERIE_LEAP_THREADING=y
CONFIG_EERIE_LEAP_SMP=y

CONFIG_EERIE_LEAP_DOMAIN_CANBUS=y
CONFIG_EERIE_LEAP_DOMAIN_SCRIPT=y
CONFIG_EERIE_LEAP_DOMAIN_CAN_MONITOR=y

# A small ring, so that a stalled link overflows it quickly.
CONFIG_EERIE_LEAP_CAN_MONITOR_RING_SIZE=16384
CONFIG_EERIE_LEAP_CAN_MONITOR_SYNTHETIC=y

# The sender catches and throws; the unwinder needs a DWARF-sized stack on the 64-bit and MIPS targets.
CONFIG_EERIE_LEAP_CAN_MONITOR_SENDER_STACK_SIZE=10240

# OPEN allocates the ring, sets the tap and builds the session on the MCUmgr work queue; with the unwinder's frames
# on the 64-bit and MIPS targets that is more than the default 2 KiB.
CONFIG_MCUMGR_TRANSPORT_WORKQUEUE_STACK_SIZE=8192

# Changed-bytes records, which OPEN's `delta` asks for.
CONFIG_EERIE_LEAP_CAN_MONITOR_DELTA=y

# A lapsed lease ends the session. The suite's longer tests renew it (Harness::Sleep()); the lease tests wait it out.
CONFIG_EERIE_LEAP_CAN_MONITOR_LEASE_MS=4000

# Ends the sessions of a lapsed lease and of a lost connection, stopping the buses they own.
CONFIG_EERIE_LEAP_CAN_MONITOR_WORK_QUEUE_STACK_SIZE=6144

# A bus of its own that detects its bitrate sleeps this long between rounds; closing the session waits for it.
CONFIG_EERIE_LEAP_CANBUS_AUTO_DETECT_INTERVAL_MS=300
```

## tx.conf
```kconfig
# Transmit and replay, which the default scenario has and functional.can_monitor_domain.no_tx leaves out.
CONFIG_EERIE_LEAP_CAN_MONITOR_TX=y

# A small replay buffer, so that a chunk too large for it is easy to make.
CONFIG_EERIE_LEAP_CAN_MONITOR_REPLAY_BUFFER_SIZE=2048
```

## can_monitor.overlay
```dts
/ {
        aliases {
                can0 = &can_loopback0;
                can1 = &can_loopback1;
        };

        can_loopback0: can_loopback0 {
                status = "okay";
                compatible = "zephyr,can-loopback";
        };

        can_loopback1: can_loopback1 {
                status = "okay";
                compatible = "zephyr,can-loopback";
        };
};
```

## src/can_monitor_group.cpp
```c
#include <array>
#include <utility>
#include <vector>

#include <zephyr/mgmt/mcumgr/mgmt/mgmt_defines.h>
#include <zephyr/ztest.h>

#include "can_monitor_test_support.h"
#include "domain/can_monitor_domain/smp/can_monitor_mgmt_group.h"
#include "smp_test_client.h"

using namespace can_monitor_test;
using namespace smp_test;

using eerie_leap::domain::can_monitor_domain::smp::CanMonitorMgmtGroup;
using eerie_leap::subsys::canbus::CanId;

using Command = CanMonitorMgmtGroup::Command;

namespace {

constexpr SmpGroupId GROUP = SmpGroupId::CAN_MONITOR;

constexpr uint8_t Id(Command command) {
    return std::to_underlying(command);
}

// The unit, its group and a client; the client goes first, then the group, then the unit.
struct GroupHarness {
    Harness harness;
    CanMonitorMgmtGroup group{ harness.service };
    SmpTestClient client;

    GroupHarness() {
        group.Register();
    }

    Response Open(const Bytes& body) {
        return client.Write(GROUP, Id(Command::OPEN), body);
    }

    Response OpenTap(uint32_t channel = CONFIGURED_PORT, uint32_t mode = 0) {
        return Open(OpenBody().Put("ch", channel).Put("mode", mode).Build());
    }

    Response Close(uint32_t token) {
        return client.Write(GROUP, Id(Command::CLOSE), CborMap().Put("tok", token).Build());
    }
};

void ExpectGroupError(const Response& response, CanMonitorError error) {
    zassert_true(response.error.has_value(), "Expected a group error");
    zassert_equal(response.error_group.value(), std::to_underlying(GROUP));
    zassert_equal(response.error.value(), std::to_underlying(error));
}

} // namespace

ZTEST_SUITE(can_monitor_group, NULL, NULL, NULL, ResetControllers, NULL);

ZTEST(can_monitor_group, test_open_and_close_answer_with_the_session) {
    GroupHarness unit;

    const auto opened = unit.OpenTap();
    zassert_true(opened.IsOk());
    zassert_not_equal(opened.Value("tok"), 0U);
    zassert_equal(opened.Value("ch"), CONFIGURED_PORT);
    zassert_equal(opened.Value("mode"), 0U);
    zassert_equal(opened.Value("type"), 1U, "A classical channel");
    zassert_equal(opened.Value("bitrate"), 500000U);
    zassert_equal(opened.Value("data_bitrate"), 0U);
    zassert_equal(opened.Value("lease_ms"), static_cast<uint32_t>(CONFIG_EERIE_LEAP_CAN_MONITOR_LEASE_MS));
    zassert_equal(unit.harness.service->GetSessionCount(), 1U);
    zassert_equal(unit.harness.holds.load(), 1);

    const auto closed = unit.Close(opened.Value("tok"));
    zassert_true(closed.IsOk());
    zassert_equal(unit.harness.service->GetSessionCount(), 0U);
    zassert_true(
        WaitUntil([&] {
            return unit.harness.releases.load() == 1;
        }),
        "The fast link is released with the end record"
    );

    // The port is free again.
    zassert_true(unit.OpenTap().IsOk());
}

ZTEST(can_monitor_group, test_a_synthetic_session_states_port_255_and_streams) {
    GroupHarness unit;

    // `ch` and `mode` are ignored with `synthetic`.
    const auto opened = unit.Open(OpenBody().Put("ch", 7).Put("mode", 2).PutSynthetic(100, 2, 4, false, false).Build());
    zassert_true(opened.IsOk());
    zassert_equal(opened.Value("ch"), CAN_MONITOR_SYNTHETIC_PORT);
    zassert_equal(opened.Value("mode"), 0U);
    zassert_equal(opened.Value("type"), 0U);
    zassert_equal(opened.Value("bitrate"), 0U);
    zassert_equal(opened.Value("data_bitrate"), 0U);

    zassert_true(WaitUntil([&] {
        return unit.harness.notifier->Count() >= 1;
    }));
    const auto notifications = DecodeAll(unit.harness.notifier->Notifications());
    zassert_equal(notifications[0].port, CAN_SYNTHETIC_PORT);

    zassert_true(unit.Close(opened.Value("tok")).IsOk());
    zassert_true(WaitUntil([&] {
        unit.harness.service->OnNotificationSent();
        return unit.harness.HasEnded();
    }));
}

ZTEST(can_monitor_group, test_a_port_with_a_session_is_busy) {
    GroupHarness unit;
    const auto opened = unit.OpenTap();
    zassert_true(opened.IsOk());

    // Another request for the port is not the same OPEN again.
    const auto busy = unit.Open(OpenBody().Put("ch", CONFIGURED_PORT).Put("mode", 0).Put("type", 2).Build());
    ExpectGroupError(busy, CanMonitorError::BUSY);
    zassert_equal(unit.harness.service->GetSessionCount(), 1U);
}

ZTEST(can_monitor_group, test_a_lost_answer_gets_the_same_token_again) {
    GroupHarness unit;

    const auto first = unit.OpenTap();
    const auto again = unit.OpenTap();

    zassert_true(first.IsOk());
    zassert_true(again.IsOk());
    zassert_equal(again.Value("tok"), first.Value("tok"));
    zassert_equal(unit.harness.service->GetSessionCount(), 1U, "No second session");
    zassert_equal(unit.harness.holds.load(), 1, "Held once");

    // The same holds for a synthetic session.
    const Bytes synthetic = OpenBody().PutSynthetic(50, 2, 2, false, false).Build();
    const auto synthetic_first = unit.Open(synthetic);
    const auto synthetic_again = unit.Open(synthetic);
    zassert_true(synthetic_first.IsOk());
    zassert_equal(synthetic_again.Value("tok"), synthetic_first.Value("tok"));
    zassert_not_equal(synthetic_first.Value("tok"), first.Value("tok"));
    zassert_equal(unit.harness.service->GetSessionCount(), 2U);
}

ZTEST(can_monitor_group, test_unknown_ports_and_modes_the_port_cannot_take) {
    GroupHarness unit;

    // A port the devicetree has no alias for.
    ExpectGroupError(unit.OpenTap(5), CanMonitorError::NOT_FOUND);

    // TAP is for a channel the configuration runs; can1 is not run.
    ExpectGroupError(unit.OpenTap(UNCONFIGURED_PORT), CanMonitorError::BAD_MODE);

    // LISTEN_ONLY and ACTIVE are for a port the configuration doesn't run; can0 is run. And a mode nobody knows.
    ExpectGroupError(unit.OpenTap(CONFIGURED_PORT, 1), CanMonitorError::BAD_MODE);
    ExpectGroupError(unit.OpenTap(CONFIGURED_PORT, 2), CanMonitorError::BAD_MODE);
    ExpectGroupError(unit.OpenTap(CONFIGURED_PORT, 7), CanMonitorError::BAD_MODE);
    ExpectGroupError(unit.OpenTap(UNCONFIGURED_PORT, 7), CanMonitorError::BAD_MODE);

    zassert_equal(unit.harness.service->GetSessionCount(), 0U);
    zassert_equal(unit.harness.holds.load(), 0);
}

ZTEST(can_monitor_group, test_open_needs_a_central_listening_on_bus) {
    GroupHarness unit;
    unit.harness.notifier->SetMaxSize(0);

    ExpectGroupError(unit.OpenTap(), CanMonitorError::NOT_LISTENING);
    ExpectGroupError(
        unit.Open(OpenBody().PutSynthetic(10, 1, 1, false, false).Build()), CanMonitorError::NOT_LISTENING
    );
    zassert_equal(unit.harness.service->GetSessionCount(), 0U);
}

ZTEST(can_monitor_group, test_close_names_what_is_wrong_with_the_token) {
    GroupHarness unit;
    const auto opened = unit.OpenTap();
    const uint32_t token = opened.Value("tok");

    ExpectGroupError(unit.Close(0), CanMonitorError::BAD_TOKEN);
    ExpectGroupError(unit.Close(token + 1), CanMonitorError::NO_SESSION);
    zassert_equal(unit.harness.service->GetSessionCount(), 1U, "Nothing was closed");

    zassert_true(unit.Close(token).IsOk());
    ExpectGroupError(unit.Close(token), CanMonitorError::NO_SESSION);

    // A request with no token at all is malformed.
    zassert_equal(unit.client.Write(GROUP, Id(Command::CLOSE), CborMap().Build()).Value("rc"), MGMT_ERR_EINVAL);
}

ZTEST(can_monitor_group, test_malformed_requests_are_invalid) {
    GroupHarness unit;

    // No port, no mode.
    zassert_equal(unit.Open(OpenBody().Put("mode", 0).Build()).Value("rc"), MGMT_ERR_EINVAL);
    zassert_equal(unit.Open(OpenBody().Put("ch", 0).Build()).Value("rc"), MGMT_ERR_EINVAL);
    // A channel that is no byte; a type nobody has.
    zassert_equal(unit.Open(OpenBody().Put("ch", 300).Put("mode", 0).Build()).Value("rc"), MGMT_ERR_EINVAL);
    zassert_equal(
        unit.Open(OpenBody().Put("ch", 0).Put("mode", 0).Put("type", 9).Build()).Value("rc"), MGMT_ERR_EINVAL
    );
    // Synthetic parameters that can't be generated, or are missing.
    zassert_equal(unit.Open(OpenBody().PutSynthetic(0, 2, 4, false, false).Build()).Value("rc"), MGMT_ERR_EINVAL);
    zassert_equal(unit.Open(OpenBody().PutSynthetic(10, 2, 9, false, false).Build()).Value("rc"), MGMT_ERR_EINVAL);

    // More filters than a session takes.
    std::vector<OpenBody::FilterSpec> filters(CONFIG_EERIE_LEAP_CAN_MONITOR_MAX_FILTERS + 1);
    zassert_equal(
        unit.Open(OpenBody().Put("ch", 0).Put("mode", 0).PutFilters(filters).Build()).Value("rc"), MGMT_ERR_EINVAL
    );

    zassert_equal(unit.harness.service->GetSessionCount(), 0U);
}

ZTEST(can_monitor_group, test_filters_of_open_are_applied_to_the_stream) {
    GroupHarness unit;
    Canbus& bus = *unit.harness.Bus();

    constexpr std::array<OpenBody::FilterSpec, 2> FILTERS = {
        OpenBody::FilterSpec{ 0x200, 0x7FF, false },
        OpenBody::FilterSpec{ 0x18DA0000, 0x1FFF0000, true },
    };
    const auto opened = unit.Open(OpenBody().Put("ch", 0).Put("mode", 0).PutFilters(FILTERS).Build());
    zassert_true(opened.IsOk());

    const std::array<uint8_t, 1> payload = { 0x42 };
    zassert_ok(bus.SendFrame(CanId::Standard(0x123), payload));
    zassert_ok(bus.SendFrame(CanId::Standard(0x200), payload));
    zassert_ok(bus.SendFrame(CanId::Extended(0x18DA1234), payload));
    // Extended with the same low bits as a filter's standard id: IDE decides.
    zassert_ok(bus.SendFrame(CanId::Extended(0x200), payload));

    // Two frames pass, each twice (received and echoed).
    zassert_true(WaitUntil([&] {
        const auto last = unit.harness.notifier->Notifications();
        size_t frames = 0;
        for(const SentNotification& sent : last) {
            const auto decoded = DecodeNotification(sent);
            frames += decoded ? RecordsOf({ *decoded }, CanRecordKind::FRAME).size() : 0;
        }
        return frames >= 4;
    }));
    k_msleep(100);
    unit.harness.CloseAndDrain(opened.Value("tok"));

    const auto notifications = DecodeAll(unit.harness.notifier->Notifications());
    const auto frames = RecordsOf(notifications, CanRecordKind::FRAME);
    zassert_equal(frames.size(), 4U);
    for(const DecodedRecord* frame : frames) {
        const bool passes = (!frame->record.ide && frame->record.id == 0x200)
            || (frame->record.ide && frame->record.id == 0x18DA1234);
        zassert_true(passes, "Frame 0x%x passed the filter", frame->record.id);
    }

    const CanStatistics sum = SumStatistics(notifications);
    zassert_equal(sum.filtered, 4U, "0x123 and the extended 0x200, each twice");
    zassert_equal(sum.frames_received, 4U);
    zassert_equal(sum.frames_sent, 4U);
}
```

## src/can_monitor_status_client.h
```c
#pragma once

#include <array>
#include <cstdint>
#include <optional>
#include <span>
#include <string>
#include <string_view>
#include <vector>

#include <mgmt/mcumgr/transport/smp_internal.h>
#include <zcbor_decode.h>
#include <zephyr/kernel.h>
#include <zephyr/mgmt/mcumgr/transport/smp.h>
#include <zephyr/net_buf.h>
#include <zephyr/ztest.h>

#include "subsys/smp/smp_group_id.h"
#include "subsys/smp/smp_header.h"

// STATUS answers a list of maps that hold a list of numbers, which the common SMP test client does not decode.
// This client sends a request as it does and hands back the raw answer, which StatusView reads.
namespace can_monitor_test {

using eerie_leap::subsys::smp::SmpGroupId;
using eerie_leap::subsys::smp::SmpHeader;
using eerie_leap::subsys::smp::SmpOperation;

struct StatusPort {
    uint32_t ch = 0;
    std::vector<uint32_t> types;
    bool is_configured = false;
    uint32_t state = 0;
    uint32_t bitrate = 0;
    uint32_t data_bitrate = 0;
    bool has_session = false;
};

/** @brief STATUS's answer, decoded. */
struct StatusView {
    uint32_t version = 0;
    std::vector<StatusPort> ports;
    uint32_t filters_max = 0;
    uint32_t ring_bytes = 0;
    uint32_t notify_max = 0;
    bool has_tx = false;
    bool has_synthetic = false;
    bool has_delta = false;

    [[nodiscard]] const StatusPort* Port(uint32_t ch) const {
        for(const StatusPort& port : ports) {
            if(port.ch == ch)
                return &port;
        }

        return nullptr;
    }
};

inline bool KeyIs(const zcbor_string& key, std::string_view name) {
    // NOLINTNEXTLINE(cppcoreguidelines-pro-type-reinterpret-cast): zcbor hands out text as bytes
    return std::string_view(reinterpret_cast<const char*>(key.value), key.len) == name;
}

inline bool DecodePort(zcbor_state_t* zsd, StatusPort& port) {
    if(!zcbor_map_start_decode(zsd))
        return false;

    while(!zcbor_array_at_end(zsd)) {
        zcbor_string key{};
        if(!zcbor_tstr_decode(zsd, &key))
            return false;

        bool ok = false;
        if(KeyIs(key, "ch")) {
            ok = zcbor_uint32_decode(zsd, &port.ch);
        } else if(KeyIs(key, "types")) {
            ok = zcbor_list_start_decode(zsd);
            while(ok && !zcbor_array_at_end(zsd)) {
                uint32_t type = 0;
                ok = zcbor_uint32_decode(zsd, &type);
                port.types.push_back(type);
            }
            ok = ok && zcbor_list_end_decode(zsd);
        } else if(KeyIs(key, "configured")) {
            ok = zcbor_bool_decode(zsd, &port.is_configured);
        } else if(KeyIs(key, "state")) {
            ok = zcbor_uint32_decode(zsd, &port.state);
        } else if(KeyIs(key, "bitrate")) {
            ok = zcbor_uint32_decode(zsd, &port.bitrate);
        } else if(KeyIs(key, "data_bitrate")) {
            ok = zcbor_uint32_decode(zsd, &port.data_bitrate);
        } else if(KeyIs(key, "session")) {
            ok = zcbor_bool_decode(zsd, &port.has_session);
        } else {
            ok = zcbor_any_skip(zsd, nullptr);
        }

        if(!ok)
            return false;
    }

    return zcbor_map_end_decode(zsd);
}

inline std::optional<StatusView> DecodeStatus(std::span<const uint8_t> body) {
    ZCBOR_STATE_D(zsd, 6, body.data(), body.size(), 1, 0);

    StatusView view;
    if(!zcbor_map_start_decode(zsd))
        return std::nullopt;

    while(!zcbor_array_at_end(zsd)) {
        zcbor_string key{};
        if(!zcbor_tstr_decode(zsd, &key))
            return std::nullopt;

        bool ok = false;
        if(KeyIs(key, "version")) {
            ok = zcbor_uint32_decode(zsd, &view.version);
        } else if(KeyIs(key, "ports")) {
            ok = zcbor_list_start_decode(zsd);
            while(ok && !zcbor_array_at_end(zsd)) {
                StatusPort port;
                ok = DecodePort(zsd, port);
                view.ports.push_back(std::move(port));
            }
            ok = ok && zcbor_list_end_decode(zsd);
        } else if(KeyIs(key, "filters_max")) {
            ok = zcbor_uint32_decode(zsd, &view.filters_max);
        } else if(KeyIs(key, "ring_bytes")) {
            ok = zcbor_uint32_decode(zsd, &view.ring_bytes);
        } else if(KeyIs(key, "notify_max")) {
            ok = zcbor_uint32_decode(zsd, &view.notify_max);
        } else if(KeyIs(key, "tx")) {
            ok = zcbor_bool_decode(zsd, &view.has_tx);
        } else if(KeyIs(key, "synthetic")) {
            ok = zcbor_bool_decode(zsd, &view.has_synthetic);
        } else if(KeyIs(key, "delta")) {
            ok = zcbor_bool_decode(zsd, &view.has_delta);
        } else {
            ok = zcbor_any_skip(zsd, nullptr);
        }

        if(!ok)
            return std::nullopt;
    }

    if(!zcbor_map_end_decode(zsd))
        return std::nullopt;

    return view;
}

/** @brief Sends a read to MCUmgr as a client on a test transport and returns the body of the answer. */
class RawSmpClient {
private:
    static inline RawSmpClient* instance = nullptr;

    smp_transport transport_{};
    k_sem received_{};
    k_mutex lock_{};
    std::vector<uint8_t> response_;
    uint8_t sequence_ = 0;

    static int Output(net_buf* packet) {
        RawSmpClient* client = instance;
        if(client != nullptr) {
            k_mutex_lock(&client->lock_, K_FOREVER);
            client->response_.assign(packet->data, packet->data + packet->len);
            k_mutex_unlock(&client->lock_);
            k_sem_give(&client->received_);
        }

        smp_packet_free(packet);

        return 0;
    }

public:
    RawSmpClient() {
        k_sem_init(&received_, 0, 1);
        k_mutex_init(&lock_);
        transport_.functions.output = Output;
        zassert_equal(smp_transport_init(&transport_), 0);
        instance = this;
    }

    RawSmpClient(const RawSmpClient&) = delete;
    RawSmpClient& operator=(const RawSmpClient&) = delete;
    RawSmpClient(RawSmpClient&&) = delete;
    RawSmpClient& operator=(RawSmpClient&&) = delete;

    ~RawSmpClient() {
        k_work_sync sync{};
        k_work_cancel_sync(&transport_.work, &sync);
        instance = nullptr;
    }

    /** @return The CBOR body of the answer; nothing when none came or it is not the answer to this request. */
    std::optional<std::vector<uint8_t>>
    Read(SmpGroupId group, uint8_t command, const std::vector<uint8_t>& body = { 0xA0 }) {
        net_buf* packet = smp_packet_alloc();
        zassert_not_null(packet, "SMP pool exhausted");

        const SmpHeader header{
            .operation = SmpOperation::READ,
            .version = 1,
            .length = static_cast<uint16_t>(body.size()),
            .group = std::to_underlying(group),
            .sequence = ++sequence_,
            .command_id = command,
        };
        std::array<uint8_t, SmpHeader::SIZE> raw_header{};
        header.Encode(raw_header);
        net_buf_add_mem(packet, raw_header.data(), raw_header.size());
        net_buf_add_mem(packet, body.data(), body.size());

        smp_rx_req(&transport_, packet);

        if(k_sem_take(&received_, K_MSEC(2000)) != 0)
            return std::nullopt;

        k_mutex_lock(&lock_, K_FOREVER);
        const std::vector<uint8_t> raw = response_;
        k_mutex_unlock(&lock_);

        const auto response_header = SmpHeader::Parse(raw);
        if(!response_header.has_value() || response_header->sequence != header.sequence)
            return std::nullopt;

        return std::vector<uint8_t>(raw.begin() + SmpHeader::SIZE, raw.end());
    }
};

} // namespace can_monitor_test
```

## src/can_monitor_stream.cpp
```c
#include <cerrno>

#include <zephyr/ztest.h>

#include "can_monitor_test_support.h"

using namespace can_monitor_test;

namespace {

/// The frames of the stream, in order.
std::vector<const DecodedRecord*> FramesOf(const std::vector<DecodedNotification>& notifications) {
    return RecordsOf(notifications, CanRecordKind::FRAME);
}

} // namespace

ZTEST_SUITE(can_monitor_stream, NULL, NULL, NULL, ResetControllers, NULL);

ZTEST(can_monitor_stream, test_notifications_hold_whole_records_and_chain_back_to_the_frames) {
    Harness harness;
    constexpr uint32_t FPS = 2000;
    constexpr uint32_t IDS = 4;

    const uint64_t before_us = NowUs();
    const auto answer = harness.OpenSynthetic(FPS, IDS);
    const uint64_t after_us = NowUs();

    k_msleep(400);
    harness.CloseAndDrain(answer.tok);

    const auto sent = harness.notifier->Notifications();
    zassert_true(sent.size() > 2, "A stream of several notifications");
    for(const SentNotification& notification : sent) {
        zassert_true(notification.data.size() <= NOTIFY_MAX, "A notification of %zu bytes", notification.data.size());
        zassert_equal(notification.data[1], CAN_SYNTHETIC_PORT);
    }

    // The first `base_us` is the OPEN's time.
    const uint64_t first_base_us = sys_get_le64(&sent[0].data[4]);
    zassert_true(first_base_us >= before_us && first_base_us <= after_us);

    // Every frame of the generator, in order, at a time that never goes back; seq and base_us chain (WalkStream).
    size_t frames = 0;
    uint64_t last_time_us = first_base_us;
    WalkStream(sent, [&](const CanRecord& record, uint64_t time_us) {
        zassert_true(time_us >= last_time_us);
        last_time_us = time_us;

        if(record.kind != CanRecordKind::FRAME)
            return;

        zassert_equal(record.id, static_cast<uint32_t>(frames % IDS));
        zassert_equal(record.dlc, 8);
        zassert_false(record.ide || record.fdf || record.brs || record.rtr || record.tx);
        zassert_equal(record.payload.size(), 8U);
        for(size_t k = 0; k < 8; ++k)
            zassert_equal(
                record.payload[k], CanSyntheticSource::PayloadByte(frames, k), "Byte %zu of frame %zu", k, frames
            );

        ++frames;
    });

    zassert_true(frames > 300, "Frames came: %zu", frames);
    // The last frame was generated before CLOSE returned.
    zassert_true(last_time_us <= NowUs());
}

ZTEST(can_monitor_stream, test_at_most_four_notifications_wait_for_their_completion) {
    Harness harness;
    harness.is_auto_complete = false;

    const auto answer = harness.OpenSynthetic(5000, 8);

    zassert_true(WaitUntil([&] {
        return harness.notifier->Count() >= CONFIG_EERIE_LEAP_CAN_MONITOR_IN_FLIGHT;
    }));
    k_msleep(300);

    zassert_equal(harness.notifier->Count(), CONFIG_EERIE_LEAP_CAN_MONITOR_IN_FLIGHT, "No fifth one goes");
    zassert_equal(harness.service->GetInFlight(), CONFIG_EERIE_LEAP_CAN_MONITOR_IN_FLIGHT);

    // A full notification waits for nothing: these left because they filled up.
    for(const SentNotification& sent : harness.notifier->Notifications()) {
        zassert_true(sent.data.size() <= NOTIFY_MAX);
        zassert_true(sent.data.size() + CAN_MAX_RECORD_SIZE > NOTIFY_MAX, "Full: %zu bytes", sent.data.size());
    }

    // One completion lets exactly one more go.
    harness.service->OnNotificationSent();
    zassert_true(WaitUntil([&] {
        return harness.notifier->Count() == CONFIG_EERIE_LEAP_CAN_MONITOR_IN_FLIGHT + 1;
    }));
    k_msleep(100);
    zassert_equal(harness.notifier->Count(), CONFIG_EERIE_LEAP_CAN_MONITOR_IN_FLIGHT + 1);

    // The ring was overrun meanwhile; the stream still chains.
    harness.CloseAndDrain(answer.tok);
    const StreamSummary summary = Summarize(harness.notifier->Notifications());
    zassert_true(summary.gaps > 0);
    zassert_true(summary.largest_notification <= NOTIFY_MAX);
}

ZTEST(can_monitor_stream, test_a_lone_record_leaves_after_the_flush_time) {
    Harness harness;

    const int64_t opened_ms = k_uptime_get();
    const auto answer = harness.OpenSynthetic(1, 1, 2);

    zassert_true(WaitUntil([&] {
        return harness.notifier->Count() >= 1;
    }));

    const auto notifications = DecodeAll(harness.notifier->Notifications());
    const int64_t waited_ms = notifications[0].time_ms - opened_ms;

    // Held for the flush time, give or take the clock and the scheduler; QEMU is slow, so the upper bound is wide.
    zassert_true(waited_ms >= static_cast<int64_t>(FLUSH_MS) - 10, "Left after %d ms", static_cast<int>(waited_ms));
    zassert_true(waited_ms <= static_cast<int64_t>(FLUSH_MS) + 500, "Left after %d ms", static_cast<int>(waited_ms));
    zassert_equal(FramesOf(notifications).size(), 1);
    zassert_equal(notifications[0].sequence, 0);

    harness.CloseAndDrain(answer.tok);
}

ZTEST(can_monitor_stream, test_statistics_come_each_second_and_add_up) {
    Harness harness;

    const auto answer = harness.OpenSynthetic(100, 2, 4);
    harness.Sleep(answer.tok, 2600);
    harness.CloseAndDrain(answer.tok);

    const auto notifications = DecodeAll(harness.notifier->Notifications());
    ExpectChain(notifications);

    const auto statistics = RecordsOf(notifications, CanRecordKind::STATISTICS);
    // One at about 1 s, one at about 2 s, and the final one.
    zassert_true(statistics.size() >= 3, "Statistics records: %zu", statistics.size());

    // The first full second holds about a second of frames.
    const uint64_t first = statistics[0]->record.statistics.frames_received;
    zassert_true(first >= 50 && first <= 150, "Frames in the first second: %u", static_cast<unsigned>(first));

    // Sender records take no time of their own.
    for(const DecodedNotification& notification : notifications) {
        for(size_t i = 0; i < notification.records.size(); ++i) {
            if(notification.records[i].record.kind != CanRecordKind::STATISTICS)
                continue;

            const uint64_t before = i > 0 ? notification.records[i - 1].time_us : notification.base_us;
            zassert_equal(notification.records[i].time_us, before);
        }
    }

    // What the records add up to is what the stream holds.
    const CanStatistics sum = SumStatistics(notifications);
    zassert_equal(sum.frames_received, FramesOf(notifications).size());
    zassert_equal(sum.frames_sent, 0);
    zassert_equal(sum.busy_us, 0, "A synthetic session has no bus time");
    zassert_equal(sum.filtered, 0);
    for(const uint64_t lost : sum.lost)
        zassert_equal(lost, 0);

    // The end record is the last one, after the final statistics.
    const auto ends = RecordsOf(notifications, CanRecordKind::END);
    zassert_equal(ends.size(), 1);
    zassert_equal(ends[0]->record.end_reason, CanEndReason::CLOSED);
    const auto& last_records = notifications.back().records;
    zassert_equal(&last_records.back(), ends[0]);
    if(last_records.size() >= 2)
        zassert_equal(last_records[last_records.size() - 2].record.kind, CanRecordKind::STATISTICS);
}

ZTEST(can_monitor_stream, test_a_stalled_link_overflows_into_gaps_and_the_end_follows) {
    Harness harness;
    harness.is_auto_complete = false;

    const auto answer = harness.OpenSynthetic(2000, 8);

    // 2000 frames a second of 13 bytes fill the 16 KiB ring in well under a second and a half.
    k_msleep(1500);
    zassert_equal(harness.notifier->Count(), CONFIG_EERIE_LEAP_CAN_MONITOR_IN_FLIGHT);

    // The link comes back while frames still arrive: the first one that finds room writes the gap.
    harness.is_auto_complete = true;
    harness.service->OnNotificationSent();
    k_msleep(300);

    harness.CloseAndDrain(answer.tok);

    const StreamSummary summary = Summarize(harness.notifier->Notifications());
    zassert_true(summary.gaps > 0, "The ring overflowed");
    zassert_true(summary.are_gaps_from_the_ring);
    zassert_true(summary.gap_frames > 0);
    zassert_true(summary.frames > 0);

    // Every frame is in the stream or counted lost; the gap records account for those they could be written for.
    const uint64_t lost = summary.statistics.lost[CanStatistics::LOST_RING];
    zassert_equal(summary.statistics.frames_received, summary.frames + lost);
    zassert_true(lost >= summary.gap_frames);
    zassert_true(lost - summary.gap_frames < 100, "Few losses are left without a gap");

    zassert_equal(summary.ends.size(), 1U);
    zassert_equal(summary.ends[0], CanEndReason::CLOSED);
    zassert_equal(summary.last_kind, CanRecordKind::END);
}

ZTEST(can_monitor_stream, test_a_pending_smp_response_holds_the_stream_back) {
    Harness harness;
    harness.is_smp_busy = true;

    const auto answer = harness.OpenSynthetic(200, 2);
    k_msleep(300);
    zassert_equal(harness.notifier->Count(), 0, "Nothing goes while an SMP response is pending");

    harness.is_smp_busy = false;
    zassert_true(WaitUntil([&] {
        return harness.notifier->Count() >= 1;
    }));

    harness.CloseAndDrain(answer.tok);

    // What was held back arrives whole.
    const auto notifications = DecodeAll(harness.notifier->Notifications());
    ExpectChain(notifications);
    zassert_true(FramesOf(notifications).size() >= 50);
}

ZTEST(can_monitor_stream, test_a_notify_without_a_buffer_is_retried_with_no_gap_in_seq) {
    Harness harness;
    harness.notifier->SetResult(-ENOMEM);

    const auto answer = harness.OpenSynthetic(500, 4);
    k_msleep(300);

    zassert_equal(harness.notifier->Count(), 0);
    zassert_true(harness.notifier->GetRefused() > 0, "The sender tried");

    harness.notifier->SetResult(0);
    zassert_true(WaitUntil([&] {
        return harness.notifier->Count() >= 1;
    }));
    k_msleep(200);
    harness.CloseAndDrain(answer.tok);

    // The first notification to get through is the first one built, with every frame since the start.
    const auto notifications = DecodeAll(harness.notifier->Notifications());
    ExpectChain(notifications);
    const auto frames = FramesOf(notifications);
    zassert_true(frames.size() > 100);
    for(size_t i = 0; i < frames.size(); ++i)
        zassert_equal(frames[i]->record.id, i % 4, "No frame went missing (%zu)", i);

    const CanStatistics sum = SumStatistics(notifications);
    zassert_equal(sum.lost[CanStatistics::LOST_RING], 0);
}

ZTEST(can_monitor_stream, test_a_refused_notification_is_dropped_and_seq_shows_the_hole) {
    Harness harness;
    harness.notifier->FailNext(-EIO, 1);

    const auto answer = harness.OpenSynthetic(200, 4);
    zassert_true(WaitUntil([&] {
        return harness.notifier->Count() >= 2;
    }));
    harness.CloseAndDrain(answer.tok);

    const auto notifications = DecodeAll(harness.notifier->Notifications());
    zassert_equal(harness.notifier->GetRefused(), 1);
    zassert_equal(notifications[0].sequence, 1, "Notification 0 was dropped");
    ExpectChain(notifications, 1);

    // The frames it held count as lost, so the books still balance.
    const CanStatistics sum = SumStatistics(notifications);
    const uint64_t lost = sum.lost[CanStatistics::LOST_RING];
    zassert_true(lost > 0);
    zassert_equal(sum.frames_received, FramesOf(notifications).size() + lost);

    // And the time the dropped records spanned is not lost: the next base_us picks up after them.
    const auto frames = FramesOf(notifications);
    zassert_true(notifications[0].base_us > 0);
    zassert_true(frames[0]->time_us >= notifications[0].base_us);
}

ZTEST(can_monitor_stream, test_a_notify_refused_by_a_link_going_away_is_kept_not_dropped) {
    Harness harness;
    // What the stack answers between the end of the link and the report of the disconnect.
    harness.notifier->SetResult(-ENOTCONN);

    const auto answer = harness.OpenSynthetic(500, 4);
    k_msleep(300);

    zassert_equal(harness.notifier->Count(), 0);
    zassert_true(harness.notifier->GetRefused() > 0, "The sender tried");

    harness.notifier->SetResult(0);
    zassert_true(WaitUntil([&] {
        return harness.notifier->Count() >= 1;
    }));
    harness.CloseAndDrain(answer.tok);

    const auto notifications = DecodeAll(harness.notifier->Notifications());
    ExpectChain(notifications);
    zassert_equal(SumStatistics(notifications).lost[CanStatistics::LOST_RING], 0, "Nothing was dropped");
}

ZTEST(can_monitor_stream, test_a_drain_out_of_time_is_cut_into_a_gap_and_still_ends) {
    Harness harness;
    harness.is_auto_complete = false;

    const auto answer = harness.OpenSynthetic(2000, 4);

    // The ring fills behind the first notifications; a few completions let a gap record in, and it fills again.
    k_msleep(1000);
    for(int i = 0; i < CONFIG_EERIE_LEAP_CAN_MONITOR_IN_FLIGHT; ++i)
        harness.service->OnNotificationSent();
    k_msleep(300);
    zassert_true(harness.service->Close(answer.tok).has_value());

    k_msleep(CanMonitorSender::DRAIN_TIMEOUT_MS / 2);
    zassert_false(harness.HasEnded());
    zassert_equal(harness.releases.load(), 0, "The session drains on the fast link");

    // Past the drain's time the ring is cut, and the end record goes with the next completion.
    k_msleep(CanMonitorSender::DRAIN_TIMEOUT_MS / 2 + 200);
    harness.is_auto_complete = true;
    zassert_true(
        WaitUntil([&] {
            harness.service->OnNotificationSent();
            return harness.HasEnded();
        }),
        "The end record follows the cut"
    );
    zassert_equal(harness.holds.load(), harness.releases.load());

    // seq has no hole; base_us chains up to the cut and keeps the time of what was cut.
    const auto notifications = DecodeAll(harness.notifier->Notifications());
    zassert_true(notifications.size() >= 2);
    const std::vector<DecodedNotification> before(notifications.begin(), notifications.end() - 1);
    ExpectChain(before);
    const DecodedNotification& last = notifications.back();
    zassert_equal(last.sequence, static_cast<uint16_t>(before.size()));
    zassert_true(last.base_us > before.back().EndTimeUs(), "The cut records' time is kept");

    // The last notification: the cut's gap, the last statistics and the end record.
    const auto& records = last.records;
    zassert_true(records.size() >= 3);
    const CanRecord& gap = records[records.size() - 3].record;
    zassert_equal(gap.kind, CanRecordKind::GAP);
    zassert_equal(gap.gap_cause, CanGapCause::RING);
    zassert_true(gap.frames_lost > 0);
    zassert_equal(records[records.size() - 2].record.kind, CanRecordKind::STATISTICS);
    zassert_equal(records.back().record.kind, CanRecordKind::END);
    zassert_equal(records.back().record.end_reason, CanEndReason::CLOSED);

    // Every frame is in the stream or in a gap: the cut gap also carries the gaps it cut.
    const CanStatistics sum = SumStatistics(notifications);
    const uint64_t lost = sum.lost[CanStatistics::LOST_RING];
    uint64_t gap_frames = 0;
    for(const DecodedRecord* record : RecordsOf(notifications, CanRecordKind::GAP))
        gap_frames += record->record.frames_lost;

    zassert_equal(sum.frames_received, FramesOf(notifications).size() + lost);
    zassert_equal(gap_frames, lost, "The gaps count every lost frame once");
}

ZTEST(can_monitor_stream, test_stop_ends_the_sessions_for_a_new_configuration) {
    Harness harness;
    const auto answer = harness.OpenSynthetic(100, 2);
    k_msleep(100);

    zassert_true(harness.service->Stop());
    zassert_equal(harness.service->GetSessionCount(), 0);

    zassert_true(WaitUntil([&] {
        return harness.HasEnded();
    }));
    zassert_equal(harness.holds.load(), harness.releases.load(), "The fast link is released with the end record");

    const auto notifications = DecodeAll(harness.notifier->Notifications());
    const auto ends = RecordsOf(notifications, CanRecordKind::END);
    zassert_equal(ends.size(), 1);
    zassert_equal(ends[0]->record.end_reason, CanEndReason::CONFIGURATION_STORED);

    // The old token is gone, and nothing opens while the service is stopped.
    const auto closed = harness.service->Close(answer.tok);
    zassert_false(closed.has_value());
    zassert_equal(closed.error(), CanMonitorError::NO_SESSION);

    CanMonitorOpenRequest request;
    request.synthetic = CanSyntheticParameters{ .fps = 10, .ids = 1, .dlc = 1 };
    zassert_equal(harness.service->Open(request).error(), CanMonitorError::BUSY);

    zassert_true(harness.service->Start());
    zassert_true(harness.service->Open(request).has_value(), "The new configuration takes OPEN again");
}

ZTEST(can_monitor_stream, test_a_disconnect_ends_the_sessions_with_no_record) {
    Harness harness;
    harness.OpenSynthetic(100, 2);
    k_msleep(100);

    // The handler runs on the system work queue: the sessions end on the domain's own.
    harness.service->OnDisconnected();

    zassert_true(WaitUntil([&] {
        return harness.service->GetSessionCount() == 0;
    }));

    // Nothing can drain into a link that is gone: the sender lets go of the session and of what is in flight.
    zassert_true(WaitUntil([&] {
        return harness.service->GetSenderSessionCount() == 0 && harness.service->GetInFlight() == 0;
    }));
    zassert_equal(harness.holds.load(), harness.releases.load());

    const size_t before = harness.notifier->Count();
    k_msleep(100);
    zassert_false(harness.HasEnded(), "No end record goes to a link that is gone");
    zassert_equal(harness.notifier->Count(), before, "Nothing more is sent");
}

ZTEST(can_monitor_stream, test_a_session_ending_with_no_central_subscribed_is_freed_at_once) {
    Harness harness;
    const auto answer = harness.OpenSynthetic(100, 2);
    k_msleep(100);

    harness.notifier->SetMaxSize(0);
    zassert_true(harness.service->Close(answer.tok).has_value());

    zassert_true(
        WaitUntil([&] {
            return harness.service->GetSenderSessionCount() == 0;
        }),
        "Nothing to drain into: the sender lets go of it"
    );

    // The port is free, and a new OPEN says why it can't stream.
    CanMonitorOpenRequest request;
    request.synthetic = CanSyntheticParameters{ .fps = 10, .ids = 1, .dlc = 1 };
    zassert_equal(harness.service->Open(request).error(), CanMonitorError::NOT_LISTENING);
}
```

## src/can_monitor_synthetic.cpp
```c
#include <cstdlib>

#include <zephyr/ztest.h>

#include "can_monitor_test_support.h"

using namespace can_monitor_test;

namespace {} // namespace

ZTEST_SUITE(can_monitor_synthetic, NULL, NULL, NULL, ResetControllers, NULL);

ZTEST(can_monitor_synthetic, test_the_rate_holds_within_one_percent) {
    Harness harness;
    constexpr uint32_t FPS = 1000;
    constexpr uint32_t WINDOW_MS = 5000;

    const auto answer = harness.OpenSynthetic(FPS, 8);
    harness.Sleep(answer.tok, WINDOW_MS);
    harness.CloseAndDrain(answer.tok);

    const auto notifications = DecodeAll(harness.notifier->Notifications());
    ExpectChain(notifications);
    zassert_true(RecordsOf(notifications, CanRecordKind::GAP).empty(), "The ring never filled");

    // The frames' own times: the first at the start, the last a bit after its turn.
    const auto frames = RecordsOf(notifications, CanRecordKind::FRAME);
    zassert_true(frames.size() >= 4900, "Frames in 5 s: %zu", frames.size());

    const uint64_t span_us = frames.back()->time_us - frames.front()->time_us;
    const uint64_t expected_us = (frames.size() - 1) * 1000000ULL / FPS;
    const uint64_t error_us = span_us > expected_us ? span_us - expected_us : expected_us - span_us;
    zassert_true(
        error_us * 100 <= expected_us, "%zu frames took %u ms, %u ms are due", frames.size(),
        static_cast<unsigned>(span_us / 1000), static_cast<unsigned>(expected_us / 1000)
    );

    // And the records decode to the frames generated: a counter in the payload, the ids in turn.
    for(size_t i = 0; i < frames.size(); ++i) {
        zassert_equal(frames[i]->record.id, static_cast<uint32_t>(i % 8), "Frame %zu", i);
        zassert_equal(frames[i]->payload.size(), 8U);
        uint64_t counter = 0;
        for(size_t k = 0; k < 8; ++k)
            counter |= static_cast<uint64_t>(frames[i]->payload[k]) << (8 * k);
        zassert_equal(counter, i, "Counter of frame %zu", i);
    }

    const CanStatistics sum = SumStatistics(notifications);
    zassert_equal(sum.frames_received, frames.size());
}

ZTEST(can_monitor_synthetic, test_extended_fd_frames_decode_to_what_was_generated) {
    Harness harness;
    constexpr uint32_t IDS = 3;
    const CanSyntheticParameters parameters{ .fps = 200, .ids = IDS, .dlc = 15, .ext = true, .fd = true };

    const auto answer = harness.OpenSynthetic(parameters.fps, parameters.ids, parameters.dlc, true, true);
    k_msleep(500);
    harness.CloseAndDrain(answer.tok);

    const auto notifications = DecodeAll(harness.notifier->Notifications());
    ExpectChain(notifications);

    const auto frames = RecordsOf(notifications, CanRecordKind::FRAME);
    zassert_true(frames.size() > 20, "Frames: %zu", frames.size());
    for(size_t i = 0; i < frames.size(); ++i) {
        const CanRecord& record = frames[i]->record;
        zassert_equal(record.id, CanSyntheticSource::IdOf(parameters, i));
        zassert_true(record.id >= 0x18DA0000U && record.ide && record.fdf && record.brs);
        zassert_false(record.rtr || record.esi || record.tx);
        zassert_equal(record.dlc, 15);
        zassert_equal(frames[i]->payload.size(), 64U);
        for(size_t k = 0; k < 64; ++k)
            zassert_equal(frames[i]->payload[k], CanSyntheticSource::PayloadByte(i, k), "Frame %zu byte %zu", i, k);
    }
}

ZTEST(can_monitor_synthetic, test_parameters_that_cannot_be_generated_are_refused) {
    Harness harness;

    const auto open = [&](CanSyntheticParameters parameters) {
        CanMonitorOpenRequest request;
        request.synthetic = parameters;

        return harness.service->Open(request);
    };

    zassert_equal(open({ .fps = 0, .ids = 1, .dlc = 1 }).error(), CanMonitorError::UNKNOWN);
    zassert_equal(open({ .fps = 10, .ids = 0, .dlc = 1 }).error(), CanMonitorError::UNKNOWN);
    zassert_equal(open({ .fps = 10, .ids = 4096, .dlc = 1 }).error(), CanMonitorError::UNKNOWN);
    zassert_equal(open({ .fps = 10, .ids = 1, .dlc = 9 }).error(), CanMonitorError::UNKNOWN, "9 needs FD");
    zassert_equal(open({ .fps = 10, .ids = 1, .dlc = 16, .fd = true }).error(), CanMonitorError::UNKNOWN);
    zassert_equal(harness.service->GetSessionCount(), 0U);

    zassert_true(open({ .fps = 10, .ids = 1, .dlc = 9, .fd = true }).has_value());
}

ZTEST(can_monitor_synthetic, test_the_synthetic_port_takes_one_session) {
    Harness harness;
    const CanSyntheticParameters parameters{ .fps = 20, .ids = 2, .dlc = 2 };

    CanMonitorOpenRequest request;
    request.synthetic = parameters;
    const auto first = harness.service->Open(request);
    zassert_true(first.has_value());
    zassert_equal(first->ch, CAN_MONITOR_SYNTHETIC_PORT);
    zassert_equal(first->mode, CanMonitorMode::TAP);
    zassert_equal(first->type, eerie_leap::subsys::canbus::CanbusType::NONE);
    zassert_equal(first->bitrate, 0U);

    // The same request again is a lost answer; another one finds the port taken.
    const auto again = harness.service->Open(request);
    zassert_true(again.has_value());
    zassert_equal(again->tok, first->tok);
    zassert_equal(harness.service->GetSessionCount(), 1U);
    zassert_equal(harness.holds.load(), 1);

    request.synthetic->fps = 21;
    zassert_equal(harness.service->Open(request).error(), CanMonitorError::BUSY);
}
```
