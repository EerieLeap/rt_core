## CMakeLists.txt
```
cmake_minimum_required(VERSION 3.20.0)

include(${CMAKE_CURRENT_SOURCE_DIR}/../../../rt_core_test.cmake)

find_package(Zephyr REQUIRED HINTS $ENV{ZEPHYR_BASE})
project(functional_ble_domain)

file(GLOB_RECURSE TEST_SOURCES src/*.c src/*.cpp)

# The BLE domain needs Bluetooth, so its live data parts are built on their own here.
target_sources(app PRIVATE
  ${RT_CORE_DIR}/src/domain/ble_domain/utilities/live_data_encoder.cpp
  ${RT_CORE_DIR}/src/domain/ble_domain/services/live_data_service.cpp
  ${RT_CORE_DIR}/src/domain/ble_domain/smp/live_mgmt_group.cpp
  ${TEST_SOURCES}
)

# The test client injects requests with smp_rx_req().
target_include_directories(app PRIVATE
  ${RT_CORE_DIR}/tests/common
  ${ZEPHYR_BASE}/subsys/mgmt/mcumgr/transport/include
)
```

## prj.conf
```kconfig
CONFIG_ZTEST=y

# Language and Compiler
CONFIG_CPP=y
CONFIG_PICOLIBC=y
CONFIG_STD_CPP23=y
CONFIG_REQUIRES_FULL_LIBCPP=y
CONFIG_CPP_EXCEPTIONS=y
CONFIG_CPP_RTTI=y

# Memory
CONFIG_HEAP_MEM_POOL_SIZE=200000

# C++ exception unwinding needs considerably more stack than the ztest defaults.
CONFIG_MAIN_STACK_SIZE=8192
CONFIG_ZTEST_STACK_SIZE=8192

# Logging And Debugging
CONFIG_LOG=y
CONFIG_TEST_RANDOM_GENERATOR=y
CONFIG_THREAD_NAME=y

CONFIG_EERIE_LEAP_RT_CORE=y
CONFIG_EERIE_LEAP_THREADING=y
CONFIG_EERIE_LEAP_RANDOM=y
CONFIG_EERIE_LEAP_SMP=y

# The sensor models reference expressions and scripts.
CONFIG_EERIE_LEAP_EXPRESSION_ENGINE=y
CONFIG_EERIE_LEAP_LUA_SCRIPT=y
```

## src/live_data_encoder.cpp
```c
#include <array>
#include <optional>

#include <zephyr/ztest.h>

#include "live_data_test_support.h"

using namespace live_data_test;

ZTEST_SUITE(live_data_encoder, NULL, NULL, NULL, NULL, NULL);

ZTEST(live_data_encoder, test_layout_leaves_out_sensors_without_a_value) {
    const std::array<std::optional<float>, 3> values = { 1.5F, std::nullopt, -2.0F };
    std::array<uint8_t, LiveDataEncoder::GetMaxSize(3)> out{};

    const size_t size = LiveDataEncoder::Encode(7, 0x01020304, values, out);

    const std::array<uint8_t, 17> expected = {
        0x01,
        0x07,
        0x04,
        0x03,
        0x02,
        0x01,
        0x02,
        0x00,
        0x00,
        0x00,
        0xC0,
        0x3F,
        0x02,
        0x00,
        0x00,
        0x00,
        0xC0,
    };
    zassert_equal(size, expected.size());
    zassert_mem_equal(out.data(), expected.data(), expected.size());
}

ZTEST(live_data_encoder, test_no_values_leaves_the_header) {
    const std::array<std::optional<float>, 2> values = {};
    std::array<uint8_t, LiveDataEncoder::GetMaxSize(2)> out{};

    zassert_equal(LiveDataEncoder::Encode(1, 2, values, out), LiveDataEncoder::HEADER_SIZE);
    zassert_equal(out[6], 0);
}

ZTEST(live_data_encoder, test_rejects_a_short_buffer_and_too_many_values) {
    const std::array<std::optional<float>, 2> values = { 1.0F, 2.0F };
    std::array<uint8_t, LiveDataEncoder::GetMaxSize(2) - 1> short_out{};
    zassert_equal(LiveDataEncoder::Encode(0, 0, values, short_out), 0);

    std::vector<std::optional<float>> many(LiveDataEncoder::MAX_VALUES + 1);
    std::vector<uint8_t> out(LiveDataEncoder::GetMaxSize(many.size()));
    zassert_equal(LiveDataEncoder::Encode(0, 0, many, out), 0);
}

ZTEST(live_data_encoder, test_a_full_subscription_fills_one_notification) {
    // ATT MTU 247 leaves 244 bytes.
    zassert_true(LiveDataEncoder::GetMaxSize(LiveDataService::MAX_SENSORS) <= 244);
    zassert_true(LiveDataEncoder::GetMaxSize(LiveDataService::MAX_SENSORS + 1) > 244);
}
```

## src/live_data_service.cpp
```c
#include <array>
#include <cerrno>

#include <zephyr/ztest.h>

#include "live_data_test_support.h"

using namespace live_data_test;

using SubscribeResult = LiveDataService::SubscribeResult;

ZTEST_SUITE(live_data_service, NULL, NULL, NULL, NULL, NULL);

ZTEST(live_data_service, test_capacity_follows_the_notification_size) {
    const auto notifier = std::make_shared<FakeNotifier>();
    const Readings readings;
    LiveDataService service(notifier, readings.frame);

    notifier->SetMaxSize(244);
    zassert_equal(service.GetCapacity(), 47);
    notifier->SetMaxSize(20);
    zassert_equal(service.GetCapacity(), 2);
    notifier->SetMaxSize(1000);
    zassert_equal(service.GetCapacity(), LiveDataService::MAX_SENSORS);
    notifier->SetMaxSize(0);
    zassert_equal(service.GetCapacity(), 0);
}

ZTEST(live_data_service, test_subscription_is_limited_to_one_notification) {
    const auto notifier = std::make_shared<FakeNotifier>();
    const Readings readings;
    LiveDataService service(notifier, readings.frame);
    const std::array<uint32_t, 3> hashes = { 1, 2, 3 };

    notifier->SetMaxSize(0);
    zassert_equal(service.Subscribe(hashes, AllValues(hashes.size()), 100), SubscribeResult::NOT_LISTENING);

    notifier->SetMaxSize(20);
    zassert_equal(service.Subscribe(hashes, AllValues(hashes.size()), 100), SubscribeResult::TOO_MANY);
    zassert_false(service.IsSubscribed());

    zassert_equal(service.Subscribe(std::span(hashes).first(2), AllValues(2), 100), SubscribeResult::OK);
    zassert_true(service.IsSubscribed());
}

ZTEST(live_data_service, test_samples_carry_values_by_subscription_position) {
    const auto notifier = std::make_shared<FakeNotifier>();
    Readings readings;
    const uint32_t first = readings.Add("first", 1.5F);
    const uint32_t pending = readings.Add("pending", std::nullopt);
    const uint32_t last = readings.Add("last", 3.25F);
    LiveDataService service(notifier, readings.frame);

    const std::array<uint32_t, 4> hashes = { last, pending, 12345, first };
    const uint32_t before_ms = k_uptime_get_32();
    zassert_equal(service.Subscribe(hashes, AllValues(hashes.size()), 1000), SubscribeResult::OK);

    const auto notifications = notifier->WaitForNotifications(1);
    zassert_equal(notifications.size(), 1);

    const auto sample = Decode(notifications[0]);
    zassert_equal(sample.version, LiveDataEncoder::VERSION);
    zassert_equal(sample.sequence, 0);
    zassert_true(sample.time_ms >= before_ms && sample.time_ms <= k_uptime_get_32());
    zassert_equal(sample.values.size(), 2);
    zassert_equal(sample.values[0].first, 0);
    zassert_equal(sample.values[0].second, 3.25F);
    zassert_equal(sample.values[1].first, 3);
    zassert_equal(sample.values[1].second, 1.5F);
}

ZTEST(live_data_service, test_fields_must_match_the_sensors) {
    const auto notifier = std::make_shared<FakeNotifier>();
    const Readings readings;
    LiveDataService service(notifier, readings.frame);
    const std::array<uint32_t, 2> hashes = { 1, 2 };

    zassert_equal(service.Subscribe(hashes, AllValues(1), 100), SubscribeResult::TOO_MANY);
    zassert_false(service.IsSubscribed());
}

ZTEST(live_data_service, test_one_sensor_listed_for_each_field) {
    const auto notifier = std::make_shared<FakeNotifier>();
    Readings readings;
    const uint32_t analog = readings.Add("analog", 80.0F, 4.0F, 2.0F);
    const uint32_t plain = readings.Add("plain", 1.5F);
    LiveDataService service(notifier, readings.frame);

    const std::array<uint32_t, 4> hashes = { analog, analog, analog, plain };
    const std::array<ReadingField, 4> fields = { ReadingField::VALUE, ReadingField::CALIBRATED_VOLTAGE,
        ReadingField::ADC_VOLTAGE, ReadingField::ADC_VOLTAGE };
    zassert_equal(service.Subscribe(hashes, fields, 1000), SubscribeResult::OK);

    const auto notifications = notifier->WaitForNotifications(1);
    zassert_equal(notifications.size(), 1);

    // Each entry is one position; the plain sensor has no ADC voltage, so its entry is left out.
    const auto sample = Decode(notifications[0]);
    zassert_equal(sample.values.size(), 3);
    zassert_equal(sample.values[0].first, 0);
    zassert_equal(sample.values[0].second, 80.0F);
    zassert_equal(sample.values[1].first, 1);
    zassert_equal(sample.values[1].second, 4.0F);
    zassert_equal(sample.values[2].first, 2);
    zassert_equal(sample.values[2].second, 2.0F);
}

ZTEST(live_data_service, test_period_is_at_least_the_minimum) {
    zassert_equal(LiveDataService::ClampPeriod(10), LiveDataService::MIN_PERIOD_MS);
    zassert_equal(LiveDataService::ClampPeriod(200), 200);

    const auto notifier = std::make_shared<FakeNotifier>();
    Readings readings;
    LiveDataService service(notifier, readings.frame);
    notifier->on_notified = [&service] {
        service.OnNotificationSent();
    };

    const std::array<uint32_t, 1> hashes = { readings.Add("sensor", 1.0F) };
    zassert_equal(service.Subscribe(hashes, AllValues(hashes.size()), 10), SubscribeResult::OK);
    k_msleep(175);
    service.Unsubscribe();

    // 10 ms would give well over a dozen samples.
    const size_t count = notifier->Notifications().size();
    zassert_true(count >= 2 && count <= 5, "%u samples in 175 ms", static_cast<unsigned>(count));
}

ZTEST(live_data_service, test_one_notification_in_flight) {
    const auto notifier = std::make_shared<FakeNotifier>();
    Readings readings;
    LiveDataService service(notifier, readings.frame);

    const std::array<uint32_t, 1> hashes = { readings.Add("sensor", 1.0F) };
    zassert_equal(
        service.Subscribe(hashes, AllValues(hashes.size()), LiveDataService::MIN_PERIOD_MS), SubscribeResult::OK
    );
    k_msleep(200);

    zassert_equal(notifier->Notifications().size(), 1, "The first notification never reported back");
    zassert_true(service.GetDroppedCount() >= 2);

    service.OnNotificationSent();
    const auto notifications = notifier->WaitForNotifications(2);
    zassert_equal(notifications.size(), 2);

    // The sequence counts samples, so the dropped ones show as a gap.
    zassert_true(Decode(notifications[1]).sequence >= 3);
}

ZTEST(live_data_service, test_sample_without_a_buffer_is_dropped) {
    const auto notifier = std::make_shared<FakeNotifier>();
    Readings readings;
    LiveDataService service(notifier, readings.frame);
    notifier->SetResult(-ENOMEM);

    const std::array<uint32_t, 1> hashes = { readings.Add("sensor", 1.0F) };
    zassert_equal(
        service.Subscribe(hashes, AllValues(hashes.size()), LiveDataService::MIN_PERIOD_MS), SubscribeResult::OK
    );
    k_msleep(120);

    zassert_true(notifier->Notifications().empty());
    zassert_true(service.GetDroppedCount() >= 1);

    notifier->SetResult(0);
    zassert_equal(notifier->WaitForNotifications(1).size(), 1, "Nothing stays in flight after a failure");
}

ZTEST(live_data_service, test_unsubscribe_stops_sampling) {
    const auto notifier = std::make_shared<FakeNotifier>();
    Readings readings;
    LiveDataService service(notifier, readings.frame);
    notifier->on_notified = [&service] {
        service.OnNotificationSent();
    };

    const std::array<uint32_t, 1> hashes = { readings.Add("sensor", 1.0F) };
    zassert_equal(
        service.Subscribe(hashes, AllValues(hashes.size()), LiveDataService::MIN_PERIOD_MS), SubscribeResult::OK
    );
    zassert_equal(notifier->WaitForNotifications(1).size(), 1);

    service.Unsubscribe();
    notifier->Clear();
    k_msleep(150);

    zassert_true(notifier->Notifications().empty());
    zassert_false(service.IsSubscribed());
}
```

## src/live_data_test_support.h
```c
#pragma once

#include <bit>
#include <cerrno>
#include <cstdint>
#include <functional>
#include <memory>
#include <optional>
#include <span>
#include <string_view>
#include <utility>
#include <vector>

#include <zephyr/kernel.h>
#include <zephyr/sys/byteorder.h>
#include <zephyr/ztest.h>

#include "domain/ble_domain/services/live_data_service.h"
#include "domain/ble_domain/utilities/live_data_encoder.h"
#include "domain/sensor_domain/models/sensor.h"
#include "domain/sensor_domain/models/sensor_reading.h"
#include "domain/sensor_domain/utilities/sensor_readings_frame.hpp"
#include "subsys/bluetooth/i_ble_notifier.h"
#include "utilities/memory/memory_resource_manager.h"

namespace live_data_test {

using namespace eerie_leap::domain::sensor_domain::models;
using eerie_leap::domain::ble_domain::services::LiveDataService;
using eerie_leap::domain::ble_domain::utilities::LiveDataEncoder;
using eerie_leap::domain::sensor_domain::utilities::SensorReadingsFrame;
using eerie_leap::subsys::bluetooth::IBleNotifier;
using eerie_leap::utilities::memory::Mrm;

using Bytes = std::vector<uint8_t>;

// The `live` characteristic of a central: records notifications, or fails them on demand.
class FakeNotifier : public IBleNotifier {
private:
    mutable k_mutex lock_{};
    size_t max_size_ = 244;
    int result_ = 0;
    std::vector<Bytes> notifications_;

public:
    // Called after each accepted notification, e.g. to report it sent.
    std::function<void()> on_notified;

    FakeNotifier() {
        k_mutex_init(&lock_);
    }

    void SetMaxSize(size_t size) {
        k_mutex_lock(&lock_, K_FOREVER);
        max_size_ = size;
        k_mutex_unlock(&lock_);
    }

    void SetResult(int result) {
        k_mutex_lock(&lock_, K_FOREVER);
        result_ = result;
        k_mutex_unlock(&lock_);
    }

    [[nodiscard]] size_t GetMaxNotificationSize() const override {
        k_mutex_lock(&lock_, K_FOREVER);
        const size_t size = max_size_;
        k_mutex_unlock(&lock_);

        return size;
    }

    int Notify(std::span<const uint8_t> data) override {
        k_mutex_lock(&lock_, K_FOREVER);
        const int result = result_;
        if(result == 0)
            notifications_.emplace_back(data.begin(), data.end());
        k_mutex_unlock(&lock_);

        if(result == 0 && on_notified)
            on_notified();

        return result;
    }

    [[nodiscard]] std::vector<Bytes> Notifications() const {
        k_mutex_lock(&lock_, K_FOREVER);
        auto notifications = notifications_;
        k_mutex_unlock(&lock_);

        return notifications;
    }

    void Clear() {
        k_mutex_lock(&lock_, K_FOREVER);
        notifications_.clear();
        k_mutex_unlock(&lock_);
    }

    std::vector<Bytes> WaitForNotifications(size_t count, int timeout_ms = 1000) const {
        for(int waited_ms = 0; waited_ms < timeout_ms; waited_ms += 10) {
            auto notifications = Notifications();
            if(notifications.size() >= count)
                return notifications;

            k_msleep(10);
        }

        return Notifications();
    }
};

struct DecodedSample {
    uint8_t version;
    uint8_t sequence;
    uint32_t time_ms;
    std::vector<std::pair<uint8_t, float>> values;
};

inline DecodedSample Decode(std::span<const uint8_t> data) {
    zassert_true(data.size() >= LiveDataEncoder::HEADER_SIZE);

    DecodedSample sample{
        .version = data[0],
        .sequence = data[1],
        .time_ms = sys_get_le32(&data[2]),
        .values = {},
    };

    const uint8_t count = data[6];
    zassert_equal(data.size(), LiveDataEncoder::GetMaxSize(count));

    for(size_t i = 0; i < count; i++) {
        const uint8_t* entry = &data[LiveDataEncoder::HEADER_SIZE + i * LiveDataEncoder::ENTRY_SIZE];
        sample.values.emplace_back(entry[0], std::bit_cast<float>(sys_get_le32(entry + 1)));
    }

    return sample;
}

// One VALUE field per entry, what a client without `fields` gets.
inline std::vector<ReadingField> AllValues(size_t count) {
    return std::vector<ReadingField>(count, ReadingField::VALUE);
}

// A frame with processed values for some sensors.
struct Readings {
    std::shared_ptr<SensorReadingsFrame> frame = std::make_shared<SensorReadingsFrame>();
    std::vector<std::shared_ptr<Sensor>> sensors;
    std::vector<std::optional<float>> values;
    std::vector<std::optional<float>> calibrated_voltages;
    std::vector<std::optional<float>> adc_voltages;

    uint32_t
    Add(std::string_view id,
        std::optional<float> value,
        std::optional<float> calibrated_voltage = std::nullopt,
        std::optional<float> adc_voltage = std::nullopt) {
        const auto sensor = std::make_shared<Sensor>(std::allocator_arg, Mrm::GetDefaultPmr(), id);
        sensors.push_back(sensor);
        values.push_back(value);
        calibrated_voltages.push_back(calibrated_voltage);
        adc_voltages.push_back(adc_voltage);

        // Slots exist per configuration, so every added sensor reconfigures the frame and replays the readings.
        frame->Configure(sensors);
        for(size_t i = 0; i < sensors.size(); i++) {
            SensorReading reading(sensors[i].get());
            reading.source = ReadingSource::PROCESSING;
            reading.calibrated_voltage = calibrated_voltages[i];
            reading.adc_voltage = adc_voltages[i];
            if(values[i].has_value()) {
                reading.status = ReadingStatus::PROCESSED;
                // NOLINTNEXTLINE(bugprone-optional-value-conversion): the plain copy of the optional trips GCC's maybe-uninitialized
                reading.value = *values[i];
            }
            frame->AddOrUpdateReading(reading);
        }

        return sensor->id_hash;
    }
};

} // namespace live_data_test
```

## src/live_mgmt_group.cpp
```c
#include <utility>
#include <vector>

#include <zephyr/mgmt/mcumgr/mgmt/mgmt_defines.h>
#include <zephyr/ztest.h>

#include "domain/ble_domain/smp/live_mgmt_group.h"
#include "live_data_test_support.h"
#include "smp_test_client.h"

using namespace live_data_test;
using namespace smp_test;
using eerie_leap::domain::ble_domain::smp::LiveMgmtGroup;

using Command = LiveMgmtGroup::Command;
using Error = LiveMgmtGroup::Error;

namespace {

constexpr uint8_t Id(Command command) {
    return std::to_underlying(command);
}

struct GroupHarness {
    std::shared_ptr<FakeNotifier> notifier = std::make_shared<FakeNotifier>();
    Readings readings;
    std::shared_ptr<LiveDataService> service = std::make_shared<LiveDataService>(notifier, readings.frame);
    LiveMgmtGroup group{ service };
    SmpTestClient client;

    GroupHarness() {
        notifier->on_notified = [service = service.get()] {
            service->OnNotificationSent();
        };
        group.Register();
    }

    Response
    SubscribeFields(const std::vector<uint32_t>& hashes, const std::vector<uint32_t>& fields, uint32_t period_ms) {
        return client.Write(
            SmpGroupId::LIVE, Id(Command::SUBSCRIBE),
            CborMap()
                .Put("ids", std::span<const uint32_t>(hashes))
                .Put("fields", std::span<const uint32_t>(fields))
                .Put("period", period_ms)
                .Build()
        );
    }

    Response Subscribe(const std::vector<uint32_t>& hashes, uint32_t period_ms) {
        return client.Write(
            SmpGroupId::LIVE, Id(Command::SUBSCRIBE),
            CborMap().Put("ids", std::span<const uint32_t>(hashes)).Put("period", period_ms).Build()
        );
    }
};

void ExpectGroupError(const Response& response, Error error) {
    zassert_true(response.error.has_value(), "Expected a group error");
    zassert_equal(response.error_group.value(), std::to_underlying(SmpGroupId::LIVE));
    zassert_equal(response.error.value(), std::to_underlying(error));
}

} // namespace

ZTEST_SUITE(smp_live_group, NULL, NULL, NULL, NULL, NULL);

ZTEST(smp_live_group, test_subscribe_reports_the_period_and_capacity) {
    GroupHarness harness;
    const uint32_t hash = harness.readings.Add("sensor", 2.5F);

    const auto response = harness.Subscribe({ hash }, 20);

    zassert_true(response.IsOk());
    zassert_equal(response.Value("period"), LiveDataService::MIN_PERIOD_MS);
    zassert_equal(response.Value("max"), 47);
    zassert_true(response.flags.at("fields"), "Tells a unit that knows `fields`");
    zassert_true(harness.service->IsSubscribed());

    const auto notifications = harness.notifier->WaitForNotifications(1);
    zassert_equal(notifications.size(), 1);
    zassert_equal(Decode(notifications[0]).values.size(), 1);
}

ZTEST(smp_live_group, test_too_many_sensors_report_the_capacity) {
    GroupHarness harness;

    harness.notifier->SetMaxSize(20);
    auto response = harness.Subscribe({ 1, 2, 3 }, 100);
    ExpectGroupError(response, Error::TOO_MANY);
    zassert_equal(response.Value("max"), 2);

    // More than the service can hold at all.
    harness.notifier->SetMaxSize(1000);
    response = harness.Subscribe(std::vector<uint32_t>(LiveDataService::MAX_SENSORS + 1, 7), 100);
    ExpectGroupError(response, Error::TOO_MANY);
    zassert_equal(response.Value("max"), LiveDataService::MAX_SENSORS);

    zassert_false(harness.service->IsSubscribed());
}

ZTEST(smp_live_group, test_central_must_listen_on_live) {
    GroupHarness harness;
    harness.notifier->SetMaxSize(0);

    ExpectGroupError(harness.Subscribe({ 1 }, 100), Error::NOT_LISTENING);
}

ZTEST(smp_live_group, test_incomplete_requests_are_invalid) {
    GroupHarness harness;

    auto response = harness.client.Write(
        SmpGroupId::LIVE, Id(Command::SUBSCRIBE), CborMap().Put("period", 100).Build()
    );
    zassert_equal(response.Value("rc"), MGMT_ERR_EINVAL);

    const std::vector<uint32_t> hashes = { 1 };
    response = harness.client.Write(
        SmpGroupId::LIVE, Id(Command::SUBSCRIBE), CborMap().Put("ids", std::span<const uint32_t>(hashes)).Build()
    );
    zassert_equal(response.Value("rc"), MGMT_ERR_EINVAL);

    zassert_equal(harness.Subscribe({}, 100).Value("rc"), MGMT_ERR_EINVAL);
}

ZTEST(smp_live_group, test_unsubscribe_stops_the_samples) {
    GroupHarness harness;
    zassert_true(harness.Subscribe({ harness.readings.Add("sensor", 1.0F) }, 50).IsOk());

    const auto response = harness.client.Write(SmpGroupId::LIVE, Id(Command::UNSUBSCRIBE), CborMap().Build());

    zassert_true(response.IsOk());
    zassert_false(harness.service->IsSubscribed());
}

ZTEST(smp_live_group, test_absent_fields_mean_values) {
    GroupHarness harness;
    const uint32_t hash = harness.readings.Add("analog", 80.0F, 4.0F, 2.0F);

    zassert_true(harness.Subscribe({ hash, hash }, 50).IsOk());

    const auto notifications = harness.notifier->WaitForNotifications(1);
    zassert_equal(notifications.size(), 1);
    const auto sample = Decode(notifications[0]);
    zassert_equal(sample.values.size(), 2);
    zassert_equal(sample.values[0].second, 80.0F);
    zassert_equal(sample.values[1].second, 80.0F);
}

ZTEST(smp_live_group, test_one_sensor_three_times_with_each_field) {
    GroupHarness harness;
    const uint32_t hash = harness.readings.Add("analog", 80.0F, 4.0F, 2.0F);

    const auto response = harness.SubscribeFields({ hash, hash, hash }, { 0, 1, 2 }, 50);
    zassert_true(response.IsOk());
    zassert_true(response.flags.at("fields"));

    const auto notifications = harness.notifier->WaitForNotifications(1);
    zassert_equal(notifications.size(), 1);
    const auto sample = Decode(notifications[0]);
    zassert_equal(sample.values.size(), 3);
    zassert_equal(sample.values[0].second, 80.0F);
    zassert_equal(sample.values[1].second, 4.0F);
    zassert_equal(sample.values[2].second, 2.0F);
}

ZTEST(smp_live_group, test_fields_of_another_length_are_invalid) {
    GroupHarness harness;
    const uint32_t hash = harness.readings.Add("sensor", 1.0F);

    zassert_equal(harness.SubscribeFields({ hash, hash }, { 0 }, 50).Value("rc"), MGMT_ERR_EINVAL);
    zassert_equal(harness.SubscribeFields({ hash }, { 0, 1 }, 50).Value("rc"), MGMT_ERR_EINVAL);
    zassert_equal(harness.SubscribeFields({ hash }, {}, 50).Value("rc"), MGMT_ERR_EINVAL);
    zassert_false(harness.service->IsSubscribed());
}

ZTEST(smp_live_group, test_an_unknown_field_is_invalid) {
    GroupHarness harness;
    const uint32_t hash = harness.readings.Add("sensor", 1.0F);

    zassert_equal(harness.SubscribeFields({ hash, hash }, { 0, 3 }, 50).Value("rc"), MGMT_ERR_EINVAL);
    zassert_equal(harness.SubscribeFields({ hash }, { 4000000000U }, 50).Value("rc"), MGMT_ERR_EINVAL);
    zassert_false(harness.service->IsSubscribed());
}
```
