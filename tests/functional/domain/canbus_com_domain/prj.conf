## CMakeLists.txt
```
cmake_minimum_required(VERSION 3.20.0)

set(RT_CORE_TEST_SIM_FLASH ON)
# The CAN controller on every board; boards/ holds the native_sim flash only.
list(APPEND EXTRA_DTC_OVERLAY_FILE "${CMAKE_CURRENT_SOURCE_DIR}/can_loopback.overlay")
include(${CMAKE_CURRENT_SOURCE_DIR}/../../../rt_core_test.cmake)

find_package(Zephyr REQUIRED HINTS $ENV{ZEPHYR_BASE})
project(functional_canbus_com_domain)

file(GLOB_RECURSE TEST_SOURCES src/*.c src/*.cpp)

target_sources(app PRIVATE ${TEST_SOURCES})

# The CDMP loopback harness, shared with the cdmp_state suite.
target_include_directories(app PRIVATE ${RT_CORE_DIR}/tests/common)
```

## prj.conf
```kconfig
CONFIG_ZTEST=y

# Language and Compiler
CONFIG_CPP=y
CONFIG_PICOLIBC=y
CONFIG_STD_CPP23=y
CONFIG_REQUIRES_FULL_LIBCPP=y
CONFIG_CPP_EXCEPTIONS=y
CONFIG_CPP_RTTI=y

# Memory
CONFIG_HEAP_MEM_POOL_SIZE=200000

# C++ exception unwinding needs considerably more stack than the ztest defaults.
CONFIG_MAIN_STACK_SIZE=8192
CONFIG_ZTEST_STACK_SIZE=8192

# Logging And Debugging
CONFIG_LOG=y
CONFIG_TEST_RANDOM_GENERATOR=y
CONFIG_THREAD_NAME=y

# ThreadBase::InitializeStack() falls back to k_thread_stack_alloc().
CONFIG_THREAD_STACK_INFO=y
CONFIG_DYNAMIC_THREAD=y
CONFIG_DYNAMIC_THREAD_ALLOC=y

# FS Config: the CAN configuration is stored on the internal filesystem.
CONFIG_FLASH=y
CONFIG_FLASH_MAP=y
CONFIG_FILE_SYSTEM=y
CONFIG_FILE_SYSTEM_LITTLEFS=y
CONFIG_FILE_SYSTEM_MKFS=y

CONFIG_ZCBOR=y

CONFIG_CRC=y

# CANBus
CONFIG_CAN=y
CONFIG_CAN_FD_MODE=y
CONFIG_CAN_LOOPBACK=y

# The 512 byte default overflows on the 64-bit QEMU targets.
CONFIG_CAN_LOOPBACK_TX_THREAD_STACK_SIZE=2048

CONFIG_EERIE_LEAP_RT_CORE=y
CONFIG_EERIE_LEAP_CONFIGURATION=y
CONFIG_EERIE_LEAP_CANBUS=y
CONFIG_EERIE_LEAP_CDMP=y
CONFIG_EERIE_LEAP_DEVICE_TREE=y
CONFIG_EERIE_LEAP_FS=y
CONFIG_EERIE_LEAP_LUA_SCRIPT=y
CONFIG_EERIE_LEAP_EXPRESSION_ENGINE=y
CONFIG_EERIE_LEAP_RANDOM=y
CONFIG_EERIE_LEAP_THREADING=y

CONFIG_EERIE_LEAP_DOMAIN_CANBUS=y
CONFIG_EERIE_LEAP_DOMAIN_CANBUS_COM=y
CONFIG_EERIE_LEAP_DOMAIN_SCRIPT=y

# The state bridge carries logging_events. The logging domain stays off, as on the gauge, which
# imports the logging status with its header-only descriptor.
CONFIG_EERIE_LEAP_EVENT_BUS=y
```

## can_loopback.overlay
```dts
/ {
        can_loopback0: can_loopback0 {
                status = "okay";
                compatible = "zephyr,can-loopback";
        };
};
```

## src/canbus_com_features.cpp
```c
#include <cstdint>

#include <zephyr/kernel.h>
#include <zephyr/ztest.h>

#include "domain/system_domain/models/product_feature.h"

#include "canbus_com_test_support.h"

using namespace canbus_com_test;

using eerie_leap::domain::system_domain::models::BUILD_FEATURES;
using eerie_leap::domain::system_domain::models::HasFeature;
using eerie_leap::domain::system_domain::models::ProductFeature;

namespace {

Harness* harness_under_test = nullptr;

void* CanbusComFeaturesSetup() {
    return nullptr;
}

void CanbusComFeaturesBefore(void*) {
    harness_under_test = new Harness();
}

void CanbusComFeaturesAfter(void*) {
    delete harness_under_test;
    harness_under_test = nullptr;

    ResetLoopbackDevice();
}

} // namespace

ZTEST_SUITE(canbus_com_features, NULL, CanbusComFeaturesSetup, CanbusComFeaturesBefore, CanbusComFeaturesAfter, NULL);

ZTEST(canbus_com_features, test_features_start_with_the_build_but_without_logging) {
    const auto features = harness_under_test->com->GetFeatures();

    zassert_true(HasFeature(BUILD_FEATURES, ProductFeature::CANBUS), "The suite builds the CAN domain");
    zassert_true(HasFeature(features, ProductFeature::CANBUS));
    zassert_false(HasFeature(features, ProductFeature::LOGGING), "LOGGING is set only by a log writer");
    zassert_equal(features, BUILD_FEATURES & ~static_cast<uint16_t>(ProductFeature::LOGGING));
}

// This suite does not build the logging domain, so the build has no LOGGING to offer.
ZTEST(canbus_com_features, test_logging_cannot_be_set_when_the_build_lacks_it) {
    zassert_false(HasFeature(BUILD_FEATURES, ProductFeature::LOGGING));

    harness_under_test->com->SetLoggingAvailable(true);

    zassert_false(HasFeature(harness_under_test->com->GetFeatures(), ProductFeature::LOGGING));
}

ZTEST(canbus_com_features, test_device_info_carries_the_current_features) {
    const auto info = harness_under_test->com->GetNetworkInfo()->GetDeviceInfo();

    zassert_equal(info.features, harness_under_test->com->GetFeatures());
}
```

## src/canbus_com_reachability.cpp
```c
#include <cstdint>

#include <zephyr/kernel.h>
#include <zephyr/ztest.h>

#include "canbus_com_test_support.h"

using namespace canbus_com_test;

namespace {

// A second unit next to the scripted peer, with an ID above the unit's.
constexpr uint8_t OTHER_PEER_ID = 3;
constexpr uint32_t OTHER_PEER_UID = 0x33333333;
// CDMP major version 2.0; the unit under test speaks 1.0.
constexpr uint8_t OTHER_MAJOR_VERSION = 0x20;

Harness* harness_under_test = nullptr;

void* CanbusComReachabilitySetup() {
    return nullptr;
}

void CanbusComReachabilityBefore(void*) {
    harness_under_test = new Harness();
}

void CanbusComReachabilityAfter(void*) {
    delete harness_under_test;
    harness_under_test = nullptr;

    ResetLoopbackDevice();
}

} // namespace

ZTEST_SUITE(
    canbus_com_reachability,
    NULL,
    CanbusComReachabilitySetup,
    CanbusComReachabilityBefore,
    CanbusComReachabilityAfter,
    NULL
);

ZTEST(canbus_com_reachability, test_only_other_units_in_the_table_are_reachable) {
    Harness& harness = *harness_under_test;
    harness.BringOnline();
    harness.Settle();

    zassert_equal(harness.com->GetAddress(), OWN_ID, "SMP is bound to the claimed ID");
    zassert_true(harness.com->IsSmpBound());
    zassert_true(harness.com->IsReachable(PEER_ID), "The peer answered discovery");
    zassert_false(harness.com->IsReachable(OWN_ID), "Not the unit itself");
    zassert_false(harness.com->IsReachable(OTHER_PEER_ID), "Not a unit that is not in the table");
    zassert_false(harness.com->IsReachable(CdmpDevice::DEVICE_ID_UNASSIGNED));
    zassert_false(harness.com->IsReachable(CdmpDevice::DEVICE_ID_BROADCAST));

    harness.Join(OTHER_PEER_ID, OTHER_PEER_UID);

    zassert_true(harness.com->IsReachable(OTHER_PEER_ID), "A unit joins the table on its first heartbeat");
}

// Boot complete of a CAN-only unit waits for this (docs/dfu.md): the ID is claimed a few seconds after the start.
ZTEST(canbus_com_reachability, test_smp_is_bound_only_while_online_with_a_claimed_id) {
    Harness& harness = *harness_under_test;

    zassert_false(harness.com->IsSmpBound(), "Not started");

    zassert_true(harness.com->Start());

    zassert_true(harness.bus.Wait(MANAGEMENT, IsManagement(CdmpManagementMessageType::DISCOVERY_REQUEST)).has_value());
    zassert_false(harness.com->IsSmpBound(), "Discovering, with no ID yet");

    harness.SendAsPeer(
        MANAGEMENT,
        CdmpDiscoveryResponseMessage{ .device_id = PEER_ID, .uid = PEER_UID, .features = LOGGER_FEATURES }.ToCanFrame()
    );
    auto claim = harness.bus.Wait(MANAGEMENT, IsManagement(CdmpManagementMessageType::ID_CLAIM), STARTUP_TIMEOUT_MS);
    zassert_true(claim.has_value(), "The unit claims an ID after discovery");
    zassert_false(harness.com->IsSmpBound(), "Claiming, not yet answered");

    harness.SendAsPeer(
        MANAGEMENT,
        CdmpIdClaimResponseMessage{ .responding_device_id = PEER_ID,
            .claiming_device_id = OWN_ID,
            .claiming_device_uid = CdmpIdClaimRequestMessage::FromCanFrame(claim->data).uid,
            .result = CdmpIdClaimResult::ACCEPT }
            .ToCanFrame()
    );
    zassert_true(harness.WaitForStatus(CdmpDeviceStatus::ONLINE));

    // The transport binds from the status handler, right after the status changes.
    const int64_t deadline = k_uptime_get() + FRAME_TIMEOUT_MS;
    while(!harness.com->IsSmpBound()) {
        zassert_true(k_uptime_get() < deadline, "SMP binds to the claimed ID once the unit is online");
        k_msleep(5);
    }
    zassert_equal(harness.com->GetAddress(), OWN_ID);

    harness.Settle();
    zassert_true(harness.com->Stop());

    zassert_false(harness.com->IsSmpBound(), "A stopped node unbinds SMP");
}

// The access point asks CDMP whether a unit is reachable, and CDMP's table has no entry for a unit
// whose ID claim it refused for its version, so the access point cannot forward to it.
ZTEST(canbus_com_reachability, test_unit_on_another_major_version_is_not_reachable) {
    Harness& harness = *harness_under_test;
    harness.BringOnline();
    harness.Settle();

    harness.SendAsPeer(
        MANAGEMENT,
        CdmpIdClaimRequestMessage{
            .claiming_device_id = OTHER_PEER_ID, .uid = OTHER_PEER_UID, .protocol_version = OTHER_MAJOR_VERSION }
            .ToCanFrame()
    );
    harness.SendAsPeer(HEARTBEAT, HeartbeatFrame(OTHER_PEER_ID, 0, LOGGER_FEATURES));

    // A heartbeat of a unit that is not in the table makes the unit rediscover the network, which
    // also says that the heartbeat has been processed.
    zassert_true(
        harness.bus.Wait(MANAGEMENT, IsManagement(CdmpManagementMessageType::DISCOVERY_REQUEST)).has_value(),
        "The heartbeat of an unknown unit makes the unit send a discovery request"
    );

    zassert_false(harness.IsInDeviceTable(OTHER_PEER_ID), "The refused claim leaves no pending claim to join on");
    zassert_false(harness.com->IsReachable(OTHER_PEER_ID));

    // Nothing else changes: the unit stays online and keeps its address and its other peer.
    zassert_equal(harness.com->GetNetworkInfo()->GetDeviceInfo().status, CdmpDeviceStatus::ONLINE);
    zassert_equal(harness.com->GetAddress(), OWN_ID);
    zassert_true(harness.com->IsReachable(PEER_ID));
}

// The unit that is refused for its version is the one that cannot be reached over CAN.
ZTEST(canbus_com_reachability, test_unit_refused_for_its_version_has_no_address_and_reaches_no_one) {
    Harness& harness = *harness_under_test;
    zassert_true(harness.com->Start());

    zassert_true(harness.bus.Wait(MANAGEMENT, IsManagement(CdmpManagementMessageType::DISCOVERY_REQUEST)).has_value());
    harness.SendAsPeer(
        MANAGEMENT,
        CdmpDiscoveryResponseMessage{ .device_id = PEER_ID, .uid = PEER_UID, .features = LOGGER_FEATURES }.ToCanFrame()
    );

    auto claim = harness.bus.Wait(MANAGEMENT, IsManagement(CdmpManagementMessageType::ID_CLAIM), STARTUP_TIMEOUT_MS);
    zassert_true(claim.has_value(), "The unit claims an ID after discovery");
    const auto claim_message = CdmpIdClaimRequestMessage::FromCanFrame(claim->data);
    zassert_equal(claim_message.claiming_device_id, OWN_ID);

    // The peer holds the lowest ID and speaks another major version.
    harness.SendAsPeer(
        MANAGEMENT,
        CdmpIdClaimResponseMessage{ .responding_device_id = PEER_ID,
            .claiming_device_id = OWN_ID,
            .claiming_device_uid = claim_message.uid,
            .result = CdmpIdClaimResult::VERSION_INCOMPATIBLE }
            .ToCanFrame()
    );

    zassert_true(harness.WaitForStatus(CdmpDeviceStatus::VERSION_MISMATCH));

    // The network service stops itself from the CDMP work queue and drops its table.
    const int64_t deadline = k_uptime_get() + FRAME_TIMEOUT_MS;
    while(harness.com->GetNetworkInfo()->GetNetworkDeviceCount() != 0) {
        zassert_true(k_uptime_get() < deadline, "The refused unit forgets the network");
        k_msleep(5);
    }

    // The ID is assigned only when a claim succeeds, so the unit has none to bind SMP to.
    zassert_equal(harness.com->GetNetworkInfo()->GetDeviceInfo().device_id, CdmpDevice::DEVICE_ID_UNASSIGNED);
    zassert_equal(harness.com->GetAddress(), 0);
    zassert_false(harness.com->IsSmpBound(), "A unit refused for its version cannot be managed over CAN");
    zassert_false(harness.com->IsReachable(PEER_ID));
    zassert_false(harness.com->IsReachable(OWN_ID));
}
```

## src/canbus_com_state.cpp
```c
#include <algorithm>
#include <array>
#include <cstdint>
#include <span>
#include <utility>
#include <vector>

#include <zephyr/kernel.h>
#include <zephyr/ztest.h>

#include "canbus_com_test_support.h"

using namespace canbus_com_test;

namespace {

constexpr CanbusComStateType LOGGING_STATUS = CanbusComStateType::LOGGING_STATUS;
constexpr uint8_t LOGGING_STATUS_CODE = std::to_underlying(LOGGING_STATUS);
// A second application type, which the handlers of LOGGING_STATUS do not hear about.
constexpr uint8_t OTHER_STATE_TYPE = 0x7F;
constexpr auto OTHER_STATE = static_cast<CanbusComStateType>(OTHER_STATE_TYPE);

// A second unit next to the scripted peer, with an ID above the unit's.
constexpr uint8_t OTHER_PEER_ID = 3;
constexpr uint32_t OTHER_PEER_UID = 0x33333333;

// A state type as an application defines one: it encodes this unit's record and decodes another's.
class TestState : public ICanbusComState {
private:
    uint8_t value_ = 0;

public:
    explicit TestState(uint8_t value) :
        value_(value) {}
    explicit TestState(std::span<const uint8_t> data) :
        value_(data.empty() ? 0 : data[0]) {}

    [[nodiscard]] uint8_t GetValue() const {
        return value_;
    }

    [[nodiscard]] CanbusComStateType GetStateType() const override {
        return LOGGING_STATUS;
    }

    [[nodiscard]] CanbusComStateData GetData() const override {
        const std::array<uint8_t, 1> data = { value_ };
        return CanbusComStateData(data);
    }
};

static_assert(CanbusComState<TestState>);

CanbusComStateData Data(const Bytes& bytes) {
    return CanbusComStateData(bytes);
}

using RemoteStateRecords = std::array<RemoteStateRecord, INetworkStateTransport::MAX_REMOTE_RECORDS>;

/**
 * @brief The unit's next @p notifications.size() notifications, ordered by state type: going online
 * sends every record at once, in an order the test leaves to the unit.
 */
void WaitForNotifications(Harness& harness, std::span<CdmpStateChangeMessage> notifications) {
    for(auto& notification : notifications) {
        auto next = harness.WaitForNotification();
        zassert_true(next.has_value(), "The unit sends each of its records");
        notification = *next;
    }

    std::ranges::sort(notifications, {}, &CdmpStateChangeMessage::state_type);
}

} // namespace

struct canbus_com_state_fixture {
    Harness* harness;
    // Outlives the harness, whose stop may still call the handler.
    HandlerProbe* probe;
};

static void* CanbusComStateSetup() {
    static canbus_com_state_fixture fixture{};

    return &fixture;
}

static void CanbusComStateBefore(void* data) {
    auto* fixture = static_cast<canbus_com_state_fixture*>(data);
    fixture->probe = new HandlerProbe();
    fixture->harness = new Harness();
}

static void CanbusComStateAfter(void* data) {
    auto* fixture = static_cast<canbus_com_state_fixture*>(data);

    if(fixture->probe != nullptr)
        fixture->probe->Unregister();

    delete fixture->harness;
    fixture->harness = nullptr;
    delete fixture->probe;
    fixture->probe = nullptr;

    ResetLoopbackDevice();
}

ZTEST_SUITE(canbus_com_state, NULL, CanbusComStateSetup, CanbusComStateBefore, CanbusComStateAfter, NULL);

ZTEST_F(canbus_com_state, test_state_set_before_start_is_announced_on_online) {
    Harness& harness = *fixture->harness;
    // Initialized but not started: the record waits for the first ONLINE.
    zassert_true(harness.Transport().SetLocalState(LOGGING_STATUS, Data({ 0x01, 0x00 })));

    harness.BringOnline();

    auto notification = harness.WaitForNotification();
    zassert_true(notification.has_value(), "The unit announces its record on going online");
    zassert_equal(notification->source_device_id, OWN_ID);
    zassert_equal(notification->version, 1, "The first change of the unit is version 1");
    zassert_equal(notification->state_type, 0x10, "LOGGING_STATUS is state type 0x10 on the wire");
    zassert_true(notification->data == Data({ 0x01, 0x00 }));
}

ZTEST_F(canbus_com_state, test_typed_state_is_shared_and_withdrawn) {
    Harness& harness = *fixture->harness;
    harness.BringOnline();
    harness.Settle();

    zassert_true(harness.Transport().SetLocalState(TestState(0x05)));

    auto change = harness.WaitForNotification();
    zassert_true(change.has_value(), "A typed state goes out as its type and data");
    zassert_equal(change->state_type, LOGGING_STATUS_CODE);
    zassert_equal(TestState(change->data.GetData()).GetValue(), 0x05, "and decodes from the data");
    harness.SendAsPeer(STATE_CHANGE_RESPONSE, AcknowledgementFrame(PEER_ID, OWN_ID, change->version));

    zassert_true(harness.Transport().SetLocalState(TestState(0x05)));
    zassert_false(
        harness.WaitForNotification(NO_FRAME_TIMEOUT_MS).has_value(), "Setting the current value again sends nothing"
    );

    harness.Transport().ClearLocalState(LOGGING_STATUS);

    auto withdrawal = harness.WaitForNotification();
    zassert_true(withdrawal.has_value(), "Clearing the state withdraws the record");
    zassert_equal(withdrawal->state_type, LOGGING_STATUS_CODE);
    zassert_equal(withdrawal->version, change->version + 1);
    zassert_true(withdrawal->data.IsEmpty(), "with a notification without data");
}

ZTEST_F(canbus_com_state, test_handler_runs_on_registration_and_on_each_change) {
    Harness& harness = *fixture->harness;
    HandlerProbe& probe = *fixture->probe;

    // Before the start: the CDMP work queue runs from Initialize().
    probe.Register(harness.Transport(), LOGGING_STATUS);

    auto first = probe.WaitForCall();
    zassert_true(first.has_value(), "A new handler is called once, so that it catches up");
    zassert_true(first->empty(), "There are no records yet");
    zassert_false(probe.WaitForCall(NO_FRAME_TIMEOUT_MS).has_value(), "Only once");

    harness.BringOnline();
    harness.Settle();
    zassert_false(probe.WaitForCall(NO_FRAME_TIMEOUT_MS).has_value(), "Going online changes no record");

    harness.SendAsPeer(STATE_CHANGE, NotificationFrame(PEER_ID, 1, LOGGING_STATUS_CODE, { 0x01 }));

    auto added = probe.WaitForCall();
    zassert_true(added.has_value(), "Called when another unit adds a record");
    zassert_equal(added->size(), 1, "The handler reads the record it is called for");
    zassert_equal(added->at(0).device_id, PEER_ID);
    zassert_true(added->at(0).data == Data({ 0x01 }));

    // A duplicate, a new version of the same value, and a record of another type.
    harness.SendAsPeer(STATE_CHANGE, NotificationFrame(PEER_ID, 1, LOGGING_STATUS_CODE, { 0x01 }));
    harness.SendAsPeer(STATE_CHANGE, NotificationFrame(PEER_ID, 2, LOGGING_STATUS_CODE, { 0x01 }));
    harness.SendAsPeer(STATE_CHANGE, NotificationFrame(PEER_ID, 3, OTHER_STATE_TYPE, { 0x07 }));
    zassert_true(harness.WaitForAcknowledgement(PEER_ID, 3), "The unit applied all three");
    zassert_false(
        probe.WaitForCall(NO_FRAME_TIMEOUT_MS).has_value(), "Not called when the data of its type stays the same"
    );

    harness.SendAsPeer(STATE_CHANGE, NotificationFrame(PEER_ID, 4, LOGGING_STATUS_CODE, { 0x00, 0x01 }));

    auto changed = probe.WaitForCall();
    zassert_true(changed.has_value(), "Called when the record changes");
    zassert_equal(changed->size(), 1);
    zassert_true(changed->at(0).data == Data({ 0x00, 0x01 }));

    harness.SendAsPeer(STATE_CHANGE, NotificationFrame(PEER_ID, 5, LOGGING_STATUS_CODE, {}));

    auto removed = probe.WaitForCall();
    zassert_true(removed.has_value(), "Called when the record is withdrawn");
    zassert_true(removed->empty());

    zassert_true(probe.CallsWereAsRegistered(), "Every call ran on the CDMP work queue, with its own type");

    probe.Unregister();
    harness.SendAsPeer(STATE_CHANGE, NotificationFrame(PEER_ID, 6, LOGGING_STATUS_CODE, { 0x01 }));
    zassert_true(harness.WaitForAcknowledgement(PEER_ID, 6));
    zassert_false(probe.WaitForCall(NO_FRAME_TIMEOUT_MS).has_value(), "Not called once unregistered");
}

ZTEST_F(canbus_com_state, test_remote_states_are_copied_in_device_order) {
    Harness& harness = *fixture->harness;
    harness.BringOnline();
    harness.Settle();
    harness.Join(OTHER_PEER_ID, OTHER_PEER_UID);

    // The higher ID first, so that the order comes from the IDs.
    harness.SendAsPeer(STATE_CHANGE, NotificationFrame(OTHER_PEER_ID, 1, LOGGING_STATUS_CODE, { 0x03 }));
    harness.SendAsPeer(STATE_CHANGE, NotificationFrame(PEER_ID, 1, OTHER_STATE_TYPE, { 0x09 }));
    harness.SendAsPeer(STATE_CHANGE, NotificationFrame(PEER_ID, 2, LOGGING_STATUS_CODE, { 0x01 }));
    zassert_true(harness.WaitForAcknowledgement(PEER_ID, 2), "The unit applied all three");

    RemoteStateRecords records{};
    zassert_equal(
        harness.Transport().GetRemoteStates(LOGGING_STATUS, records), 2, "One record per unit, and none of another type"
    );
    zassert_equal(records[0].device_id, PEER_ID, "Ordered by device ID");
    zassert_true(records[0].data == Data({ 0x01 }));
    zassert_equal(records[1].device_id, OTHER_PEER_ID);
    zassert_true(records[1].data == Data({ 0x03 }));

    std::array<RemoteStateRecord, 1> lowest{};
    zassert_equal(harness.Transport().GetRemoteStates(LOGGING_STATUS, lowest), 1, "As many as fit");
    zassert_equal(lowest[0].device_id, PEER_ID, "from the lowest ID");

    harness.SendAsPeer(STATE_CHANGE, NotificationFrame(PEER_ID, 3, LOGGING_STATUS_CODE, { 0x00 }));
    zassert_true(harness.WaitForAcknowledgement(PEER_ID, 3));
    zassert_true(records[0].data == Data({ 0x01 }), "A copy keeps the values it was taken with");

    RemoteStateRecords later{};
    zassert_equal(harness.Transport().GetRemoteStates(LOGGING_STATUS, later), 2);
    zassert_true(later[0].data == Data({ 0x00 }), "and the next copy has the change");
    zassert_true(later[1].data == Data({ 0x03 }));
}

ZTEST_F(canbus_com_state, test_a_span_of_the_capacity_takes_every_unit) {
    Harness& harness = *fixture->harness;
    HandlerProbe& probe = *fixture->probe;
    harness.BringOnline();
    harness.Settle();

    // Five units share the type, and only the one with the highest ID reports 0x01, as when one of
    // several loggers logs.
    constexpr std::array<uint8_t, 4> JOINED_IDS = { 3, 4, 5, 6 };
    constexpr uint8_t ACTIVE_ID = JOINED_IDS.back();
    static_assert(INetworkStateTransport::MAX_REMOTE_RECORDS > JOINED_IDS.size());

    for(const uint8_t device_id : JOINED_IDS)
        harness.Join(device_id, 0x30000000 + device_id);

    probe.Register(harness.Transport(), LOGGING_STATUS);
    zassert_true(probe.WaitForCall().has_value());

    harness.SendAsPeer(STATE_CHANGE, NotificationFrame(PEER_ID, 1, LOGGING_STATUS_CODE, { 0x00 }));
    for(const uint8_t device_id : JOINED_IDS) {
        const uint8_t value = device_id == ACTIVE_ID ? 0x01 : 0x00;
        harness.SendAsPeer(STATE_CHANGE, NotificationFrame(device_id, 1, LOGGING_STATUS_CODE, { value }));
    }
    // The unit processes the notifications in order, so the last one acknowledged means all applied.
    zassert_true(harness.WaitForAcknowledgement(ACTIVE_ID, 1), "The unit applied all five");

    auto seen = probe.WaitForLastCall();
    zassert_true(seen.has_value(), "The handler hears of the records");
    zassert_equal(seen->size(), 1 + JOINED_IDS.size(), "and reads every unit's record");
    zassert_equal(seen->back().device_id, ACTIVE_ID);
    zassert_true(seen->back().data == Data({ 0x01 }), "including that of the unit with the highest ID");

    RemoteStateRecords records{};
    zassert_equal(harness.Transport().GetRemoteStates(LOGGING_STATUS, records), 1 + JOINED_IDS.size());
    zassert_equal(records[JOINED_IDS.size()].device_id, ACTIVE_ID);

    std::array<RemoteStateRecord, 4> short_span{};
    zassert_equal(
        harness.Transport().GetRemoteStates(LOGGING_STATUS, short_span), short_span.size(), "A shorter span is filled"
    );
    zassert_true(
        std::ranges::none_of(
            short_span,
            [](const auto& record) {
                return record.data == Data({ 0x01 });
            }
        ),
        "and misses the unit with the highest ID, which is why readers take the capacity"
    );
}

ZTEST_F(canbus_com_state, test_local_states_survive_a_restart) {
    Harness& harness = *fixture->harness;
    // Two records before the first ONLINE: LOGGING_STATUS is version 1, the other type version 2.
    zassert_true(harness.Transport().SetLocalState(LOGGING_STATUS, Data({ 0x01 })));
    zassert_true(harness.Transport().SetLocalState(OTHER_STATE, Data({ 0x0A })));
    harness.BringOnline();

    std::array<CdmpStateChangeMessage, 2> announced{};
    WaitForNotifications(harness, announced);
    zassert_equal(announced[0].state_type, LOGGING_STATUS_CODE);
    zassert_equal(announced[0].version, 1);
    zassert_equal(announced[1].state_type, OTHER_STATE_TYPE);
    zassert_equal(announced[1].version, 2);
    for(const auto& notification : announced)
        harness.SendAsPeer(STATE_CHANGE_RESPONSE, AcknowledgementFrame(PEER_ID, OWN_ID, notification.version));
    harness.Settle();

    // What CanbusService's reset and updated handlers do to the COM service on a CAN reconfiguration.
    zassert_true(harness.com->Stop());
    // Only the other type changes while stopped, as version 3; LOGGING_STATUS is left alone.
    zassert_true(harness.Transport().SetLocalState(OTHER_STATE, Data({ 0x0B })));
    harness.bus.Clear();

    harness.BringOnline();

    std::array<CdmpStateChangeMessage, 2> restarted{};
    WaitForNotifications(harness, restarted);
    zassert_equal(restarted[0].state_type, LOGGING_STATUS_CODE, "The record left alone outlives the stop");
    zassert_equal(restarted[0].version, 1, "as it was");
    zassert_true(restarted[0].data == Data({ 0x01 }));
    zassert_equal(restarted[1].state_type, OTHER_STATE_TYPE, "The record changed while stopped is kept");
    zassert_equal(restarted[1].version, 3, "with its change");
    zassert_true(restarted[1].data == Data({ 0x0B }));
}

ZTEST_F(canbus_com_state, test_stop_drops_remote_states_and_keeps_handlers) {
    Harness& harness = *fixture->harness;
    HandlerProbe& probe = *fixture->probe;
    harness.BringOnline();
    harness.Settle();

    probe.Register(harness.Transport(), LOGGING_STATUS);
    zassert_true(probe.WaitForCall().has_value());

    harness.SendAsPeer(STATE_CHANGE, NotificationFrame(PEER_ID, 1, LOGGING_STATUS_CODE, { 0x01 }));
    auto added = probe.WaitForCall();
    zassert_true(added.has_value());
    zassert_equal(added->size(), 1);

    zassert_true(harness.com->Stop());

    auto dropped = probe.WaitForCall();
    zassert_true(dropped.has_value(), "Stopping drops the other units' records, and says so");
    zassert_true(dropped->empty());

    harness.bus.Clear();
    harness.BringOnline();
    harness.Settle();

    harness.SendAsPeer(STATE_CHANGE, NotificationFrame(PEER_ID, 1, LOGGING_STATUS_CODE, { 0x01 }));

    auto again = probe.WaitForCall();
    zassert_true(again.has_value(), "The handler outlives the restart");
    zassert_equal(again->size(), 1);
    zassert_equal(again->at(0).device_id, PEER_ID);
    zassert_true(probe.CallsWereAsRegistered());
}

namespace {

// Fills the controller's free filter slots with a filter no test frame matches, then frees them.
size_t CountFreeControllerFilters() {
    const can_filter unused{ .id = 0x0F0, .mask = CAN_STD_ID_MASK, .flags = 0 };
    std::vector<int> filter_ids;

    int filter_id = 0;
    while((filter_id = can_add_rx_filter(
               LoopbackDevice(), [](const device*, can_frame*, void*) {}, nullptr, &unused
           ))
        >= 0) {

        filter_ids.push_back(filter_id);
    }

    for(const int id : filter_ids)
        can_remove_rx_filter(LoopbackDevice(), id);

    return filter_ids.size();
}

} // namespace

// The CDMP IDs share one filter at the default base, so an online unit with SMP bound leaves the
// rest of the controller's filters to the sensors' CAN routes.
ZTEST_F(canbus_com_state, test_online_unit_takes_two_controller_filters) {
    Harness& harness = *fixture->harness;
    harness.BringOnline();
    harness.Settle();
    zassert_not_equal(harness.com->GetAddress(), 0, "SMP is bound to the claimed ID");

    const size_t used = CONFIG_CAN_LOOPBACK_MAX_FILTERS - CountFreeControllerFilters();
    zassert_equal(used, 2, "CDMP and SMP take %zu controller filters, expected 2", used);
}
```

## src/canbus_com_test_support.h
```c
#pragma once

#include <array>
#include <cstdint>
#include <cstring>
#include <deque>
#include <memory>
#include <optional>
#include <vector>

#include <zephyr/kernel.h>
#include <zephyr/ztest.h>

#include "domain/canbus_com_domain/services/canbus_com_service.h"
#include "domain/canbus_com_domain/services/i_network_state_transport.h"
#include "domain/canbus_com_domain/states/canbus_com_state_data.h"
#include "domain/canbus_com_domain/states/canbus_com_state_type.h"
#include "domain/canbus_com_domain/states/i_canbus_com_state.h"

#include "canbus_com_loopback_harness.h"
#include "cdmp_loopback_harness.h"

namespace canbus_com_test {

using namespace cdmp_loopback_test;
using namespace canbus_com_loopback_test;
using namespace eerie_leap::domain::canbus_com_domain::states;

using eerie_leap::domain::canbus_com_domain::services::CanbusComService;
using eerie_leap::domain::canbus_com_domain::services::INetworkStateTransport;

/** @brief A state handler that keeps the records it read on each call, and where it ran. */
class HandlerProbe {
private:
    k_sem called_{};
    k_mutex lock_{};
    std::deque<std::vector<RemoteStateRecord>> snapshots_;
    INetworkStateTransport* transport_ = nullptr;
    CanbusComStateType state_type_ = CanbusComStateType::LOGGING_STATUS;
    int handler_id_ = -1;
    bool is_off_work_queue_ = false;
    bool is_other_type_ = false;

    void OnStateChanged(CanbusComStateType state_type) {
        const char* thread_name = k_thread_name_get(k_current_get());

        // Read as the importer will, from the handler, with room for every unit's record.
        std::array<RemoteStateRecord, INetworkStateTransport::MAX_REMOTE_RECORDS> records{};
        const size_t count = transport_->GetRemoteStates(state_type, records);

        k_mutex_lock(&lock_, K_FOREVER);
        if(thread_name == nullptr || std::strcmp(thread_name, CDMP_WORK_QUEUE_NAME) != 0)
            is_off_work_queue_ = true;
        if(state_type != state_type_)
            is_other_type_ = true;
        snapshots_.emplace_back(records.begin(), records.begin() + count);
        k_mutex_unlock(&lock_);

        k_sem_give(&called_);
    }

public:
    HandlerProbe() {
        k_sem_init(&called_, 0, K_SEM_MAX_LIMIT);
        k_mutex_init(&lock_);
    }

    void Register(INetworkStateTransport& transport, CanbusComStateType state_type) {
        transport_ = &transport;
        state_type_ = state_type;
        handler_id_ = transport.RegisterStateHandler(state_type, [this](CanbusComStateType type) {
            OnStateChanged(type);
        });
        zassert_true(handler_id_ >= 0, "RegisterStateHandler failed: %d", handler_id_);
    }

    void Unregister() {
        if(handler_id_ < 0)
            return;

        transport_->UnregisterStateHandler(handler_id_);
        handler_id_ = -1;
    }

    /** @brief The records the next call read, or nothing without a call in time. */
    std::optional<std::vector<RemoteStateRecord>> WaitForCall(int timeout_ms = FRAME_TIMEOUT_MS) {
        if(k_sem_take(&called_, K_MSEC(timeout_ms)) != 0)
            return std::nullopt;

        k_mutex_lock(&lock_, K_FOREVER);
        auto snapshot = std::move(snapshots_.front());
        snapshots_.pop_front();
        k_mutex_unlock(&lock_);

        return snapshot;
    }

    /** @brief The records the last of the calls made in time read, or nothing without a call. */
    std::optional<std::vector<RemoteStateRecord>> WaitForLastCall() {
        auto last = WaitForCall();

        // Changes that arrive together may share a call, so the calls are not counted.
        while(auto next = WaitForCall(NO_FRAME_TIMEOUT_MS))
            last = std::move(next);

        return last;
    }

    /** @brief Whether every call ran on the CDMP work queue, with the registered state type. */
    bool CallsWereAsRegistered() {
        k_mutex_lock(&lock_, K_FOREVER);
        const bool is_as_registered = !is_off_work_queue_ && !is_other_type_;
        k_mutex_unlock(&lock_);

        return is_as_registered;
    }
};

} // namespace canbus_com_test
```

## src/logging_network_state.cpp
```c
#include <array>
#include <cstdint>
#include <optional>
#include <span>
#include <utility>
#include <variant>
#include <vector>

#include <zephyr/ztest.h>

#include "network_state_test_support.h"

using namespace network_state_test;

namespace {

using State = LoggingNetworkState::State;

State Active() {
    return State(true);
}

State Inactive(LoggingStatusReason reason) {
    return State(false, reason);
}

LoggingEventsChannel::EventMessage
StatusUpdated(bool is_active, std::optional<LoggingStatusReason> reason = std::nullopt) {
    LoggingEventsChannel::EventMessage event{ .type = LoggingEventType::StatusUpdated };

    event.payload.insert_or_assign(LoggingPayloadType::IsActive, is_active);
    if(reason.has_value())
        event.payload.insert_or_assign(LoggingPayloadType::Reason, static_cast<uint32_t>(*reason));

    return event;
}

State Decode(const Bytes& bytes) {
    return State(std::span<const uint8_t>(bytes));
}

State Combine(const std::vector<State>& states) {
    return LoggingNetworkState::Combine(states);
}

constexpr std::array<LoggingStatusReason, 5> ALL_REASONS = { LoggingStatusReason::Stopped,
    LoggingStatusReason::WriteFailed, LoggingStatusReason::NoSpace, LoggingStatusReason::RotationFailed,
    LoggingStatusReason::Unavailable };

} // namespace

ZTEST_SUITE(logging_network_state, NULL, NULL, NULL, NULL, NULL);

// ======== The record ========

ZTEST(logging_network_state, test_reason_values_are_stable) {
    // The values travel in records and events: appended, never renumbered.
    zassert_equal(static_cast<uint32_t>(LoggingStatusReason::Stopped), 0);
    zassert_equal(static_cast<uint32_t>(LoggingStatusReason::WriteFailed), 1);
    zassert_equal(static_cast<uint32_t>(LoggingStatusReason::NoSpace), 2);
    zassert_equal(static_cast<uint32_t>(LoggingStatusReason::RotationFailed), 3);
    zassert_equal(static_cast<uint32_t>(LoggingStatusReason::Unavailable), 4);
}

ZTEST(logging_network_state, test_record_encodes_flags_and_reason) {
    zassert_equal(Active().GetStateType(), CanbusComStateType::LOGGING_STATUS);
    zassert_equal(std::to_underlying(Active().GetStateType()), 0x10);

    zassert_true(Active().GetData() == Data({ 0x01, 0x00 }), "Active: bit 0 set, no reason");
    zassert_true(Inactive(LoggingStatusReason::Stopped).GetData() == Data({ 0x00, 0x00 }));
    zassert_true(Inactive(LoggingStatusReason::WriteFailed).GetData() == Data({ 0x00, 0x01 }));
    zassert_true(Inactive(LoggingStatusReason::NoSpace).GetData() == Data({ 0x00, 0x02 }));
    zassert_true(Inactive(LoggingStatusReason::RotationFailed).GetData() == Data({ 0x00, 0x03 }));
    zassert_true(Inactive(LoggingStatusReason::Unavailable).GetData() == Data({ 0x00, 0x04 }));

    zassert_true(State(true, LoggingStatusReason::WriteFailed) == Active(), "An active status carries no reason");
    zassert_true(State() == Inactive(LoggingStatusReason::Stopped), "The default is inactive, Stopped");
}

ZTEST(logging_network_state, test_record_round_trips) {
    const State active = Active();
    zassert_true(State(active.GetData().GetData()) == active);
    zassert_true(State(active.GetData().GetData()).IsActive());

    for(const auto reason : ALL_REASONS) {
        const State inactive = Inactive(reason);
        const State decoded(inactive.GetData().GetData());

        zassert_true(decoded == inactive, "Reason %u round-trips", static_cast<unsigned>(reason));
        zassert_false(decoded.IsActive());
        zassert_equal(decoded.GetReason(), reason);
    }
}

ZTEST(logging_network_state, test_decoder_gives_a_missing_reason_its_default) {
    zassert_true(Decode({ 0x01 }) == Active(), "One byte, active");
    zassert_true(Decode({ 0x00 }) == Inactive(LoggingStatusReason::Stopped), "One byte, inactive: Stopped");
    zassert_true(Decode({}) == Inactive(LoggingStatusReason::Stopped), "No byte: the default");
}

ZTEST(logging_network_state, test_decoder_ignores_what_it_does_not_know) {
    zassert_true(
        Decode({ 0x00, 0x03, 0xAA, 0xBB }) == Inactive(LoggingStatusReason::RotationFailed),
        "Four bytes: the trailing two are ignored"
    );
    zassert_true(Decode({ 0x01, 0x02, 0xFF, 0xFF }) == Active(), "Active, whatever follows");
    zassert_true(Decode({ 0xFE, 0x01 }) == Inactive(LoggingStatusReason::WriteFailed), "Flag bits 1-7 are ignored");
    zassert_true(Decode({ 0xFF, 0x00 }) == Active());
}

// ======== The descriptor ========

ZTEST(logging_network_state, test_initial_state_is_inactive_stopped) {
    zassert_true(LoggingNetworkState::Initial() == Inactive(LoggingStatusReason::Stopped));
    zassert_true(LoggingNetworkState::Initial().GetData() == Data({ 0x00, 0x00 }));
}

ZTEST(logging_network_state, test_from_event_maps_the_status) {
    const State stopped = Inactive(LoggingStatusReason::Stopped);

    auto started = LoggingNetworkState::FromEvent(StatusUpdated(true), stopped);
    zassert_true(started.has_value() && *started == Active());

    for(const auto reason : ALL_REASONS) {
        auto inactive = LoggingNetworkState::FromEvent(StatusUpdated(false, reason), Active());
        zassert_true(
            inactive.has_value() && *inactive == Inactive(reason), "Reason %u is kept", static_cast<unsigned>(reason)
        );
    }

    auto without_reason = LoggingNetworkState::FromEvent(StatusUpdated(false), Active());
    zassert_true(without_reason.has_value() && *without_reason == stopped, "No reason reads Stopped");
}

ZTEST(logging_network_state, test_from_event_ignores_events_without_a_status) {
    const LoggingEventsChannel::EventMessage empty{ .type = LoggingEventType::StatusUpdated };
    zassert_false(LoggingNetworkState::FromEvent(empty, Active()).has_value(), "No IsActive");

    LoggingEventsChannel::EventMessage wrong_type = empty;
    wrong_type.payload.insert_or_assign(LoggingPayloadType::IsActive, uint32_t{ 1 });
    zassert_false(LoggingNetworkState::FromEvent(wrong_type, Active()).has_value(), "IsActive is not a bool");
}

ZTEST(logging_network_state, test_cleanup_stop_keeps_the_failure) {
    State record = LoggingNetworkState::Initial();

    auto started = LoggingNetworkState::FromEvent(StatusUpdated(true), record);
    zassert_true(started.has_value());
    record = *started;

    auto failed = LoggingNetworkState::FromEvent(StatusUpdated(false, LoggingStatusReason::WriteFailed), record);
    zassert_true(failed.has_value() && *failed == Inactive(LoggingStatusReason::WriteFailed));
    record = *failed;

    // The owner's Stop() after the failure.
    zassert_false(
        LoggingNetworkState::FromEvent(StatusUpdated(false, LoggingStatusReason::Stopped), record).has_value(),
        "Stopped does not replace WriteFailed"
    );
    zassert_false(
        LoggingNetworkState::FromEvent(StatusUpdated(false), record).has_value(), "Nor does a stop without a reason"
    );

    auto other_failure = LoggingNetworkState::FromEvent(StatusUpdated(false, LoggingStatusReason::NoSpace), record);
    zassert_true(
        other_failure.has_value() && *other_failure == Inactive(LoggingStatusReason::NoSpace), "Another failure does"
    );

    auto restarted = LoggingNetworkState::FromEvent(StatusUpdated(true), record);
    zassert_true(restarted.has_value() && *restarted == Active(), "A start clears the failure");
    record = *restarted;

    auto stopped = LoggingNetworkState::FromEvent(StatusUpdated(false, LoggingStatusReason::Stopped), record);
    zassert_true(
        stopped.has_value() && *stopped == Inactive(LoggingStatusReason::Stopped), "and the next stop is Stopped again"
    );
}

ZTEST(logging_network_state, test_combine_without_records_is_unavailable) {
    zassert_true(Combine({}) == Inactive(LoggingStatusReason::Unavailable));
}

ZTEST(logging_network_state, test_combine_is_active_while_any_unit_logs) {
    zassert_true(Combine({ Active() }) == Active());
    zassert_true(
        Combine({ Inactive(LoggingStatusReason::WriteFailed), Inactive(LoggingStatusReason::Stopped), Active() })
            == Active(),
        "A failure of a lower ID does not hide a unit that logs"
    );
}

ZTEST(logging_network_state, test_combine_prefers_the_failure_of_the_lowest_id) {
    zassert_true(Combine({ Inactive(LoggingStatusReason::Stopped) }) == Inactive(LoggingStatusReason::Stopped));
    zassert_true(
        Combine({ Inactive(LoggingStatusReason::Stopped), Inactive(LoggingStatusReason::Stopped) })
        == Inactive(LoggingStatusReason::Stopped)
    );

    zassert_true(
        Combine({ Inactive(LoggingStatusReason::Stopped), Inactive(LoggingStatusReason::NoSpace) })
            == Inactive(LoggingStatusReason::NoSpace),
        "A failure is preferred over Stopped"
    );

    // The records come ordered by device ID, so the first failure is the lowest ID's, whatever the
    // reason's value.
    zassert_true(
        Combine(
            { Inactive(LoggingStatusReason::Stopped), Inactive(LoggingStatusReason::RotationFailed),
                Inactive(LoggingStatusReason::WriteFailed) }
        ) == Inactive(LoggingStatusReason::RotationFailed),
        "The lowest ID wins over a lower reason"
    );
    zassert_true(
        Combine(
            { Inactive(LoggingStatusReason::Stopped), Inactive(LoggingStatusReason::WriteFailed),
                Inactive(LoggingStatusReason::RotationFailed) }
        ) == Inactive(LoggingStatusReason::WriteFailed),
        "and over a higher one"
    );

    zassert_true(
        Combine({ Inactive(LoggingStatusReason::Unavailable), Inactive(static_cast<LoggingStatusReason>(0x7F)) })
            == Inactive(LoggingStatusReason::Stopped),
        "A reason that is not a failure counts as Stopped"
    );
}

ZTEST(logging_network_state, test_to_event_is_published_as_the_log_writer_does) {
    auto active = LoggingNetworkState::ToEvent(Active());
    zassert_equal(active.type, LoggingEventType::StatusUpdated);
    zassert_equal(active.source_id, 0, "The importer sets the source");
    zassert_true(std::get<bool>(active.payload.at(LoggingPayloadType::IsActive)));
    zassert_false(active.payload.contains(LoggingPayloadType::Reason), "No reason while active");

    auto unavailable = LoggingNetworkState::ToEvent(Inactive(LoggingStatusReason::Unavailable));
    zassert_equal(unavailable.type, LoggingEventType::StatusUpdated);
    zassert_false(std::get<bool>(unavailable.payload.at(LoggingPayloadType::IsActive)));
    zassert_equal(
        std::get<uint32_t>(unavailable.payload.at(LoggingPayloadType::Reason)),
        static_cast<uint32_t>(LoggingStatusReason::Unavailable)
    );

    // What a unit imports is what its consumers would map back.
    for(const auto reason : ALL_REASONS) {
        auto mapped = LoggingNetworkState::FromEvent(LoggingNetworkState::ToEvent(Inactive(reason)), Active());
        zassert_true(mapped.has_value() && *mapped == Inactive(reason));
    }
}
```
