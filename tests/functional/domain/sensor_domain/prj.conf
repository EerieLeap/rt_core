## CMakeLists.txt
```
cmake_minimum_required(VERSION 3.20.0)

set(RT_CORE_TEST_SIM_FLASH ON)
set(RT_CORE_TEST_ADC_EMUL ON)
# The CAN controller the frame router listens on, on every board; boards/ holds the native_sim flash only.
list(APPEND EXTRA_DTC_OVERLAY_FILE "${CMAKE_CURRENT_SOURCE_DIR}/can_loopback.overlay")
include(${CMAKE_CURRENT_SOURCE_DIR}/../../../rt_core_test.cmake)

find_package(Zephyr REQUIRED HINTS $ENV{ZEPHYR_BASE})
project(functional_sensor_domain)

file(GLOB_RECURSE TEST_SOURCES src/*.c src/*.cpp)

target_sources(app PRIVATE ${TEST_SOURCES})

# Set by the raised_publisher_stack scenario (testcase.yaml): the throwing filter case must run there.
if(RT_CORE_TEST_RAISED_PUBLISHER_STACK)
    target_compile_definitions(app PRIVATE RT_CORE_TEST_RAISED_PUBLISHER_STACK)
endif()

# allocation_counter.h
target_include_directories(app PRIVATE ${CMAKE_CURRENT_SOURCE_DIR}/../../../common)
```

## Kconfig
```
menu "Zephyr"
source "Kconfig.zephyr"
endmenu

config EERIE_LEAP_HW_VERSION_MAJOR
	int "Hardware version major"
	range 0 255
	default 0

config EERIE_LEAP_HW_VERSION_MINOR
	int "Hardware version minor"
	range 0 255
	default 0

config EERIE_LEAP_HW_VERSION_PATCH
	int "Hardware version patch"
	range 0 65535
	default 0

config EERIE_LEAP_SW_VERSION_MAJOR
	int "Software version major"
	range 0 255
	default 0

config EERIE_LEAP_SW_VERSION_MINOR
	int "Software version minor"
	range 0 255
	default 0

config EERIE_LEAP_SW_VERSION_PATCH
	int "Software version patch"
	range 0 65535
	default 0

config EERIE_LEAP_SW_VERSION_BUILD
	int "Software build number"
	range 0 255
	default 0

config EERIE_LEAP_LOG_DATA_FILE_PREFIX
	string "Log data files prefix"
	default "log_data"

config EERIE_LEAP_LOG_WRITER_STACK_SIZE
	int "Log writer stack size"
	default 8192

config EERIE_LEAP_FS_SD_THREAD_STACK_SIZE
	int "SD thread stack size"
	default 2048

config EERIE_LEAP_SD_CHECK_INTERVAL_MS
	int "SD check interval ms"
	default 1000
```

## prj.conf
```kconfig
CONFIG_ZTEST=y

# Language and Compiler
CONFIG_CPP=y
CONFIG_PICOLIBC=y
CONFIG_STD_CPP23=y
CONFIG_REQUIRES_FULL_LIBCPP=y
CONFIG_CPP_EXCEPTIONS=y
CONFIG_CPP_RTTI=y

# Memory
CONFIG_HEAP_MEM_POOL_SIZE=100000

# C++ exception unwinding needs considerably more stack than the ztest defaults.
CONFIG_MAIN_STACK_SIZE=8192
CONFIG_ZTEST_STACK_SIZE=8192

# ThreadBase::InitializeStack() falls back to k_thread_stack_alloc() for the processing and
# calibration threads.
CONFIG_THREAD_STACK_INFO=y
CONFIG_DYNAMIC_THREAD=y
CONFIG_DYNAMIC_THREAD_ALLOC=y

# Logging And Debugging
CONFIG_LOG=y
CONFIG_TEST_RANDOM_GENERATOR=y
CONFIG_THREAD_ANALYZER=y
CONFIG_THREAD_ANALYZER_USE_LOG=y
CONFIG_THREAD_NAME=y
CONFIG_SYS_HEAP_RUNTIME_STATS=y
CONFIG_THREAD_ANALYZER_ISR_STACK_USAGE=n
CONFIG_TIMING_FUNCTIONS=y
CONFIG_CRC=y

# FS Config
CONFIG_FLASH=y
CONFIG_FLASH_MAP=y
CONFIG_FILE_SYSTEM=y
CONFIG_FILE_SYSTEM_LITTLEFS=y
CONFIG_FILE_SYSTEM_MKFS=y

CONFIG_ZCBOR=y

# CANBus: the processing service links the CAN frame router.
CONFIG_CAN=y
CONFIG_CAN_FD_MODE=y
CONFIG_CAN_LOOPBACK=y

# The 512 byte default overflows on the 64-bit QEMU targets.
CONFIG_CAN_LOOPBACK_TX_THREAD_STACK_SIZE=2048

CONFIG_EERIE_LEAP_RT_CORE=y
CONFIG_EERIE_LEAP_CONFIGURATION=y
CONFIG_EERIE_LEAP_ADC=y
CONFIG_EERIE_LEAP_CANBUS=y
CONFIG_EERIE_LEAP_DEVICE_TREE=y
CONFIG_EERIE_LEAP_EVENT_BUS=y
CONFIG_EERIE_LEAP_FS=y
CONFIG_EERIE_LEAP_GPIO=y
CONFIG_EERIE_LEAP_LUA_SCRIPT=y
CONFIG_EERIE_LEAP_EXPRESSION_ENGINE=y
CONFIG_EERIE_LEAP_RANDOM=y
CONFIG_EERIE_LEAP_TIME=y

CONFIG_EERIE_LEAP_DOMAIN_ADC=y
CONFIG_EERIE_LEAP_DOMAIN_CANBUS=y
CONFIG_EERIE_LEAP_DOMAIN_SENSOR=y
```

## boards/native_sim.conf
```kconfig
CONFIG_FLASH_SIMULATOR=y
CONFIG_ADC=y
CONFIG_ADC_EMUL=y

# The emulated GPIO controller (gpio_emul) drives the indicator conditioning cases.
CONFIG_GPIO=y
```

## src/adc_apply_restart.cpp
```c
// An ADC configuration applied while sensors run takes effect through a processing restart: the
// running generation keeps the snapshot and calibrators it was built with until then, the next one
// gets the new ones, and the old calibrators go with the old generation.
#include <array>
#include <chrono>
#include <cmath>
#include <memory>
#include <vector>

#include <zephyr/kernel.h>
#include <zephyr/ztest.h>

#include "configuration/cbor/cbor_serializer.h"
#include "domain/sensor_domain/models/reading_status.h"
#include "subsys/threading/work_queue_thread.h"

#include "processing_test_support.h"

using namespace eerie_leap::subsys::threading;
using namespace eerie_leap::domain::sensor_domain::models;

using namespace processing_test_support;

ZTEST_SUITE(adc_apply_restart, NULL, NULL, NULL, NULL, NULL);

namespace {

// What SensorsController does with the ADC configuration manager's handler, split in two so the
// test decides when the queued restart runs: the handler only reports the apply.
struct Restarter {
    std::shared_ptr<SensorsProcessingService> processing_service;
    k_sem applied;
    k_sem restarted;
    bool is_restarted = false;

    static WorkQueueTaskResult Restart(Restarter* restarter) {
        restarter->is_restarted = restarter->processing_service->Stop() && restarter->processing_service->Start();
        k_sem_give(&restarter->restarted);

        return {};
    }
};

struct ObservedReading {
    std::chrono::system_clock::time_point timestamp;
    ReadingStatus status{};
    float voltage{};
};

} // namespace

ZTEST(adc_apply_restart, test_ApplyCborConfiguration_restarts_processing_with_the_new_calibrator) {
    const auto fs_service = MakeFormattedFsService();

    const auto adc = MakeEmulator();
    const auto adc_manager = MakeAdcManager(adc);
    DriveConstant(*adc, 0, 1000);

    // Calibrator A takes the reading as it is; B recorded 2.5 V for a true 5 V input, so it doubles.
    auto calibrator_a = MakeCalibrator({ { 0.0F, 0.0F }, { 5.0F, 5.0F } });
    const auto calibrator_b = MakeCalibrator({ { 0.0F, 0.0F }, { 5.0F, 2.5F } });
    const float volts_a = calibrator_a->InterpolateToCalibratedRange(1.0F);
    const float volts_b = calibrator_b->InterpolateToCalibratedRange(1.0F);
    constexpr float TOLERANCE = 0.02F;
    zassert_true(volts_b - volts_a > 0.5F, "A and B must be told apart");

    const auto adc_configuration_manager = MakeAdcConfigurationManager(fs_service, adc_manager);
    zassert_true(
        adc_configuration_manager->Update(*MakeAdcConfiguration(adc_manager->GetChannelCount(), 8, calibrator_a))
    );

    auto rig = MakeProcessingRig(
        fs_service, adc_manager, adc_configuration_manager,
        {
            MakeAnalogSensor("analog", 0, 20),
        },
        adc_manager->GetChannelCount()
    );

    const auto config_thread = std::make_shared<WorkQueueThread>("adc_apply_config", 4096, 5);
    zassert_true(config_thread->Initialize());

    Restarter restarter{ .processing_service = rig.processing_service };
    k_sem_init(&restarter.applied, 0, 1);
    k_sem_init(&restarter.restarted, 0, 1);
    auto restart_task = config_thread->CreateTask(Restarter::Restart, &restarter);

    adc_configuration_manager->RegisterConfigurationUpdatedHandler([&restarter] {
        k_sem_give(&restarter.applied);
    });

    zassert_true(rig.processing_service->Start());

    // The generation owns its snapshot of the configuration, and through it A's calibrators.
    auto generation_a = rig.processing_service->GetGeneration();
    zassert_not_null(generation_a.get());
    zassert_not_null(generation_a->adc_configuration.get());
    zassert_equal(generation_a->adc_configuration, adc_configuration_manager->Get());
    const std::weak_ptr<const AdcCalibrator> calibrator_a_weak =
        generation_a->adc_configuration->channel_configurations->at(0)->calibrator;

    // Every committed reading, told apart by its tick's timestamp.
    std::array<ObservedReading, 256> observed;
    size_t observed_count = 0;
    const auto observe_until = [&](size_t count, int timeout_ms) {
        const int64_t end = k_uptime_get() + timeout_ms;
        while(k_uptime_get() < end && observed_count < count) {
            const auto reading = rig.frame->TryGetReading("analog");
            if(reading.has_value()
                && reading->timestamp.has_value()
                && (observed_count == 0 || observed[observed_count - 1].timestamp != reading->timestamp.value())) {

                observed[observed_count++] = { .timestamp = reading->timestamp.value(),
                    .status = reading->status,
                    .voltage = reading->calibrated_voltage.value_or(0.0F) };
            }

            k_msleep(2);
        }
    };

    observe_until(3, 1000);
    const size_t observed_before_apply = observed_count;
    zassert_true(observed_before_apply >= 2, "Processing runs with A before the apply");

    // The client's apply: the stored configuration with channel 0 recalibrated to B.
    eerie_leap::configuration::cbor::CborSerializer<CborAdcConfig> serializer;
    auto cbor_config = serializer.Deserialize(adc_configuration_manager->GetCborConfiguration());
    zassert_not_null(cbor_config.get());
    cbor_config->CborAdcChannelConfig_m.at(0).calibration_table.float32float.back().float32float = 2.5F;
    zassert_true(adc_configuration_manager->ApplyCborConfiguration(serializer.Serialize(*cbor_config)));
    zassert_ok(k_sem_take(&restarter.applied, K_NO_WAIT), "The apply reported itself");

    // Until the restart runs, the generation keeps reading with its own snapshot.
    zassert_not_equal(
        generation_a->adc_configuration, adc_configuration_manager->Get(),
        "The apply swapped the manager's configuration, not the generation's"
    );
    observe_until(observed_before_apply + 2, 1000);
    const size_t observed_before_restart = observed_count;
    zassert_true(
        observed_before_restart - observed_before_apply >= 2, "Processing ran between the apply and the restart"
    );
    zassert_equal(rig.processing_service->GetGeneration(), generation_a);

    for(size_t i = observed_before_apply; i < observed_before_restart; i++)
        zassert_within(observed[i].voltage, volts_a, TOLERANCE, "reading %zu after the apply is not A", i);

    restart_task.Reschedule(K_NO_WAIT);
    zassert_ok(k_sem_take(&restarter.restarted, K_SECONDS(2)), "The restart ran");
    zassert_true(restarter.is_restarted);

    const auto generation_b = rig.processing_service->GetGeneration();
    zassert_not_null(generation_b.get());
    zassert_not_equal(generation_b, generation_a);
    zassert_equal(generation_b->adc_configuration, adc_configuration_manager->Get(), "The new generation snapshots B");

    // Nothing but the dropped generation kept A's calibrators: they go with it, while B runs.
    generation_a.reset();
    calibrator_a.reset();
    zassert_true(calibrator_a_weak.expired(), "A's calibrators lived as long as its generation");

    observe_until(observed_before_restart + 3, 1000);

    adc_configuration_manager->RegisterConfigurationUpdatedHandler(nullptr);
    zassert_true(rig.processing_service->Stop());
    restart_task.Cancel();

    // A … A B … B: never 0 V, never an error, never A again once B has been committed.
    size_t first_b = observed_count;
    for(size_t i = 0; i < observed_count; i++) {
        const auto& reading = observed[i];
        zassert_equal(reading.status, ReadingStatus::PROCESSED, "reading %zu", i);

        const bool is_a = std::abs(reading.voltage - volts_a) < TOLERANCE;
        const bool is_b = std::abs(reading.voltage - volts_b) < TOLERANCE;
        zassert_true(is_a || is_b, "reading %zu: %f V is neither A nor B", i, static_cast<double>(reading.voltage));

        if(is_b && first_b == observed_count)
            first_b = i;

        zassert_false(is_a && first_b < i, "reading %zu went back to A", i);
    }

    zassert_true(first_b >= observed_before_restart, "B only arrives with the restart");
    zassert_true(first_b < observed_count, "The restarted generation reads with B");
    zassert_true(observed_count - first_b >= 2);
}
```

## src/adc_configuration_manager.cpp
```c
#include <algorithm>
#include <array>
#include <memory>
#include <zephyr/kernel.h>
#include <zephyr/ztest.h>

#include "configuration/cbor/cbor_adc_config/cbor_adc_config.h"
#include "configuration/cbor/cbor_serializer.h"
#include "configuration/services/cbor_configuration_service.h"

#include "subsys/device_tree/dt_fs.h"
#include "subsys/fs/services/fs_service.h"

#include "domain/sensor_domain/configuration/adc_configuration_manager.h"

using namespace eerie_leap::utilities::voltage_interpolator;
using namespace eerie_leap::configuration::services;
using namespace eerie_leap::subsys::fs::services;
using namespace eerie_leap::subsys::device_tree;
using namespace eerie_leap::subsys::adc;
using namespace eerie_leap::subsys::adc::utilities;
using namespace eerie_leap::subsys::adc::models;
using namespace eerie_leap::domain::sensor_domain::configuration;

ZTEST_SUITE(adc_configuration_manager, NULL, NULL, NULL, NULL, NULL);

AdcConfiguration adc_configuration_manager_GetTestConfiguration() {
    std::pmr::vector<CalibrationData> adc_calibration_data_samples {
        {0.0, 0.0},
        {5.0, 5.0}
    };

    auto adc_calibration_data_samples_ptr = std::make_shared<std::pmr::vector<CalibrationData>>(adc_calibration_data_samples);
    auto adc_calibrator = std::make_shared<AdcCalibrator>(InterpolationMethod::LINEAR, adc_calibration_data_samples_ptr);

    auto adc_channel_configuration = std::make_shared<AdcChannelConfiguration>(adc_calibrator);

    std::vector<std::shared_ptr<AdcChannelConfiguration>> channel_configurations;
    channel_configurations.reserve(8);
    for(int i = 0; i < 8; i++)
        channel_configurations.push_back(adc_channel_configuration);

    AdcConfiguration adc_configuration;
    adc_configuration.samples = 40;
    adc_configuration.channel_configurations =
        std::make_shared<std::vector<std::shared_ptr<AdcChannelConfiguration>>>(channel_configurations);

    return adc_configuration;
}

ZTEST(adc_configuration_manager, test_AdcConfigurationManager_Save_config_successfully_saved) {
    DtFs::InitInternalFs();
    auto fs_service = std::make_shared<FsService>(DtFs::GetInternalFsMp());

    fs_service->Format();

    AdcFactory adc_factory(nullptr);
    auto adc_manager = adc_factory.Create();
    adc_manager->Initialize();

    auto adc_configuration_service = std::make_unique<CborConfigurationService<CborAdcConfig>>("adc_config", fs_service);
    auto adc_configuration_manager = std::make_shared<AdcConfigurationManager>(
        std::move(adc_configuration_service), adc_manager);

    auto adc_configuration = adc_configuration_manager_GetTestConfiguration();

    bool result = adc_configuration_manager->Update(adc_configuration);
    zassert_true(result);

    adc_manager = adc_configuration_manager->Get();

    for(int i = 0; i < adc_manager->GetChannelCount(); i++) {
        auto adc_channel_configuration = adc_manager->GetChannelConfiguration(i);

        zassert_true(adc_channel_configuration->calibrator != nullptr);
        zassert_equal(adc_channel_configuration->calibrator->GetInterpolationMethod(), InterpolationMethod::LINEAR);

        auto calibration_table = adc_channel_configuration->calibrator->GetCalibrationTable();
        zassert_equal(calibration_table->size(), 2);
        zassert_equal(calibration_table->at(0).voltage, 0.0);
        zassert_equal(calibration_table->at(0).value, 0.0);
        zassert_equal(calibration_table->at(1).voltage, 5.0);
        zassert_equal(calibration_table->at(1).value, 5.0);
    }
}

ZTEST(adc_configuration_manager, test_AdcConfigurationManager_Save_config_and_Load) {
    DtFs::InitInternalFs();
    auto fs_service = std::make_shared<FsService>(DtFs::GetInternalFsMp());

    fs_service->Format();

    AdcFactory adc_factory(nullptr);
    auto adc_manager = adc_factory.Create();
    adc_manager->Initialize();

    auto adc_configuration_service = std::make_unique<CborConfigurationService<CborAdcConfig>>("adc_config", fs_service);
    auto adc_configuration_manager = std::make_shared<AdcConfigurationManager>(
        std::move(adc_configuration_service), adc_manager);

    auto adc_configuration = adc_configuration_manager_GetTestConfiguration();

    bool result = adc_configuration_manager->Update(adc_configuration);
    zassert_true(result);

    adc_configuration_service = std::make_unique<CborConfigurationService<CborAdcConfig>>("adc_config", fs_service);
    adc_configuration_manager = nullptr;
    adc_configuration_manager = std::make_shared<AdcConfigurationManager>(
        std::move(adc_configuration_service), adc_manager);

    adc_manager = adc_configuration_manager->Get();

    for(int i = 0; i < adc_manager->GetChannelCount(); i++) {
        auto adc_channel_configuration = adc_manager->GetChannelConfiguration(i);

        zassert_true(adc_channel_configuration->calibrator != nullptr);
        zassert_equal(adc_channel_configuration->calibrator->GetInterpolationMethod(), InterpolationMethod::LINEAR);

        auto calibration_table = adc_channel_configuration->calibrator->GetCalibrationTable();
        zassert_equal(calibration_table->size(), 2);
        zassert_equal(calibration_table->at(0).voltage, 0.0);
        zassert_equal(calibration_table->at(0).value, 0.0);
        zassert_equal(calibration_table->at(1).voltage, 5.0);
        zassert_equal(calibration_table->at(1).value, 5.0);
    }
}

ZTEST(adc_configuration_manager, test_AdcConfigurationManager_ApplyCborConfiguration_accepts_an_unordered_table) {
    DtFs::InitInternalFs();
    auto fs_service = std::make_shared<FsService>(DtFs::GetInternalFsMp());

    fs_service->Format();

    AdcFactory adc_factory(nullptr);
    auto adc_manager = adc_factory.Create();
    adc_manager->Initialize();

    auto adc_configuration_manager = std::make_shared<AdcConfigurationManager>(
        std::make_unique<CborConfigurationService<CborAdcConfig>>("adc_config", fs_service), adc_manager);
    zassert_true(adc_configuration_manager->Update(adc_configuration_manager_GetTestConfiguration()));

    // The import is stored as received, so the ordering has to come from parsing it.
    eerie_leap::configuration::cbor::CborSerializer<CborAdcConfig> serializer;
    auto exported = adc_configuration_manager->GetCborConfiguration();
    auto cbor_config = serializer.Deserialize(exported);
    zassert_not_null(cbor_config.get());

    for(auto& adc_channel_config : cbor_config->CborAdcChannelConfig_m) {
        adc_channel_config.calibration_table.float32float.back().float32float = 4.0F;
        std::ranges::reverse(adc_channel_config.calibration_table.float32float);
    }

    zassert_true(adc_configuration_manager->ApplyCborConfiguration(serializer.Serialize(*cbor_config)));

    auto expect_imported_configuration = [](const std::shared_ptr<IAdcManager>& imported_adc_manager) {
        zassert_not_null(imported_adc_manager.get());

        for(int i = 0; i < imported_adc_manager->GetChannelCount(); i++) {
            auto calibration_table = imported_adc_manager->GetChannelConfiguration(i)->calibrator->GetCalibrationTable();

            zassert_equal(calibration_table->size(), 2);
            zassert_equal(calibration_table->at(0).voltage, 0.0F);
            zassert_equal(calibration_table->at(1).voltage, 5.0F);
            zassert_equal(calibration_table->at(1).value, 4.0F);
        }
    };

    expect_imported_configuration(adc_configuration_manager->Get());

    auto reloaded_adc_configuration_manager = std::make_shared<AdcConfigurationManager>(
        std::make_unique<CborConfigurationService<CborAdcConfig>>("adc_config", fs_service), adc_manager);

    expect_imported_configuration(reloaded_adc_configuration_manager->Get());
}

ZTEST(adc_configuration_manager, test_AdcConfigurationManager_ApplyCborConfiguration_reports_why_it_rejects) {
    DtFs::InitInternalFs();
    auto fs_service = std::make_shared<FsService>(DtFs::GetInternalFsMp());

    fs_service->Format();

    AdcFactory adc_factory(nullptr);
    auto adc_manager = adc_factory.Create();
    adc_manager->Initialize();

    auto adc_configuration_manager = std::make_shared<AdcConfigurationManager>(
        std::make_unique<CborConfigurationService<CborAdcConfig>>("adc_config", fs_service), adc_manager);

    eerie_leap::configuration::cbor::CborSerializer<CborAdcConfig> serializer;
    const auto exported = adc_configuration_manager->GetCborConfiguration();
    auto cbor_config = serializer.Deserialize(exported);
    zassert_not_null(cbor_config.get());
    cbor_config->samples = 0;

    std::array<char, 96> reason{};
    zassert_false(adc_configuration_manager->ApplyCborConfiguration(serializer.Serialize(*cbor_config), reason));
    zassert_str_equal(reason.data(), "Invalid ADC configuration. Samples must be greater than 0.");
}
```

## src/adc_sample_set.cpp
```c
// A rate group's ADC channels: one slot per channel that stays put, one Sample() per ADC per tick.
#include <stdexcept>

#include <zephyr/ztest.h>

#include "domain/sensor_domain/services/adc_sample_set.h"
#include "subsys/adc/adc_types.h"

#include "processing_test_support.h"

using namespace eerie_leap::subsys::adc;
using namespace eerie_leap::domain::sensor_domain::services;

using processing_test_support::FakeAdc;

ZTEST_SUITE(adc_sample_set, NULL, NULL, NULL, NULL, NULL);

ZTEST(adc_sample_set, test_Reserve_twice_for_one_channel_returns_the_same_slot) {
    FakeAdc adc(4);
    AdcSampleSet adc_samples;

    const AdcSample* first = adc_samples.Reserve(2, { .adc = &adc, .local_channel = 2 }, 10);
    const AdcSample* second = adc_samples.Reserve(2, { .adc = &adc, .local_channel = 2 }, 10);

    zassert_not_null(first);
    zassert_equal(first, second, "Two sensors on one channel share one conversion");
    zassert_equal(adc_samples.GetAdcCount(), 1);
    zassert_equal(adc_samples.GetChannelCount(), 1);
}

ZTEST(adc_sample_set, test_Reserve_slots_stay_valid_as_channels_are_added) {
    FakeAdc adc_a(4);
    FakeAdc adc_b(4);
    adc_a.volts_base = 0.25F;
    adc_a.volts_step = 0.5F;
    adc_b.volts_base = 2.0F;
    adc_b.volts_step = 0.125F;

    AdcSampleSet adc_samples;

    // Descending, so every reservation lands before the ones already made.
    const AdcSample* a3 = adc_samples.Reserve(3, { .adc = &adc_a, .local_channel = 3 }, 4);
    const AdcSample* a1 = adc_samples.Reserve(1, { .adc = &adc_a, .local_channel = 1 }, 4);
    const AdcSample* b2 = adc_samples.Reserve(6, { .adc = &adc_b, .local_channel = 2 }, 4);
    const AdcSample* a0 = adc_samples.Reserve(0, { .adc = &adc_a, .local_channel = 0 }, 4);
    const AdcSample* b0 = adc_samples.Reserve(4, { .adc = &adc_b, .local_channel = 0 }, 4);

    zassert_equal(adc_samples.Reserve(3, { .adc = &adc_a, .local_channel = 3 }, 4), a3, "Still channel 3's slot");
    zassert_equal(adc_samples.Reserve(6, { .adc = &adc_b, .local_channel = 2 }, 4), b2);

    adc_samples.Seal();
    adc_samples.Acquire();

    // Every slot holds its own channel's result, wherever its channel was inserted.
    zassert_within(a0->volts, 0.25F, 1e-6F);
    zassert_within(a1->volts, 0.75F, 1e-6F);
    zassert_within(a3->volts, 1.75F, 1e-6F);
    zassert_within(b0->volts, 2.0F, 1e-6F);
    zassert_within(b2->volts, 2.25F, 1e-6F);
}

ZTEST(adc_sample_set, test_Seal_packs_the_channels_ascending) {
    FakeAdc adc(4);
    AdcSampleSet adc_samples;

    (void)adc_samples.Reserve(3, { .adc = &adc, .local_channel = 3 }, 8);
    (void)adc_samples.Reserve(0, { .adc = &adc, .local_channel = 0 }, 16);
    (void)adc_samples.Reserve(2, { .adc = &adc, .local_channel = 2 }, 4);
    (void)adc_samples.Reserve(0, { .adc = &adc, .local_channel = 0 }, 1);

    adc_samples.Seal();
    adc_samples.Acquire();

    zassert_equal(adc.requests, 1);
    zassert_equal(adc.last_channel_count, 3, "Channel 0 is requested once");
    zassert_equal(adc.last_channels[0], 0);
    zassert_equal(adc.last_channels[1], 2);
    zassert_equal(adc.last_channels[2], 3);
    zassert_equal(adc.last_samples, 16, "The largest count any reservation asked for");
}

ZTEST(adc_sample_set, test_Acquire_samples_each_adc_once_and_fills_every_slot) {
    FakeAdc adc_a(4);
    FakeAdc adc_b(2);
    adc_a.volts_base = 1.0F;
    adc_a.volts_step = 0.5F;
    adc_a.failing_channel = 1;
    adc_b.volts_base = 3.0F;

    AdcSampleSet adc_samples;
    const AdcSample* a0 = adc_samples.Reserve(0, { .adc = &adc_a, .local_channel = 0 }, 2);
    const AdcSample* a1 = adc_samples.Reserve(1, { .adc = &adc_a, .local_channel = 1 }, 2);
    const AdcSample* a2 = adc_samples.Reserve(2, { .adc = &adc_a, .local_channel = 2 }, 2);
    const AdcSample* b1 = adc_samples.Reserve(5, { .adc = &adc_b, .local_channel = 1 }, 2);

    adc_samples.Acquire();
    zassert_equal(adc_a.requests + adc_b.requests, 0, "Nothing is sampled before Seal()");

    adc_samples.Seal();
    zassert_equal(adc_samples.GetAdcCount(), 2);
    zassert_equal(adc_samples.GetChannelCount(), 4);

    for(int tick = 1; tick <= 3; tick++) {
        adc_samples.Acquire();

        zassert_equal(adc_a.requests, tick, "One Sample() per ADC per Acquire()");
        zassert_equal(adc_b.requests, tick);
    }

    zassert_equal(adc_a.last_channel_count, 3);
    zassert_equal(adc_b.last_channel_count, 1);

    zassert_equal(a0->error, AdcError::NONE);
    zassert_within(a0->volts, 1.0F, 1e-6F);
    zassert_equal(a1->error, AdcError::DRIVER, "Each slot carries its own status");
    zassert_equal(a1->errno_value, -5);
    zassert_equal(a2->error, AdcError::NONE);
    zassert_within(a2->volts, 2.0F, 1e-6F);
    zassert_equal(b1->error, AdcError::NONE);
    zassert_within(b1->volts, 3.0F, 1e-6F);

    // A recovered channel clears its error on the next tick.
    adc_a.failing_channel = -1;
    adc_samples.Acquire();
    zassert_equal(a1->error, AdcError::NONE);
    zassert_within(a1->volts, 1.5F, 1e-6F);
}

ZTEST(adc_sample_set, test_Acquire_is_one_request_per_tick_on_the_emulator) {
    const auto adc = processing_test_support::MakeEmulator();
    zassert_true(adc->Initialize());
    processing_test_support::DriveConstant(*adc, 1, 1000);
    processing_test_support::DriveConstant(*adc, 3, 2000);

    AdcSampleSet adc_samples;
    const AdcSample* slot3 = adc_samples.Reserve(3, { .adc = adc.get(), .local_channel = 3 }, 32);
    const AdcSample* slot1 = adc_samples.Reserve(1, { .adc = adc.get(), .local_channel = 1 }, 32);
    adc_samples.Seal();

    const uint32_t requests_before = adc->GetStats().requests;
    for(int tick = 0; tick < 5; tick++)
        adc_samples.Acquire();

    zassert_equal(adc->GetStats().requests - requests_before, 5);
    zassert_equal(slot1->error, AdcError::NONE);
    zassert_equal(slot3->error, AdcError::NONE);
    zassert_within(slot1->volts, 1.0F, processing_test_support::EMUL_TOLERANCE);
    zassert_within(slot3->volts, 2.0F, processing_test_support::EMUL_TOLERANCE);
}

ZTEST(adc_sample_set, test_Reserve_after_Seal_throws) {
    FakeAdc adc(4);
    AdcSampleSet adc_samples;
    (void)adc_samples.Reserve(0, { .adc = &adc, .local_channel = 0 }, 1);
    adc_samples.Seal();

    bool is_thrown = false;
    try {
        (void)adc_samples.Reserve(1, { .adc = &adc, .local_channel = 1 }, 1);
    } catch(const std::logic_error&) {
        is_thrown = true;
    }

    zassert_true(is_thrown, "The request spans are built; a new channel would never be sampled");
}

ZTEST(adc_sample_set, test_Reserve_rejects_a_handle_the_adc_cannot_serve) {
    FakeAdc adc(4);
    AdcSampleSet adc_samples;

    bool is_out_of_range_thrown = false;
    try {
        (void)adc_samples.Reserve(4, { .adc = &adc, .local_channel = 4 }, 1);
    } catch(const std::invalid_argument&) {
        is_out_of_range_thrown = true;
    }

    bool is_null_thrown = false;
    try {
        (void)adc_samples.Reserve(0, { .adc = nullptr, .local_channel = 0 }, 1);
    } catch(const std::invalid_argument&) {
        is_null_thrown = true;
    }

    zassert_true(is_out_of_range_thrown);
    zassert_true(is_null_thrown);
    zassert_equal(adc_samples.GetAdcCount(), 0, "A rejected handle reserves nothing");
}

ZTEST(adc_sample_set, test_GetAdc_reports_each_adc_as_reserved) {
    FakeAdc adc_a(4);
    FakeAdc adc_b(2);
    adc_a.volts_base = 0.5F;
    adc_a.volts_step = 0.25F;
    adc_b.volts_base = 3.0F;

    AdcSampleSet adc_samples;

    const AdcSample* a3 = adc_samples.Reserve(3, { .adc = &adc_a, .local_channel = 3 }, 8);
    (void)adc_samples.Reserve(5, { .adc = &adc_b, .local_channel = 1 }, 2);
    (void)adc_samples.Reserve(1, { .adc = &adc_a, .local_channel = 1 }, 16);

    adc_samples.Seal();
    adc_samples.Acquire();

    zassert_equal(adc_samples.GetAdcCount(), 2);

    const auto first = adc_samples.GetAdc(0);
    zassert_equal(first.adc, &adc_a, "In the order the ADCs were first reserved");
    zassert_equal(first.channels.size(), 2);
    zassert_equal(first.channels[0], 1);
    zassert_equal(first.channels[1], 3);
    zassert_equal(first.global_channels.size(), 2, "One global index per reserved channel");
    zassert_equal(first.global_channels[0], 1);
    zassert_equal(first.global_channels[1], 3);
    zassert_equal(first.samples, 16);
    zassert_equal(first.results.size(), 4, "Results are indexed by local channel");
    zassert_equal(&first.results[3], a3, "The view shows the slots the readers hold");
    zassert_within(first.results[1].volts, 0.75F, 1e-6F);
    zassert_within(first.results[3].volts, 1.25F, 1e-6F);

    const auto second = adc_samples.GetAdc(1);
    zassert_equal(second.adc, &adc_b);
    zassert_equal(second.channels.size(), 1);
    zassert_equal(second.channels[0], 1);
    zassert_equal(second.global_channels[0], 5);
    zassert_equal(second.samples, 2);
    zassert_within(second.results[1].volts, 3.0F, 1e-6F);
}

// The PM board's layout: global channel 0 is channel 6 of the first ADC, global channels 1-3 are
// channels 4-6 of the second.
ZTEST(adc_sample_set, test_GetAdc_keeps_the_global_channel_of_each_reservation) {
    FakeAdc unit_1(7);
    FakeAdc unit_2(7);

    AdcSampleSet adc_samples;
    (void)adc_samples.Reserve(3, { .adc = &unit_2, .local_channel = 6 }, 4);
    (void)adc_samples.Reserve(0, { .adc = &unit_1, .local_channel = 6 }, 4);
    (void)adc_samples.Reserve(1, { .adc = &unit_2, .local_channel = 4 }, 4);
    (void)adc_samples.Reserve(3, { .adc = &unit_2, .local_channel = 6 }, 4);
    adc_samples.Seal();

    const auto first = adc_samples.GetAdc(0);
    zassert_equal(first.adc, &unit_2);
    zassert_equal(first.channels.size(), 2);
    zassert_equal(first.channels[0], 4);
    zassert_equal(first.global_channels[0], 1, "Moved with its local channel when 4 went before 6");
    zassert_equal(first.channels[1], 6);
    zassert_equal(first.global_channels[1], 3);

    const auto second = adc_samples.GetAdc(1);
    zassert_equal(second.adc, &unit_1);
    zassert_equal(second.channels.size(), 1);
    zassert_equal(second.channels[0], 6);
    zassert_equal(second.global_channels[0], 0);
}

ZTEST(adc_sample_set, test_Reserve_rejects_one_channel_under_two_global_channels) {
    FakeAdc adc(4);
    AdcSampleSet adc_samples;
    const AdcSample* slot = adc_samples.Reserve(2, { .adc = &adc, .local_channel = 2 }, 1);

    bool is_thrown = false;
    try {
        (void)adc_samples.Reserve(5, { .adc = &adc, .local_channel = 2 }, 1);
    } catch(const std::invalid_argument&) {
        is_thrown = true;
    }

    zassert_true(is_thrown, "A local channel has one global index");
    zassert_equal(adc_samples.Reserve(2, { .adc = &adc, .local_channel = 2 }, 1), slot);
    zassert_equal(adc_samples.GetChannelCount(), 1);
    zassert_equal(adc_samples.GetAdc(0).global_channels[0], 2);
}
```

## src/blank_user_sensors.cpp
```c
// A blank USER sensor, which nothing of its own gives a value, holds what scripts write with
// update_sensor_value(): its ticks carry that value, so the log and its dependents follow it.
#include <array>
#include <memory>
#include <optional>
#include <string_view>
#include <vector>

#include <eerie_memory.hpp>
#include <zephyr/ztest.h>

#include "domain/sensor_domain/models/sensor.h"
#include "domain/sensor_domain/models/sensor_reading.h"
#include "domain/sensor_domain/processors/expression_processor.h"
#include "domain/sensor_domain/processors/reading_pipeline.hpp"
#include "domain/sensor_domain/processors/script_processor.h"
#include "domain/sensor_domain/runtime/sensor_pipeline_builder.h"
#include "domain/sensor_domain/sensor_readers/sensor_reader_user_value_type.h"
#include "domain/sensor_domain/utilities/sensor_readings_frame.hpp"
#include "subsys/time/boot_elapsed_time_provider.h"
#include "subsys/time/rtc_provider.h"
#include "subsys/time/time_service.h"
#include "utilities/memory/memory_resource_manager.h"
#include "utilities/string/string_helpers.h"

using namespace eerie_leap::utilities::memory;
using namespace eerie_leap::subsys::time;
using namespace eerie_leap::domain::sensor_domain::models;
using namespace eerie_leap::domain::sensor_domain::utilities;
using namespace eerie_leap::domain::sensor_domain::runtime;
using namespace eerie_leap::domain::sensor_domain::sensor_readers;
using namespace eerie_leap::domain::sensor_domain::processors;
using eerie_leap::utilities::string::StringHelpers;

ZTEST_SUITE(blank_user_sensors, NULL, NULL, NULL, NULL, NULL);

namespace {

struct Fixture {
    std::shared_ptr<TimeService> time_service;
    std::shared_ptr<SensorReadingsFrame> frame;
    std::shared_ptr<SensorGeneration> generation;
    std::shared_ptr<ReadingPipeline> pipeline;

    const SensorRuntime& Runtime(std::string_view id) const {
        return *generation->Find(StringHelpers::GetHash(id));
    }

    // One tick of the sensor's rate, as RateGroupScheduler runs it.
    void Tick(std::string_view id) {
        const auto& runtime = Runtime(id);
        SensorReaderUserValueType reader(time_service, runtime);

        auto reading = reader.Read({ time_service->GetCurrentTime() });
        pipeline->Process(runtime, reading);
    }

    // What update_sensor_value(id, value) does.
    bool Write(std::string_view id, float value) {
        return frame->UpdateReadingValue(StringHelpers::GetHash(id), value);
    }

    // The sensor's reading as the log writer samples it.
    std::optional<SensorReading> Logged(std::string_view id) const {
        std::array<SensorReading, 8> readings;
        const size_t count = frame->SnapshotLoggableReadings(readings);

        for(size_t i = 0; i < count; i++) {
            if(readings[i].sensor_id_hash == StringHelpers::GetHash(id))
                return readings[i];
        }

        return std::nullopt;
    }
};

std::shared_ptr<Sensor> MakeSensor(std::string_view id, SensorType type) {
    auto sensor = std::make_shared<Sensor>(std::allocator_arg, Mrm::GetDefaultPmr(), id);
    sensor->configuration.type = type;
    sensor->configuration.sampling_rate_ms = 100;

    return sensor;
}

// blank (no script, no expression) -> follower (dependent); with_expression is not blank;
// blank_switch is a blank Toggle indicator, so it has a conditioner.
Fixture MakeFixture() {
    Fixture fixture;

    fixture.time_service = std::make_shared<TimeService>(
        std::make_shared<BootElapsedTimeProvider>(), std::make_shared<RtcProvider>()
    );

    const auto with_expression = MakeSensor("with_expression", SensorType::USER_ANALOG);
    with_expression->configuration.expression = "blank * 2";

    const auto follower = std::make_shared<Sensor>(std::allocator_arg, Mrm::GetDefaultPmr(), "follower");
    follower->configuration.type = SensorType::VIRTUAL_ANALOG;
    follower->configuration.expression = "blank + 1";

    const auto blank_switch = MakeSensor("blank_switch", SensorType::USER_INDICATOR);
    blank_switch->configuration.input_mode = IndicatorInputMode::Toggle;

    const std::vector<std::shared_ptr<Sensor>> sensors = {
        MakeSensor("blank", SensorType::USER_ANALOG),
        with_expression,
        follower,
        blank_switch,
    };

    fixture.frame = std::make_shared<SensorReadingsFrame>();
    fixture.generation = SensorPipelineBuilder(nullptr, fixture.frame)
                             .Build(std::make_shared<const std::vector<std::shared_ptr<Sensor>>>(sensors));

    const auto processors = std::make_shared<std::vector<std::shared_ptr<IReadingProcessor>>>();
    processors->push_back(std::make_shared<ExpressionProcessor>(fixture.frame));
    processors->push_back(std::make_shared<ScriptProcessor>(SensorScript::POST_PROCESS_FUNCTION));
    fixture.pipeline = std::make_shared<ReadingPipeline>(fixture.frame, processors, fixture.time_service);

    return fixture;
}

} // namespace

ZTEST(blank_user_sensors, test_only_a_sensor_without_script_functions_or_expression_is_blank) {
    const auto fixture = MakeFixture();

    zassert_not_null(fixture.Runtime("blank").written_value);
    zassert_not_null(fixture.Runtime("blank_switch").written_value);
    zassert_is_null(fixture.Runtime("with_expression").written_value, "Its expression gives it a value");
    zassert_is_null(fixture.Runtime("follower").written_value, "Not a USER sensor");
}

ZTEST(blank_user_sensors, test_a_tick_carries_the_value_last_written) {
    auto fixture = MakeFixture();

    // Before anything is written the tick commits a reading without a value, which lets a script
    // write the sensor.
    zassert_false(fixture.Write("blank", 1.0F), "No reading yet");
    fixture.Tick("blank");
    zassert_false(fixture.frame->TryGetReadingValue("blank").has_value());
    zassert_true(fixture.Logged("blank").has_value());
    zassert_false(fixture.Logged("blank")->value.has_value());

    zassert_true(fixture.Write("blank", 7.0F));
    zassert_equal(fixture.Logged("blank")->value.value(), 7.0F);

    // The ticks after the write keep it, instead of replacing it with a reading without a value.
    for(int i = 0; i < 3; i++) {
        fixture.Tick("blank");

        const auto logged = fixture.Logged("blank");
        zassert_true(logged.has_value());
        zassert_equal(logged->status, ReadingStatus::PROCESSED);
        zassert_equal(logged->value.value(), 7.0F, "Tick %d logged the value written", i);
        zassert_equal(fixture.frame->TryGetReadingValue("blank").value(), 7.0F);
    }

    zassert_equal(fixture.frame->TryGetReadingValue("follower").value(), 8.0F, "The tick evaluated the dependent");

    zassert_true(fixture.Write("blank", -2.5F));
    fixture.Tick("blank");
    zassert_equal(fixture.Logged("blank")->value.value(), -2.5F);
    zassert_equal(fixture.frame->TryGetReadingValue("follower").value(), -1.5F);
}

// What a script wrote already went past the conditioner: a Toggle would flip on the carried 1
// and hold on the carried 0.
ZTEST(blank_user_sensors, test_a_carried_value_bypasses_the_conditioner) {
    auto fixture = MakeFixture();
    zassert_not_null(fixture.Runtime("blank_switch").conditioner.get());

    fixture.pipeline->CommitStartValues(*fixture.generation);
    zassert_equal(fixture.frame->TryGetReadingValue("blank_switch").value(), 0.0F, "The switch starts off");

    zassert_true(fixture.Write("blank_switch", 1.0F));
    fixture.Tick("blank_switch");
    zassert_equal(fixture.Logged("blank_switch")->value.value(), 1.0F);

    zassert_true(fixture.Write("blank_switch", 0.0F));
    fixture.Tick("blank_switch");
    zassert_equal(fixture.Logged("blank_switch")->value.value(), 0.0F);
}
```

## src/calibration_restart_race.cpp
```c
// Calibration pauses and resumes the processing service from the MCUmgr work queue while a
// configuration apply restarts it from the configuration work queue. The service serializes the
// transitions, so whatever the interleaving, it ends running a generation and sampling.
#include <chrono>
#include <memory>

#include <zephyr/kernel.h>
#include <zephyr/ztest.h>

#include "domain/adc_domain/services/calibration_service.h"

#include "processing_test_support.h"

using eerie_leap::domain::adc_domain::services::CalibrationService;

using namespace processing_test_support;

ZTEST_SUITE(calibration_restart_race, NULL, NULL, NULL, NULL, NULL);

namespace {

constexpr int ROUNDS = 40;
// As in the apps: the configuration queue above processing (6), MCUmgr below it.
constexpr int CONFIG_PRIORITY = 5;
constexpr int MCUMGR_PRIORITY = 7;

K_THREAD_STACK_DEFINE(calibrating_stack, 8192);
K_THREAD_STACK_DEFINE(restarting_stack, 8192);

struct Race {
    std::shared_ptr<SensorsProcessingService> processing_service;
    std::shared_ptr<CalibrationService> calibration_service;
    int jobs = 0;
    int stopped_jobs = 0;
    int restarts = 0;
};

// What START and STOP do, with a job of varying length.
void Calibrate(void* context, void*, void*) {
    auto* race = static_cast<Race*>(context);

    for(int i = 0; i < ROUNDS; i++) {
        if(race->calibration_service->Start(1)) {
            race->jobs++;
            k_msleep(1 + i % 4);
            if(race->calibration_service->Stop())
                race->stopped_jobs++;
        }

        k_msleep(1 + i % 3);
    }
}

// What SensorsController::RestartProcessing() does for every apply. A START that waits for a
// restart gets the service between its Stop() and Start() and is refused, so every few rounds the
// queue idles long enough for a job to start, and the next restart lands inside it.
void Restart(void* context, void*, void*) {
    auto* race = static_cast<Race*>(context);

    for(int i = 0; i < ROUNDS; i++) {
        if(race->processing_service->Stop() && race->processing_service->Start())
            race->restarts++;

        k_msleep(i % 3 == 0 ? 25 : 1 + i % 5);
    }
}

} // namespace

ZTEST(calibration_restart_race, test_calibration_and_restarts_leave_processing_running) {
    const auto fs_service = MakeFormattedFsService();

    const auto adc = MakeEmulator();
    const auto adc_manager = MakeAdcManager(adc);
    DriveConstant(*adc, 0, 1000);
    DriveConstant(*adc, 1, 2000);

    const auto adc_configuration_manager = MakeAdcConfigurationManager(fs_service, adc_manager);
    zassert_true(adc_configuration_manager->Update(
        *MakeAdcConfiguration(adc_manager->GetChannelCount(), 8, MakeCalibrator({ { 0.0F, 0.0F }, { 5.0F, 5.0F } }))
    ));

    const auto rig = MakeProcessingRig(
        fs_service, adc_manager, adc_configuration_manager,
        {
            MakeAnalogSensor("fast", 0, 10),
            MakeAnalogSensor("slow", 0, 30),
        },
        adc_manager->GetChannelCount()
    );

    auto calibration_service = std::make_shared<CalibrationService>(
        rig.time_service, adc_manager, rig.processing_service
    );
    zassert_true(calibration_service->Initialize());

    zassert_true(rig.processing_service->Start());

    Race race{ .processing_service = rig.processing_service, .calibration_service = calibration_service };

    k_thread calibrating;
    k_thread restarting;
    k_thread_create(
        &calibrating, calibrating_stack, K_THREAD_STACK_SIZEOF(calibrating_stack), Calibrate, &race, nullptr, nullptr,
        MCUMGR_PRIORITY, 0, K_NO_WAIT
    );
    k_thread_create(
        &restarting, restarting_stack, K_THREAD_STACK_SIZEOF(restarting_stack), Restart, &race, nullptr, nullptr,
        CONFIG_PRIORITY, 0, K_NO_WAIT
    );

    zassert_ok(k_thread_join(&calibrating, K_SECONDS(30)), "The calibration loop hung");
    zassert_ok(k_thread_join(&restarting, K_SECONDS(30)), "The restart loop hung");

    zassert_equal(race.restarts, ROUNDS, "Every restart completed");
    zassert_true(race.jobs > 0, "Calibration ran between the restarts");
    zassert_equal(race.stopped_jobs, race.jobs, "Every job STOP ended");
    zassert_false(calibration_service->IsRunning());

    // The last restart started it and the last STOP either resumed it or found it taken back.
    zassert_true(rig.processing_service->IsRunning());
    zassert_not_null(rig.processing_service->GetGeneration().get(), "Running with a generation");

    // And it samples: the reading keeps getting newer.
    k_msleep(50);
    const auto before = rig.frame->TryGetReading("fast");
    zassert_true(before.has_value() && before->timestamp.has_value());
    k_msleep(50);
    const auto after = rig.frame->TryGetReading("fast");
    zassert_true(after.has_value() && after->timestamp.has_value());
    zassert_true(after->timestamp.value() > before->timestamp.value(), "Processing samples after the race");

    calibration_service.reset();
    zassert_true(rig.processing_service->Stop());
}
```
