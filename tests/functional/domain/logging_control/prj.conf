## CMakeLists.txt
```
cmake_minimum_required(VERSION 3.20.0)

set(RT_CORE_TEST_SIM_FLASH ON)
# The CAN controller on every board; boards/ holds the native_sim flash only.
list(APPEND EXTRA_DTC_OVERLAY_FILE "${CMAKE_CURRENT_SOURCE_DIR}/can_loopback.overlay")
include(${CMAKE_CURRENT_SOURCE_DIR}/../../../rt_core_test.cmake)

find_package(Zephyr REQUIRED HINTS $ENV{ZEPHYR_BASE})
project(functional_logging_control)

file(GLOB_RECURSE TEST_SOURCES src/*.c src/*.cpp)

target_sources(app PRIVATE ${TEST_SOURCES})

# The CDMP loopback harness, shared with the canbus_com_domain and cdmp_state suites.
target_include_directories(app PRIVATE ${RT_CORE_DIR}/tests/common)
```

## prj.conf
```kconfig
CONFIG_ZTEST=y

# Language and Compiler
CONFIG_CPP=y
CONFIG_PICOLIBC=y
CONFIG_STD_CPP23=y
CONFIG_REQUIRES_FULL_LIBCPP=y
CONFIG_CPP_EXCEPTIONS=y
CONFIG_CPP_RTTI=y

# Memory
CONFIG_HEAP_MEM_POOL_SIZE=200000

# C++ exception unwinding needs considerably more stack than the ztest defaults.
CONFIG_MAIN_STACK_SIZE=8192
CONFIG_ZTEST_STACK_SIZE=8192

# Logging And Debugging
CONFIG_LOG=y
CONFIG_TEST_RANDOM_GENERATOR=y
CONFIG_THREAD_NAME=y

# ThreadBase::InitializeStack() falls back to k_thread_stack_alloc().
CONFIG_THREAD_STACK_INFO=y
CONFIG_DYNAMIC_THREAD=y
CONFIG_DYNAMIC_THREAD_ALLOC=y

# FS Config: the CAN and the logging control configurations are stored on the internal filesystem.
CONFIG_FLASH=y
CONFIG_FLASH_MAP=y
CONFIG_FILE_SYSTEM=y
CONFIG_FILE_SYSTEM_LITTLEFS=y
CONFIG_FILE_SYSTEM_MKFS=y

CONFIG_ZCBOR=y

CONFIG_CRC=y

# MCUmgr's notification hooks, for the writer role's firmware update stop (the case calls them through
# mgmt_callback_notify(); no SMP server runs). The remote role registers nothing for them.
CONFIG_MCUMGR=y
CONFIG_MCUMGR_GRP_OS=y
CONFIG_MCUMGR_MGMT_NOTIFICATION_HOOKS=y
CONFIG_MCUMGR_GRP_OS_RESET_HOOK=y

# CANBus
CONFIG_CAN=y
CONFIG_CAN_FD_MODE=y
CONFIG_CAN_LOOPBACK=y

# The 512 byte default overflows on the 64-bit QEMU targets.
CONFIG_CAN_LOOPBACK_TX_THREAD_STACK_SIZE=2048

CONFIG_EERIE_LEAP_RT_CORE=y
CONFIG_EERIE_LEAP_CONFIGURATION=y
CONFIG_EERIE_LEAP_ADC=y
CONFIG_EERIE_LEAP_CANBUS=y
CONFIG_EERIE_LEAP_CDMP=y
CONFIG_EERIE_LEAP_DEVICE_TREE=y
CONFIG_EERIE_LEAP_EVENT_BUS=y
CONFIG_EERIE_LEAP_FS=y
CONFIG_EERIE_LEAP_GPIO=y
CONFIG_EERIE_LEAP_LUA_SCRIPT=y
CONFIG_EERIE_LEAP_EXPRESSION_ENGINE=y
CONFIG_EERIE_LEAP_RANDOM=y
CONFIG_EERIE_LEAP_THREADING=y
CONFIG_EERIE_LEAP_TIME=y

CONFIG_EERIE_LEAP_DOMAIN_CANBUS=y
CONFIG_EERIE_LEAP_DOMAIN_CANBUS_COM=y
CONFIG_EERIE_LEAP_DOMAIN_SCRIPT=y
CONFIG_EERIE_LEAP_DOMAIN_SENSOR=y

# The configuration-update suites (logging_controller_remote_updates.cpp, ..._writer_updates.cpp) run
# the real sensor pipeline and restart it under the controller.
CONFIG_EERIE_LEAP_CONTROLLER_SENSORS=y

# The logging domain stays off, as on the gauge: the controller takes the remote role. The writer
# scenario turns it on.
CONFIG_EERIE_LEAP_CONTROLLER_LOGGING=y
```

## src/configuration_update_logging_stop.cpp
```c
#include <atomic>
#include <memory>
#include <stdexcept>
#include <vector>

#include <zephyr/ztest.h>

#include "domain/logging_domain/control/configuration_update_logging_stop.h"

#include "logging_controller_test_support.h"

using namespace logging_controller_test;

using eerie_leap::domain::logging_domain::control::ConfigurationUpdateLoggingStop;

// The update rule of L9 on its own: a real configuration service and manager, fakes for the control and
// the sender. The rule runs in every scenario: it belongs to both roles.
namespace {

using Type = ConfigurationService::Type;

// What the update handler saw: the types, and how many requests the control had when it ran.
struct HandlerLog {
    std::vector<Type> types;
    std::vector<size_t> requests_seen;
};

struct Fixture {
    std::shared_ptr<FsService> fs_service;
    std::shared_ptr<ConfigurationService> service = std::make_shared<ConfigurationService>();
    std::shared_ptr<LoggingControlConfigurationManager> manager;
    std::shared_ptr<FakeLoggingControl> control = std::make_shared<FakeLoggingControl>();
    std::shared_ptr<FakeCommandSender> sender = std::make_shared<FakeCommandSender>();
    std::shared_ptr<HandlerLog> handler_log = std::make_shared<HandlerLog>();
    std::unique_ptr<ConfigurationUpdateLoggingStop> stop;

    Fixture() {
        DtFs::InitInternalFs();
        fs_service = std::make_shared<FsService>(DtFs::GetInternalFsMp());
        zassert_true(fs_service->Format(), "The internal file system must format.");

        manager = std::make_shared<LoggingControlConfigurationManager>(
            std::make_unique<CborConfigurationService<CborLoggingControlConfig>>(
                "logging_control_config", fs_service, TestConfigQueue()
            )
        );
        service->RegisterCborConfigurationManager(Type::LoggingControl, manager);
    }

    // Initialized, not started.
    void Build(bool has_control = true, bool has_sender = true, bool has_handler = false) {
        ConfigurationUpdateLoggingStop::UpdateHandler on_update;
        if(has_handler) {
            on_update = [log = handler_log, control = control](Type type) {
                log->types.push_back(type);
                log->requests_seen.push_back(control->Requests().size());
            };
        }

        stop = std::make_unique<ConfigurationUpdateLoggingStop>(
            service, TestConfigQueue(),
            has_control
                ? std::static_pointer_cast<eerie_leap::domain::logging_domain::control::ILoggingControl>(control)
                : nullptr,
            has_sender
                ? std::static_pointer_cast<eerie_leap::domain::logging_domain::control::ILoggingCommandSender>(sender)
                : nullptr,
            std::move(on_update)
        );
        zassert_true(stop->Initialize(), "The update stop did not initialize.");
    }

    // Initialized and started.
    void Start(bool has_control = true, bool has_sender = true, bool has_handler = false) {
        Build(has_control, has_sender, has_handler);
        zassert_true(stop->Start(), "The update stop did not start.");
    }

    // A configuration update, stored on the calling thread.
    void Store(std::initializer_list<std::string_view> sensor_ids = { "a" }) {
        zassert_true(manager->Update(TriggersOn(sensor_ids)), "The configuration was not stored.");
    }

    static bool Flush() {
        return FlushQueue(*TestConfigQueue());
    }
};

Fixture*& Current() {
    static Fixture* fixture = nullptr;

    return fixture;
}

void* SetUp() {
    return SetUpChannels();
}

void Before(void*) {
    Current() = new Fixture();
}

void After(void*) {
    Gate().Open();

    if(Current() != nullptr) {
        // A request or a send a failed case left holding would keep the update stop's destructor waiting.
        Current()->control->Release();
        Current()->sender->Release();
        Current()->stop.reset();
        delete Current();
        Current() = nullptr;
    }
}

Fixture& F() {
    return *Current();
}

} // namespace

ZTEST_SUITE(configuration_update_logging_stop, NULL, SetUp, Before, After, NULL);

ZTEST(configuration_update_logging_stop, test_NothingIsStoppedBeforeStart) {
    F().Build();
    zassert_false(F().stop->IsStarted());

    F().Store();
    zassert_true(F().Flush());

    zassert_equal(F().control->Requests().size(), 0U, "The unit's boot stores stop nothing");
    zassert_equal(F().sender->Sends().size(), 0U);

    zassert_true(F().stop->Start());
    zassert_true(F().stop->IsStarted());
    F().Store();
    zassert_equal(F().control->Requests().size(), 1U, "From Start() on they do");
}

ZTEST(configuration_update_logging_stop, test_AStoreAfterStartStopsOnTheStoringThreadAndBroadcastsFromTheQueue) {
    F().Start();

    F().Store();

    const auto requests = F().control->Requests();
    zassert_equal(requests.size(), 1U, "The stop is requested before the store returns");
    zassert_equal(requests[0].kind, Kind::Stop);
    zassert_equal(requests[0].thread, k_current_get(), "on the thread that stored the configuration");

    zassert_true(F().sender->WaitForSends(1), "and broadcast");
    const auto sends = F().sender->Sends();
    zassert_false(sends[0].is_start, "a stop");
    zassert_equal(sends[0].thread, QueueThread(*TestConfigQueue()), "from the configuration work queue");

    zassert_true(F().Flush());
    zassert_equal(F().sender->Sends().size(), 1U, "once");
}

ZTEST(configuration_update_logging_stop, test_AnSmpApplyStops) {
    F().Start();

    QueuedApply apply(F().service, Type::LoggingControl, TRIGGER_ON_AB);
    zassert_true(apply.WaitForSuccess(), "The write is applied through the service");

    const auto requests = F().control->Requests();
    zassert_equal(requests.size(), 1U);
    zassert_equal(requests[0].kind, Kind::Stop);
    zassert_equal(requests[0].thread, QueueThread(*TestConfigQueue()), "on the thread that applied it");
    zassert_true(F().sender->WaitForSends(1));
}

ZTEST(configuration_update_logging_stop, test_ARejectedApplyStopsNothing) {
    F().Start();

    const std::vector<uint8_t> malformed = { 0xFF, 0x01, 0x02 };
    zassert_false(F().service->ApplyCborConfiguration(Type::LoggingControl, malformed));
    zassert_true(F().Flush());

    zassert_equal(F().control->Requests().size(), 0U, "A rejected write is not an update");
    zassert_equal(F().sender->Sends().size(), 0U);
}

ZTEST(configuration_update_logging_stop, test_UpdateOwnSettingStopsNothing) {
    F().Start();

    zassert_true(F().manager->UpdateOwnSetting(TriggersOn({ "a" })));
    zassert_true(F().Flush());

    zassert_equal(F().control->Requests().size(), 0U, "A unit's own setting is not an update");
    zassert_equal(F().sender->Sends().size(), 0U);
}

// One job stores twice; the broadcast task, queued by the first report, runs only after it.
ZTEST(configuration_update_logging_stop, test_StoresBeforeTheBroadcastRunsSendOneStop) {
    F().Start();

    HeldStore held(F().manager, { { "a" }, { "b" } });
    zassert_true(held.WaitUntilStored());
    zassert_true(held.AllStored());

    zassert_equal(F().control->Requests().size(), 2U, "Each store requests the stop");
    zassert_equal(F().sender->Sends().size(), 0U, "and the broadcast waits behind the job");

    held.Release();
    zassert_true(F().sender->WaitForSends(1));
    zassert_true(F().Flush());
    zassert_equal(F().sender->Sends().size(), 1U, "Several stores before it runs send one stop");
}

ZTEST(configuration_update_logging_stop, test_TheUpdateHandlerRunsBeforeTheStop) {
    F().Start(true, true, true);

    F().Store();

    zassert_equal(F().handler_log->types.size(), 1U);
    zassert_equal(F().handler_log->types[0], Type::LoggingControl, "It is told the type");
    zassert_equal(F().handler_log->requests_seen[0], 0U, "and runs before the stop is requested");
    zassert_equal(F().control->Requests().size(), 1U);
}

ZTEST(configuration_update_logging_stop, test_AnUpdateHandlerThatThrowsStillStops) {
    F().Build(true, true, false);
    // Replaces the stop with one whose handler throws.
    F().stop = std::make_unique<ConfigurationUpdateLoggingStop>(
        F().service, TestConfigQueue(), F().control, F().sender, [](Type) {
            throw std::runtime_error("The handler failed.");
        }
    );
    zassert_true(F().stop->Initialize());
    zassert_true(F().stop->Start());

    F().Store();

    zassert_equal(F().control->Requests().size(), 1U, "The stop follows a handler that failed");
    zassert_true(F().sender->WaitForSends(1));
    zassert_equal(F().manager->Get()->triggers.size(), 1U, "and the store is no failure");
}

ZTEST(configuration_update_logging_stop, test_WithoutAControlOnlyTheStopIsBroadcast) {
    F().Start(false, true);

    F().Store();

    zassert_true(F().sender->WaitForSends(1), "A unit without a logging controller still tells the others");
    zassert_false(F().sender->Sends()[0].is_start);
    zassert_equal(F().control->Requests().size(), 0U);
}

ZTEST(configuration_update_logging_stop, test_WithoutASenderNothingIsBroadcast) {
    F().Start(true, false);

    F().Store();
    zassert_true(F().Flush());

    zassert_equal(F().control->Requests().size(), 1U, "The control stops (a remote control sends the stop itself)");
    zassert_equal(F().sender->Sends().size(), 0U);
}

ZTEST(configuration_update_logging_stop, test_DestructionClearsTheHandlerAndWaitsForAReport) {
    F().Start();
    F().control->HoldRequests();

    // The store runs on the queue, inside the report, which the control holds in RequestStop(ALL_UNITS).
    TestConfigQueue()->Run([manager = F().manager] {
        (void)manager->Update(TriggersOn({ "a" }));
    });
    zassert_true(F().control->WaitUntilHeld(), "The report is inside the control");

    struct Destruction {
        k_sem done{};
        std::unique_ptr<ConfigurationUpdateLoggingStop> stop;
    };
    const auto destruction = std::make_shared<Destruction>();
    k_sem_init(&destruction->done, 0, 1);
    destruction->stop = std::move(F().stop);

    WorkQueueThread helper("update_stop_destroyer", 4096, 5);
    zassert_true(helper.Initialize());
    helper.Run([destruction] {
        destruction->stop.reset();
        k_sem_give(&destruction->done);
    });

    zassert_not_equal(
        k_sem_take(&destruction->done, Ms(NO_WAIT_MS)), 0, "The destructor must wait for the report in progress"
    );

    F().control->Release();
    zassert_equal(k_sem_take(&destruction->done, Ms(WAIT_MS)), 0, "and returns once it is done");

    zassert_true(F().Flush());
    zassert_equal(F().sender->Sends().size(), 0U, "A broadcast still pending is dropped");

    F().Store();
    zassert_true(F().Flush());
    zassert_equal(F().control->Requests().size(), 1U, "and a later store reports nothing");
    zassert_equal(F().sender->Sends().size(), 0U);
}

ZTEST(configuration_update_logging_stop, test_DestroyingWithABroadcastPendingSendsNothing) {
    F().Start();

    HeldStore held(F().manager, { { "a" } });
    zassert_true(held.WaitUntilStored());
    zassert_equal(F().control->Requests().size(), 1U);

    F().stop.reset();

    held.Release();
    zassert_true(F().Flush());
    zassert_equal(F().sender->Sends().size(), 0U, "The pending broadcast was cancelled with the update stop");
}

ZTEST(configuration_update_logging_stop, test_ANullServiceOrQueueIsRefused) {
    bool is_service_refused = false;
    try {
        ConfigurationUpdateLoggingStop stop(nullptr, TestConfigQueue(), F().control, F().sender);
    } catch(const std::invalid_argument&) {
        is_service_refused = true;
    }
    zassert_true(is_service_refused, "It needs the configuration service");

    bool is_queue_refused = false;
    try {
        ConfigurationUpdateLoggingStop stop(F().service, nullptr, F().control, F().sender);
    } catch(const std::invalid_argument&) {
        is_queue_refused = true;
    }
    zassert_true(is_queue_refused, "and the configuration work queue");
}

ZTEST(configuration_update_logging_stop, test_StartBeforeInitializeFailsAndStartIsOnce) {
    F().stop = std::make_unique<ConfigurationUpdateLoggingStop>(
        F().service, TestConfigQueue(), F().control, F().sender
    );

    zassert_false(F().stop->Start(), "Start() needs Initialize()");
    zassert_false(F().stop->IsStarted());

    zassert_true(F().stop->Initialize());
    zassert_true(F().stop->Initialize(), "Initialize() is once, and repeats its result");
    zassert_true(F().stop->Start());
    zassert_false(F().stop->Start(), "and so is Start()");
    zassert_true(F().stop->IsStarted());

    F().Store();
    zassert_equal(F().control->Requests().size(), 1U, "A second Start() changed nothing");
}

ZTEST(configuration_update_logging_stop, test_AQueueThatDoesNotRunFailsToInitialize) {
    const auto never_ran = std::make_shared<WorkQueueThread>("never_ran_update_stop", 4096, 5);
    ConfigurationUpdateLoggingStop stop(F().service, never_ran, F().control, F().sender);

    zassert_false(stop.Initialize(), "The broadcast needs a queue that runs");
    zassert_false(stop.Start());
}
```

## src/logging_command_handler.cpp
```c
#include <atomic>
#include <memory>
#include <optional>
#include <stdexcept>
#include <vector>

#include <zephyr/ztest.h>

#include "domain/canbus_com_domain/commands/canbus_com_command_code.h"
#include "domain/canbus_com_domain/commands/canbus_com_logging_command.h"
#include "domain/logging_domain/control/logging_command_handler.h"
#include "domain/logging_domain/control/remote_logging_control.h"

#include "canbus_com_loopback_harness.h"
#include "logging_control_test_support.h"

using namespace logging_control_test;
using namespace canbus_com_loopback_test;

using eerie_leap::domain::canbus_com_domain::commands::CanbusComCommandCode;
using eerie_leap::domain::canbus_com_domain::commands::CanbusComLoggingCommand;
using eerie_leap::domain::logging_domain::control::LoggingCommandHandler;
using eerie_leap::domain::logging_domain::control::RemoteLoggingControl;

namespace {

constexpr uint8_t LOGGING_CODE = std::to_underlying(CanbusComCommandCode::LOGGING);

// The unit, a scripted peer on its bus, and the handler under test with a fake control.
struct Fixture {
    Harness harness;
    std::shared_ptr<FakeLoggingControl> control = std::make_shared<FakeLoggingControl>();
    std::shared_ptr<LoggingCommandHandler> handler;
    uint8_t next_transaction = 1;

    // A real remote control for the cases of the role without a writer; built by BuildRemote().
    std::shared_ptr<FakeCommandSender> remote_sender = std::make_shared<FakeCommandSender>();
    std::shared_ptr<FakeRestartMonitor> remote_monitor = std::make_shared<FakeRestartMonitor>();
    std::shared_ptr<RemoteLoggingControl> remote;

    Fixture() {
        harness.BringOnline();
        harness.Settle();
    }

    void BuildHandler() {
        handler = std::make_shared<LoggingCommandHandler>(harness.com, control);
    }

    // The role of the gauge: the handler over a RemoteLoggingControl.
    void BuildRemote() {
        remote = std::make_shared<RemoteLoggingControl>(TestConfigQueue(), remote_sender, remote_monitor);
        zassert_true(remote->Initialize(), "The remote control did not initialize.");
        handler = std::make_shared<LoggingCommandHandler>(harness.com, remote);
    }

    // A LOGGING request from the peer to the unit; the transaction it carries.
    uint8_t SendRequest(const Bytes& data) {
        const uint8_t transaction = next_transaction++;

        harness.SendAsPeer(
            COMMAND,
            CdmpCommandRequestMessage{
                .target_device_id = OWN_ID, .command_code = LOGGING_CODE, .transaction_id = transaction, .data = data }
                .ToCanFrame()
        );

        return transaction;
    }

    // The unit's answer to a transaction, or nothing in time.
    std::optional<CdmpCommandResponseMessage> WaitForResponse(uint8_t transaction, int timeout_ms = FRAME_TIMEOUT_MS) {
        auto frame = harness.bus.Wait(
            COMMAND_RESPONSE,
            [transaction](const Bytes& bytes) {
                return bytes.size() >= 4 && bytes[0] == OWN_ID && bytes[1] == LOGGING_CODE && bytes[2] == transaction;
            },
            timeout_ms
        );
        if(!frame.has_value())
            return std::nullopt;

        return CdmpCommandResponseMessage::FromCanFrame(frame->data);
    }

    std::optional<CdmpResultCode> Ask(const Bytes& data) {
        const auto response = WaitForResponse(SendRequest(data));
        if(!response.has_value())
            return std::nullopt;

        return response->result_code;
    }
};

Fixture*& Current() {
    static Fixture* fixture = nullptr;

    return fixture;
}

void* SetUp() {
    return SetUpChannels();
}

void Before(void*) {
    Current() = new Fixture();
}

void After(void*) {
    Gate().Open();

    // The handler before the harness, so it is gone when the COM service stops.
    if(Current() != nullptr) {
        Current()->handler.reset();
        Current()->remote.reset();
        delete Current();
        Current() = nullptr;
    }

    ResetLoopbackDevice();
}

Fixture& F() {
    return *Current();
}

} // namespace

ZTEST_SUITE(logging_command_handler, NULL, SetUp, Before, After, NULL);

ZTEST(logging_command_handler, test_AStartIsAnsweredBeforeItRuns) {
    const auto queue = TestConfigQueue();
    F().control->RunJobOn(queue);
    F().BuildHandler();

    // The work a start does queues up behind the gate; the answer must not wait for it.
    zassert_true(Gate().Close(*queue), "The queue must be held");

    // The queue stays held, so only the handler can make the answer late: one that waited for the
    // outcome (the fake never reports one) would not answer within this.
    const int64_t start_ms = k_uptime_get();
    const auto result = F().Ask({ 0x01 });
    const int64_t answer_ms = k_uptime_get() - start_ms;
    zassert_true(result.has_value(), "The start must be answered");
    zassert_equal(*result, CdmpResultCode::SUCCESS, "which means accepted");
    zassert_true(
        answer_ms < NO_WAIT_MS, "The answer must not wait for the start (%lld ms)", static_cast<long long>(answer_ms)
    );
    zassert_false(F().control->WaitForJob(NO_WAIT_MS), "The start had not run when it was answered");

    const auto requests = F().control->Requests();
    zassert_equal(requests.size(), 1);
    zassert_equal(requests[0].kind, Kind::Start);
    zassert_equal(requests[0].thread_name, CDMP_WORK_QUEUE_NAME, "The request is made on the CDMP work queue");

    Gate().Open();
    zassert_true(F().control->WaitForJob(), "The start runs once the queue is free");
}

ZTEST(logging_command_handler, test_AStopIsAccepted) {
    F().BuildHandler();

    const auto result = F().Ask({ 0x00 });
    zassert_true(result.has_value());
    zassert_equal(*result, CdmpResultCode::SUCCESS);

    zassert_true(F().control->Kinds() == Kinds({ Kind::Stop }));
}

ZTEST(logging_command_handler, test_ARequestWithoutAPayloadFails) {
    F().BuildHandler();

    const auto result = F().Ask({});
    zassert_true(result.has_value());
    zassert_equal(*result, CdmpResultCode::FAILURE, "A request that names neither start nor stop fails");

    zassert_equal(F().control->Requests().size(), 0);
}

ZTEST(logging_command_handler, test_DestroyingTheHandlerUnregistersTheCommand) {
    F().BuildHandler();
    zassert_true(F().Ask({ 0x01 }).has_value());
    zassert_equal(F().control->Requests().size(), 1);

    F().handler.reset();

    const auto result = F().Ask({ 0x01 });
    zassert_true(result.has_value());
    zassert_equal(*result, CdmpResultCode::UNSUPPORTED_COMMAND, "No handler, no command");
    zassert_equal(F().control->Requests().size(), 1, "and no request");
}

ZTEST(logging_command_handler, test_DestroyingTheHandlerWaitsForACallInProgress) {
    F().control->HoldRequests();
    F().BuildHandler();

    const uint8_t transaction = F().SendRequest({ 0x01 });
    zassert_true(F().control->WaitUntilHeld(), "The request must reach the control");

    // Destroyed on another thread, which has to wait for the call on the CDMP work queue.
    struct Destruction {
        k_sem done{};
        std::shared_ptr<LoggingCommandHandler> handler;
    };
    const auto destruction = std::make_shared<Destruction>();
    k_sem_init(&destruction->done, 0, 1);
    destruction->handler = std::move(F().handler);

    WorkQueueThread helper("handler_destroyer", 4096, 5);
    zassert_true(helper.Initialize());
    helper.Run([destruction] {
        destruction->handler.reset();
        k_sem_give(&destruction->done);
    });

    zassert_not_equal(
        k_sem_take(&destruction->done, Ms(NO_FRAME_TIMEOUT_MS)), 0, "The destructor must wait for the call in progress"
    );

    F().control->Release();

    const auto response = F().WaitForResponse(transaction);
    zassert_true(response.has_value(), "The call in progress is answered");
    zassert_equal(response->result_code, CdmpResultCode::SUCCESS, "as it was accepted");
    zassert_equal(k_sem_take(&destruction->done, Ms(WAIT_MS)), 0, "and the destructor returns");

    const auto later = F().Ask({ 0x01 });
    zassert_true(later.has_value());
    zassert_equal(*later, CdmpResultCode::UNSUPPORTED_COMMAND);
    zassert_equal(F().control->Requests().size(), 1, "One request in all");
}

ZTEST(logging_command_handler, test_ANullArgumentIsRefused) {
    bool is_service_refused = false;
    try {
        LoggingCommandHandler handler(nullptr, F().control);
    } catch(const std::invalid_argument&) {
        is_service_refused = true;
    }
    zassert_true(is_service_refused, "A handler needs the COM service");

    bool is_control_refused = false;
    try {
        LoggingCommandHandler handler(F().harness.com, nullptr);
    } catch(const std::invalid_argument&) {
        is_control_refused = true;
    }
    zassert_true(is_control_refused, "and a control");

    // The refusals registered nothing.
    const auto result = F().Ask({ 0x01 });
    zassert_true(result.has_value());
    zassert_equal(*result, CdmpResultCode::UNSUPPORTED_COMMAND);
}

// The slot CDMP keeps the handler in, which LoggingCommandHandler's destructor unsets while the CDMP
// work queue may be in a call: a call takes its own reference to the handler, and the lock is not
// held while the handler runs. These cases use the COM service's raw registration.
namespace {

// A handler that blocks inside its call and owns a sentinel, so a test can see how long the handler
// lives. The test keeps the semaphores through the shared signals, never the closure.
struct Signals {
    k_sem entered{};
    k_sem release{};
    std::atomic<int> calls = 0;

    Signals() {
        k_sem_init(&entered, 0, K_SEM_MAX_LIMIT);
        k_sem_init(&release, 0, K_SEM_MAX_LIMIT);
    }
};

std::weak_ptr<int>
RegisterBlockingHandler(const Fixture& fixture, const std::shared_ptr<Signals>& signals, bool result) {
    auto sentinel = std::make_shared<int>(0);
    std::weak_ptr<int> weak_sentinel = sentinel;

    fixture.harness.com->SetCommandHandler<CanbusComLoggingCommand>(
        CanbusComCommandCode::LOGGING,
        [signals, sentinel = std::move(sentinel), result](const std::optional<CanbusComLoggingCommand>&) {
            signals->calls++;
            k_sem_give(&signals->entered);
            // Gives up after 5 s, so a case that never releases cannot wedge the CDMP queue for good.
            k_sem_take(&signals->release, K_SECONDS(5));

            return result;
        }
    );

    return weak_sentinel;
}

} // namespace

ZTEST(logging_command_handler, test_AHandlerUnsetDuringItsCallFinishesThatCall) {
    const auto signals = std::make_shared<Signals>();
    const auto weak_sentinel = RegisterBlockingHandler(F(), signals, true);
    zassert_false(weak_sentinel.expired(), "the registered handler holds the sentinel");

    const uint8_t transaction = F().SendRequest({ 0x01 });
    zassert_equal(k_sem_take(&signals->entered, Ms(WAIT_MS)), 0, "The handler must be called");

    // The CDMP work queue is inside the call: unsetting neither waits for it nor ends it.
    const int64_t start_ms = k_uptime_get();
    F().harness.com->UnsetCommandHandler(CanbusComCommandCode::LOGGING);
    const int64_t elapsed_ms = k_uptime_get() - start_ms;
    zassert_true(
        elapsed_ms < NO_WAIT_MS, "Unsetting the handler waited %lld ms for its call", static_cast<long long>(elapsed_ms)
    );
    zassert_false(weak_sentinel.expired(), "The call in progress must keep its handler alive");

    k_sem_give(&signals->release);
    const auto response = F().WaitForResponse(transaction);
    zassert_true(response.has_value(), "The call in progress is answered");
    zassert_equal(response->result_code, CdmpResultCode::SUCCESS, "by the handler it started on");

    // Released when the call returned, before the answer went out.
    zassert_true(weak_sentinel.expired(), "The handler must go once its call returned");

    const auto later = F().Ask({ 0x01 });
    zassert_true(later.has_value());
    zassert_equal(*later, CdmpResultCode::UNSUPPORTED_COMMAND, "A handler that was unset is not called again");
    zassert_equal(signals->calls.load(), 1);
}

ZTEST(logging_command_handler, test_AHandlerReplacedDuringItsCallFinishesThatCall) {
    const auto signals = std::make_shared<Signals>();
    const auto weak_sentinel = RegisterBlockingHandler(F(), signals, true);

    const uint8_t transaction = F().SendRequest({ 0x01 });
    zassert_equal(k_sem_take(&signals->entered, Ms(WAIT_MS)), 0, "The handler must be called");

    // The second handler answers FAILURE at once.
    const auto replacement_calls = std::make_shared<std::atomic<int>>(0);
    const int64_t start_ms = k_uptime_get();
    F().harness.com->SetCommandHandler<CanbusComLoggingCommand>(
        CanbusComCommandCode::LOGGING, [replacement_calls](const std::optional<CanbusComLoggingCommand>&) {
            (*replacement_calls)++;

            return false;
        }
    );
    zassert_true(k_uptime_get() - start_ms < NO_WAIT_MS, "Replacing the handler must not wait for its call");
    zassert_false(weak_sentinel.expired(), "The call in progress must keep the old handler alive");

    k_sem_give(&signals->release);
    const auto response = F().WaitForResponse(transaction);
    zassert_true(response.has_value());
    zassert_equal(response->result_code, CdmpResultCode::SUCCESS, "The call in progress finishes on the old handler");
    zassert_true(weak_sentinel.expired());

    const auto later = F().Ask({ 0x01 });
    zassert_true(later.has_value());
    zassert_equal(*later, CdmpResultCode::FAILURE, "and the next call is the replacement's");
    zassert_equal(replacement_calls->load(), 1);
    zassert_equal(signals->calls.load(), 1);
}

// The gauge answers the command too (L9): a stop is accepted and drops its wanted start, so no
// re-assertion sends a start that undoes it.
ZTEST(logging_command_handler, test_TheRemoteRoleAnswersAStopAndDropsItsWantedStart) {
    F().BuildRemote();

    PublishStatus(false, LoggingStatusReason::Unavailable);
    F().remote->RequestStart(ALL_UNITS);
    zassert_true(F().remote_sender->WaitForSends(1), "The start is sent");

    const auto result = F().Ask({ 0x00 });
    zassert_true(result.has_value(), "A unit without a writer answers a stop");
    zassert_equal(*result, CdmpResultCode::SUCCESS);

    PublishStatus(false, LoggingStatusReason::Stopped);
    F().remote_monitor->Report(PEER_ID);
    zassert_true(FlushQueue(*TestConfigQueue()));
    zassert_equal(F().remote_sender->Sends().size(), 1U, "and sends no start again, whatever reports a logging unit");
}

ZTEST(logging_command_handler, test_TheRemoteRoleAnswersAStartFailure) {
    F().BuildRemote();

    const auto result = F().Ask({ 0x01 });
    zassert_true(result.has_value(), "It answers a start too");
    zassert_equal(*result, CdmpResultCode::FAILURE, "but cannot serve it");

    zassert_true(FlushQueue(*TestConfigQueue()));
    zassert_equal(F().remote_sender->Sends().size(), 0U, "and sends nothing");
}
```

## src/logging_control_configuration_manager.cpp
```c
#include <array>
#include <atomic>
#include <cstring>
#include <memory>
#include <stdexcept>
#include <string>
#include <string_view>
#include <utility>
#include <variant>
#include <vector>

#include <zephyr/kernel.h>
#include <zephyr/ztest.h>

#include "configuration/cbor/cbor_logging_control_config/cbor_logging_control_config.h"
#include "configuration/services/cbor_configuration_service.h"
#include "subsys/device_tree/dt_fs.h"
#include "subsys/event_bus/event_binding.h"
#include "subsys/fs/services/fs_service.h"
#include "utilities/memory/memory_resource_manager.h"

#include "domain/logging_domain/control/configuration/logging_control_configuration_manager.h"
#include "domain/logging_domain/control/models/logging_control_configuration.h"

#include "logging_control_test_support.h"

using namespace logging_control_test;

using eerie_leap::configuration::services::CborConfigurationService;
using eerie_leap::domain::logging_domain::control::configuration::LoggingControlConfigurationManager;
using eerie_leap::domain::logging_domain::control::models::LoggingControlConfiguration;
using eerie_leap::subsys::device_tree::DtFs;
using eerie_leap::subsys::event_bus::EventBinding;
using eerie_leap::subsys::event_bus::EventBindingChecker;
using eerie_leap::subsys::fs::services::FsService;
using eerie_leap::utilities::memory::Mrm;

namespace {

std::shared_ptr<FsService> FormattedFs() {
    DtFs::InitInternalFs();

    auto fs_service = std::make_shared<FsService>(DtFs::GetInternalFsMp());
    zassert_true(fs_service->Format(), "The internal file system must format.");

    return fs_service;
}

std::shared_ptr<LoggingControlConfigurationManager>
MakeManager(const std::shared_ptr<FsService>& fs_service, EventBindingChecker check_binding = {}) {
    return std::make_shared<LoggingControlConfigurationManager>(
        std::make_unique<CborConfigurationService<CborLoggingControlConfig>>("logging_control_config", fs_service),
        std::move(check_binding)
    );
}

LoggingControlConfiguration MakeConfiguration(const std::vector<LoggingControlBinding>& triggers) {
    LoggingControlConfiguration configuration(std::allocator_arg, Mrm::GetDefaultPmr());
    for(const auto& trigger : triggers)
        configuration.triggers.push_back(trigger);

    return configuration;
}

// One trigger of each selector kind, with values that need more than one byte.
std::vector<LoggingControlBinding> MixedTriggers() {
    LoggingControlBinding text = SensorTrigger("ignition");

    LoggingControlBinding number;
    number.event.channel = EventChannelId::Settings;
    number.event.event_type = 300;
    number.event.payload_key = 4;
    number.event.selector_key = 2;
    number.event.selector_value = -7;

    LoggingControlBinding flag;
    flag.event.channel = EventChannelId::Logging;
    flag.event.event_type = 0;
    flag.event.payload_key = 1;
    flag.event.selector_key = 0;
    flag.event.selector_value = true;

    LoggingControlBinding none;
    none.event.channel = EventChannelId::Navigation;
    none.event.event_type = 5;
    none.event.payload_key = 6;
    none.event.selector_key = 9;

    return { text, number, flag, none };
}

void AssertSame(const LoggingControlConfiguration& expected, const LoggingControlConfiguration& actual) {
    zassert_equal(actual.triggers.size(), expected.triggers.size());

    for(size_t i = 0; i < expected.triggers.size(); i++) {
        const auto& a = expected.triggers[i].event;
        const auto& b = actual.triggers[i].event;

        zassert_equal(b.channel, a.channel, "trigger %u channel", static_cast<unsigned>(i));
        zassert_equal(b.event_type, a.event_type);
        zassert_equal(b.payload_key, a.payload_key);
        zassert_equal(b.selector_key, a.selector_key);
        zassert_equal(
            b.selector_value.index(), a.selector_value.index(), "trigger %u selector kind", static_cast<unsigned>(i)
        );
        zassert_true(b.selector_value == a.selector_value, "trigger %u selector", static_cast<unsigned>(i));
    }
}

using Bytes = std::vector<uint8_t>;

// {Sensors, DataUpdated, Value, selector SensorId = "ab"}
// NOLINTNEXTLINE(bugprone-throwing-static-initialization): test fixture built before main; a failed allocation aborts the run either way
const Bytes K_VALID = { 0x9F, 0x9F, 0x9F, 0x01, 0x00, 0x01, 0xF5, 0x00, 0x62, 0x61, 0x62, 0x00, 0xFF, 0xFF, 0xFF };
// A trigger on channel 99, which names no channel, without a selector.
// NOLINTNEXTLINE(bugprone-throwing-static-initialization): test fixture built before main; a failed allocation aborts the run either way
const Bytes UNKNOWN_CHANNEL = { 0x9F, 0x9F, 0x9F, 0x18, 0x63, 0x00, 0x01, 0xF4, 0x00, 0x00, 0x00, 0xFF, 0xFF, 0xFF };
// The same as the first with the selector a float64 (1.0), which cannot select.
// NOLINTNEXTLINE(bugprone-throwing-static-initialization): test fixture built before main; a failed allocation aborts the run either way
const Bytes FLOAT_SELECTOR = { 0x9F, 0x9F, 0x9F, 0x01, 0x00, 0x01, 0xF5, 0x00, 0xFB, 0x3F, 0xF0, 0x00, 0x00, 0x00, 0x00,
    0x00, 0x00, 0x00, 0xFF, 0xFF, 0xFF };

} // namespace

ZTEST_SUITE(logging_control_configuration_manager, NULL, NULL, NULL, NULL, NULL);

ZTEST(logging_control_configuration_manager, test_TheDefaultHasNoTriggers) {
    const auto manager = MakeManager(FormattedFs());

    const auto configuration = manager->Get();
    zassert_not_null(configuration.get(), "A unit that never stored triggers has the default");
    zassert_true(configuration->triggers.empty(), "which is none");

    const auto info = manager->GetCborConfigurationInfo();
    zassert_true(info.size > 0, "and is stored");
    zassert_true(info.is_applied);
}

ZTEST(logging_control_configuration_manager, test_StoredTriggersSurviveARestart) {
    const auto fs_service = FormattedFs();
    const auto expected = MakeConfiguration(MixedTriggers());

    {
        const auto manager = MakeManager(fs_service);
        zassert_true(manager->Update(expected));
        AssertSame(expected, *manager->Get());
    }

    // A second manager on the same file system loads what the first stored.
    const auto restarted = MakeManager(fs_service);
    zassert_true(restarted->GetCborConfigurationInfo().is_applied);
    AssertSame(expected, *restarted->Get());
}

ZTEST(logging_control_configuration_manager, test_AnInvalidConfigurationIsRefused) {
    const auto manager = MakeManager(FormattedFs());
    const auto good = MakeConfiguration({ SensorTrigger("a") });
    zassert_true(manager->Update(good));
    const auto stored = manager->GetCborConfigurationInfo();

    LoggingControlBinding no_channel = SensorTrigger("a");
    no_channel.event.channel = EventChannelId::None;
    zassert_false(manager->Update(MakeConfiguration({ no_channel })), "A trigger without a channel is refused");
    AssertSame(good, *manager->Get());
    zassert_equal(manager->GetCborConfigurationInfo().crc, stored.crc, "and nothing is stored");

    std::array<char, 128> reason{};
    zassert_false(
        manager->ApplyCborConfiguration(UNKNOWN_CHANNEL, reason), "Stored CBOR that names no channel is refused"
    );
    zassert_not_null(std::strstr(reason.data(), "unknown event channel"), "with the reason: %s", reason.data());
    AssertSame(good, *manager->Get());

    reason = {};
    zassert_false(
        manager->ApplyCborConfiguration(FLOAT_SELECTOR, reason), "A selector that cannot select does not decode"
    );
    zassert_not_null(std::strstr(reason.data(), "Malformed CBOR"), "with the reason: %s", reason.data());
    AssertSame(good, *manager->Get());
    zassert_equal(manager->GetCborConfigurationInfo().crc, stored.crc);

    zassert_true(manager->ApplyCborConfiguration(K_VALID), "Valid CBOR applies");
    zassert_equal(manager->Get()->triggers.size(), 1);
    const auto& binding = manager->Get()->triggers[0].event;
    zassert_equal(binding.channel, EventChannelId::Sensors);
    zassert_true(std::get<std::pmr::string>(binding.selector_value) == "ab");
}

ZTEST(logging_control_configuration_manager, test_ABindingCheckerRefusesAnApplyOnly) {
    const auto fs_service = FormattedFs();

    // This unit "has" no channel but Sensors, as K_VALID's trigger names.
    const auto manager = MakeManager(fs_service, [](const EventBinding& binding) -> std::string_view {
        return binding.channel == EventChannelId::Sensors ? "" : "names an event channel this unit does not carry.";
    });
    const auto good = MakeConfiguration({ SensorTrigger("a") });
    zassert_true(manager->Update(good));
    const auto stored = manager->GetCborConfigurationInfo();

    // A rejected binding is refused on apply, with the trigger and the reason, and nothing is stored.
    const Bytes logging_trigger = { 0x9F, 0x9F, 0x9F, 0x02, 0x00, 0x01, 0xF4, 0x00, 0x00, 0x00, 0xFF, 0xFF, 0xFF };
    std::array<char, 128> reason{};
    zassert_false(manager->ApplyCborConfiguration(logging_trigger, reason), "The checker rejects the trigger");
    zassert_not_null(
        std::strstr(reason.data(), "Trigger 0 names an event channel this unit does not carry."), "with the reason: %s",
        reason.data()
    );
    AssertSame(good, *manager->Get());
    zassert_equal(manager->GetCborConfigurationInfo().crc, stored.crc, "and nothing is stored");

    zassert_true(manager->ApplyCborConfiguration(K_VALID), "A binding the checker accepts applies");

    // Update() and loading do not ask: a stored configuration must still load.
    const auto other = MakeConfiguration(MixedTriggers());
    zassert_true(manager->Update(other), "Update() does not call the checker");
    const auto restarted = MakeManager(fs_service, [](const EventBinding&) -> std::string_view {
        return "refuses all.";
    });
    AssertSame(other, *restarted->Get());

    // Without a checker the same bytes apply.
    zassert_true(MakeManager(FormattedFs())->ApplyCborConfiguration(logging_trigger), "No checker, no check");
}

ZTEST(logging_control_configuration_manager, test_TheUpdatedHandlerRunsAfterEachStore) {
    const auto fs_service = FormattedFs();
    const auto calls = std::make_shared<std::atomic<int>>(0);
    const auto thread = std::make_shared<std::atomic<k_tid_t>>(nullptr);

    const auto manager = MakeManager(fs_service);
    zassert_equal(calls->load(), 0, "Loading, or creating the default, calls nobody");

    manager->RegisterConfigurationUpdatedHandler([calls, thread] {
        (*calls)++;
        *thread = k_current_get();
    });
    zassert_equal(calls->load(), 0, "Registering calls nothing");

    zassert_true(manager->Update(MakeConfiguration({ SensorTrigger("a") })));
    zassert_equal(calls->load(), 1);
    zassert_equal(thread->load(), k_current_get(), "on the storing thread");

    zassert_false(manager->Update(MakeConfiguration({ LoggingControlBinding{} })), "A refused store calls nobody");
    zassert_equal(calls->load(), 1);

    // An apply on the configuration work queue, as SMP does it.
    const auto done = std::make_shared<k_sem>();
    k_sem_init(done.get(), 0, 1);
    const auto is_applied = std::make_shared<std::atomic<bool>>(false);
    TestConfigQueue()->Run([manager, done, is_applied] {
        is_applied->store(manager->ApplyCborConfiguration(K_VALID));
        k_sem_give(done.get());
    });
    zassert_equal(k_sem_take(done.get(), K_SECONDS(5)), 0);
    zassert_true(is_applied->load());
    zassert_equal(calls->load(), 2);
    zassert_equal(thread->load(), QueueThread(*TestConfigQueue()), "An apply calls it on the thread that stored it");

    manager->RegisterConfigurationUpdatedHandler(nullptr);
    zassert_true(manager->Update(MakeConfiguration({ SensorTrigger("b") })));
    zassert_equal(calls->load(), 2, "A cleared handler is not called");
}

// The controller clears the handler when it goes, while a store on the configuration work queue may be
// calling it: the clear returns at once, the call in progress finishes on its own reference to the
// handler, and the next store calls nothing.
ZTEST(logging_control_configuration_manager, test_AHandlerClearedDuringItsCallFinishesThatCall) {
    const auto manager = MakeManager(FormattedFs());

    struct Signals {
        k_sem entered{};
        k_sem release{};
        k_sem stored{};
        std::atomic<int> calls = 0;
        std::atomic<bool> is_stored = false;
    };
    const auto signals = std::make_shared<Signals>();
    k_sem_init(&signals->entered, 0, 1);
    k_sem_init(&signals->release, 0, 1);
    k_sem_init(&signals->stored, 0, 1);

    // Owned by the handler alone, so it lives exactly as long as the handler does.
    auto sentinel = std::make_shared<int>(0);
    const std::weak_ptr<int> weak_sentinel = sentinel;
    manager->RegisterConfigurationUpdatedHandler([signals, sentinel = std::move(sentinel)] {
        signals->calls++;
        k_sem_give(&signals->entered);
        // Gives up after 5 s, so a case that never releases cannot wedge the queue for good.
        k_sem_take(&signals->release, K_SECONDS(5));
    });
    zassert_false(weak_sentinel.expired(), "the registered handler holds the sentinel");

    TestConfigQueue()->Run([signals, manager] {
        signals->is_stored = manager->Update(MakeConfiguration({ SensorTrigger("a") }));
        k_sem_give(&signals->stored);
    });
    zassert_equal(k_sem_take(&signals->entered, K_SECONDS(2)), 0, "the store must call the handler");

    const int64_t start_ms = k_uptime_get();
    manager->RegisterConfigurationUpdatedHandler(nullptr);
    const int64_t elapsed_ms = k_uptime_get() - start_ms;
    zassert_true(
        elapsed_ms < NO_WAIT_MS, "clearing the handler waited %lld ms for its call", static_cast<long long>(elapsed_ms)
    );
    zassert_false(weak_sentinel.expired(), "the call in progress must keep its handler alive");

    k_sem_give(&signals->release);
    zassert_equal(k_sem_take(&signals->stored, K_SECONDS(2)), 0, "the store must finish");
    zassert_true(FlushQueue(*TestConfigQueue()));
    zassert_true(signals->is_stored.load(), "the configuration must have been stored");
    zassert_true(weak_sentinel.expired(), "the handler must go once its call returned");

    zassert_true(manager->Update(MakeConfiguration({ SensorTrigger("b") })));
    zassert_equal(signals->calls.load(), 1, "a cleared handler must not be called again");
}

// Rebuilding the triggers allocates and can throw. The configuration is stored by then, so the
// store reports success, and the next store calls the handler again.
ZTEST(logging_control_configuration_manager, test_AHandlerThatThrowsDoesNotFailTheStore) {
    const auto manager = MakeManager(FormattedFs());

    const auto calls = std::make_shared<std::atomic<int>>(0);
    manager->RegisterConfigurationUpdatedHandler([calls] {
        (*calls)++;

        throw std::runtime_error("the trigger set could not be rebuilt");
    });

    zassert_true(manager->Update(MakeConfiguration({ SensorTrigger("a") })), "The store happened");
    zassert_equal(calls->load(), 1);
    zassert_equal(manager->Get()->triggers.size(), 1, "and is in use");

    zassert_true(manager->ApplyCborConfiguration(K_VALID), "An apply reports the same");
    zassert_equal(calls->load(), 2);

    // Not a std::exception.
    manager->RegisterConfigurationUpdatedHandler([calls] {
        (*calls)++;

        throw 7; // NOLINT(bugprone-std-exception-baseclass): the case is about a handler that throws something that is not a std::exception
    });
    zassert_true(manager->Update(MakeConfiguration({ SensorTrigger("b") })));
    zassert_equal(calls->load(), 3);

    manager->RegisterConfigurationUpdatedHandler(nullptr);
}
```

## src/logging_control_test_support.cpp
```c
#include <cstring>

#include "logging_control_test_support.h"

#ifndef CONFIG_LOG_MODE_MINIMAL
    #include <zephyr/logging/log_backend.h>
    #include <zephyr/logging/log_core.h>
    #include <zephyr/logging/log_msg.h>
#endif

namespace logging_control_test {

namespace {

class SpinGuard {
public:
    explicit SpinGuard(k_spinlock& lock) :
        lock_(lock),
        key_(k_spin_lock(&lock)) {}
    ~SpinGuard() {
        k_spin_unlock(&lock_, key_);
    }

    SpinGuard(const SpinGuard&) = delete;
    SpinGuard& operator=(const SpinGuard&) = delete;

private:
    k_spinlock& lock_;
    k_spinlock_key_t key_;
};

} // namespace

LogCounter& LogCounter::Get() {
    static LogCounter counter;

    return counter;
}

void LogCounter::Watch(const char* source_name) {
    const SpinGuard guard(lock_);

    source_name_ = source_name;
    count_ = 0;
}

size_t LogCounter::Count() {
    // Returns once the log thread has processed everything logged so far.
    log_flush();

    const SpinGuard guard(lock_);

    return count_;
}

void LogCounter::Add(const char* source_name) {
    const SpinGuard guard(lock_);

    if(source_name_ != nullptr && source_name != nullptr && std::strcmp(source_name, source_name_) == 0)
        count_++;
}

} // namespace logging_control_test

#ifndef CONFIG_LOG_MODE_MINIMAL

namespace {

void ProcessLogMessage(const log_backend* const backend, log_msg_generic* message) {
    ARG_UNUSED(backend);

    log_msg* log_message = &message->log;
    if(log_msg_get_level(log_message) > LOG_LEVEL_WRN)
        return;

    const int16_t source_id = log_msg_get_source_id(log_message);
    if(source_id < 0)
        return;

    logging_control_test::LogCounter::Get().Add(
        log_source_name_get(Z_LOG_LOCAL_DOMAIN_ID, static_cast<uint32_t>(source_id))
    );
}

void DropLogMessages(const log_backend* const backend, uint32_t count) {
    ARG_UNUSED(backend);
    ARG_UNUSED(count);
}

void PanicLog(const log_backend* const backend) {
    ARG_UNUSED(backend);
}

const log_backend_api LOG_COUNTER_API = {
    .process = ProcessLogMessage,
    .dropped = DropLogMessages,
    .panic = PanicLog,
};

} // namespace

// Autostarted at the default level, which passes the warnings it counts.
LOG_BACKEND_DEFINE(LOGGING_CONTROL_LOG_COUNTER, LOG_COUNTER_API, true);

#endif // !CONFIG_LOG_MODE_MINIMAL
```
