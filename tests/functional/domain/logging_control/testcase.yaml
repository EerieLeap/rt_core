## tests/functional/subsys/adc/testcase.yaml
```yaml
common:
  tags:
    - subsys
    - subsys.adc
  platform_allow:
    - native_sim

tests:
  functional.subsys.adc: {}
```

## tests/functional/subsys/event_bus/testcase.yaml
```yaml
common:
  tags:
    - functional
    - subsys.event_bus
  platform_allow:
    - native_sim
    - qemu_cortex_a9
    - qemu_cortex_a53
    - qemu_riscv64
    - qemu_malta

tests:
  functional.subsys.event_bus: {}
```

## tests/lint/bluetooth/testcase.yaml
```yaml
common:
  tags:
    - lint
    - bluetooth
  build_only: true
  platform_allow: native_sim
  integration_platforms:
    - native_sim

tests:
  lint.bluetooth: {}
  # Also the CAN bus controller and the CAN monitor's controller, which sit on the Bluetooth stack: the
  # compile database of this scenario holds can_monitor_controller.cpp.
  lint.bluetooth.can_monitor:
    extra_args:
      - RT_CORE_LINT_CAN_MONITOR=y
    extra_configs:
      - CONFIG_FLASH=y
      - CONFIG_FLASH_MAP=y
      - CONFIG_FLASH_SIMULATOR=y
      - CONFIG_FILE_SYSTEM=y
      - CONFIG_FILE_SYSTEM_LITTLEFS=y
      - CONFIG_FILE_SYSTEM_MKFS=y
      - CONFIG_CRC=y
      - CONFIG_CAN_FD_MODE=y
      - CONFIG_CAN_LOOPBACK=y
      - CONFIG_EERIE_LEAP_CDMP=y
      - CONFIG_EERIE_LEAP_DEVICE_TREE=y
      - CONFIG_EERIE_LEAP_FS=y
      - CONFIG_EERIE_LEAP_GPIO=y
      - CONFIG_EERIE_LEAP_RANDOM=y
      - CONFIG_EERIE_LEAP_TIME=y
      - CONFIG_EERIE_LEAP_SMP=y
      - CONFIG_EERIE_LEAP_DOMAIN_CANBUS=y
      - CONFIG_EERIE_LEAP_DOMAIN_CANBUS_COM=y
      - CONFIG_EERIE_LEAP_DOMAIN_SCRIPT=y
      - CONFIG_EERIE_LEAP_DOMAIN_CAN_MONITOR=y
      - CONFIG_EERIE_LEAP_CAN_MONITOR_SYNTHETIC=y
      - CONFIG_EERIE_LEAP_CAN_MONITOR_DELTA=y
      - CONFIG_EERIE_LEAP_CONTROLLER_CANBUS=y
      - CONFIG_EERIE_LEAP_CONTROLLER_CAN_MONITOR=y
```

## tests/unit/domain/Kconfig
```kconfig
menu "Zephyr"
source "Kconfig.zephyr"
endmenu

config EERIE_LEAP_HW_VERSION_MAJOR
	int "Hardware version major"
	range 0 255
	default 0

config EERIE_LEAP_HW_VERSION_MINOR
	int "Hardware version minor"
	range 0 255
	default 0

config EERIE_LEAP_HW_VERSION_PATCH
	int "Hardware version patch"
	range 0 65535
	default 0

config EERIE_LEAP_SW_VERSION_MAJOR
	int "Software version major"
	range 0 255
	default 0

config EERIE_LEAP_SW_VERSION_MINOR
	int "Software version minor"
	range 0 255
	default 0

config EERIE_LEAP_SW_VERSION_PATCH
	int "Software version patch"
	range 0 65535
	default 0

config EERIE_LEAP_CANBUS_AUTO_DETECT_INTERVAL_MS
	int "Canbus auto detect activity check interval ms"
	default 5000

config EERIE_LEAP_FS_SD_THREAD_STACK_SIZE
	int "SD thread stack size"
	default 3072

config EERIE_LEAP_SD_CHECK_INTERVAL_MS
	int "SD check interval ms"
	default 1000


config LOGGING_UNIT_TEST_DUMP_DIR
	string "Host directory the mdf4_logger suite writes its CAN file into (empty: not written)"
	default ""
	depends on ARCH_POSIX
	help
	  Only native_sim reaches the host file system: it links the host libc, so std::ofstream
	  writes there. Other platforms do not link std::ofstream at all.
```

## tests/unit/subsys/adc/testcase.yaml
```yaml
common:
  tags: subsys.adc
  platform_allow:
    - native_sim

tests:
  unit.subsys.adc: {}
```

## tests/unit/subsys/canbus/testcase.yaml
```yaml
common:
  tags:
    - unit
    - subsys.canbus
  platform_allow:
    - native_sim
    - qemu_cortex_a9
    - qemu_cortex_a53
    - qemu_riscv64
    - qemu_malta

tests:
  unit.subsys.canbus: {}
```

## tests/unit/subsys/dfu_confirmation/testcase.yaml
```yaml
common:
  tags:
    - unit
    - subsys.dfu_confirmation
  platform_allow:
    - native_sim

tests:
  unit.subsys.dfu_confirmation: {}
```

## tests/unit/subsys/event_bus/testcase.yaml
```yaml
common:
  tags:
    - unit
    - subsys.event_bus
  platform_allow:
    - native_sim
    - qemu_cortex_a9
    - qemu_cortex_a53
    - qemu_riscv64
    - qemu_malta

tests:
  unit.subsys.event_bus: {}
```

## tests/unit/subsys/expression_engine/testcase.yaml
```yaml
common:
  tags:
    - unit
    - subsys.expression_engine
  platform_allow:
    - native_sim
    - qemu_cortex_a9
    - qemu_cortex_a53
    - qemu_riscv64
    - qemu_malta

tests:
  unit.subsys.expression_engine: {}
```

## tests/unit/subsys/math_parser/testcase.yaml
```yaml
common:
  tags:
    - unit
    - subsys.math_parser
  platform_allow:
    - native_sim
    - qemu_cortex_a9
    - qemu_cortex_a53
    - qemu_riscv64
    - qemu_malta

tests:
  unit.subsys.math_parser: {}
```
