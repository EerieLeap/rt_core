## CMakeLists.txt
```
cmake_minimum_required(VERSION 3.20.0)

set(RT_CORE_TEST_SIM_FLASH ON)
include(${CMAKE_CURRENT_SOURCE_DIR}/../../../rt_core_test.cmake)

find_package(Zephyr REQUIRED HINTS $ENV{ZEPHYR_BASE})
project(functional_system_domain)

file(GLOB_RECURSE TEST_SOURCES src/*.c src/*.cpp)

target_sources(app PRIVATE ${TEST_SOURCES})
```

## Kconfig
```
menu "Zephyr"
source "Kconfig.zephyr"
endmenu

config EERIE_LEAP_HW_VERSION_MAJOR
	int "Hardware version major"
	range 0 255
	default 0

config EERIE_LEAP_HW_VERSION_MINOR
	int "Hardware version minor"
	range 0 255
	default 0

config EERIE_LEAP_HW_VERSION_PATCH
	int "Hardware version patch"
	range 0 65535
	default 0

config EERIE_LEAP_SW_VERSION_MAJOR
	int "Software version major"
	range 0 255
	default 0

config EERIE_LEAP_SW_VERSION_MINOR
	int "Software version minor"
	range 0 255
	default 0

config EERIE_LEAP_SW_VERSION_PATCH
	int "Software version patch"
	range 0 65535
	default 0

config EERIE_LEAP_SW_VERSION_BUILD
	int "Software build number"
	range 0 255
	default 0

config EERIE_LEAP_LOG_DATA_FILE_PREFIX
	string "Log data files prefix"
	default "log_data"

config EERIE_LEAP_LOG_WRITER_STACK_SIZE
	int "Log writer stack size"
	default 8192

config EERIE_LEAP_FS_SD_THREAD_STACK_SIZE
	int "SD thread stack size"
	default 2048

config EERIE_LEAP_ADC_VOLTAGE_MAX_MV
	int "ADC voltage max"
	default 3100

config EERIE_LEAP_SENSOR_VOLTAGE_MAX_MV
	int "Sensor voltage max"
	default 5000

config EERIE_LEAP_SD_CHECK_INTERVAL_MS
	int "SD check interval ms"
	default 1000
```

## prj.conf
```kconfig
CONFIG_ZTEST=y

#HW Version
CONFIG_EERIE_LEAP_HW_VERSION_MAJOR=2
CONFIG_EERIE_LEAP_HW_VERSION_MINOR=9
CONFIG_EERIE_LEAP_HW_VERSION_PATCH=6

#SW Version
CONFIG_EERIE_LEAP_SW_VERSION_MAJOR=7
CONFIG_EERIE_LEAP_SW_VERSION_MINOR=8
CONFIG_EERIE_LEAP_SW_VERSION_PATCH=4

# Language and Compiler
CONFIG_CPP=y
CONFIG_PICOLIBC=y
CONFIG_STD_CPP23=y
CONFIG_REQUIRES_FULL_LIBCPP=y
CONFIG_CPP_EXCEPTIONS=y
CONFIG_CPP_RTTI=y

# Memory
CONFIG_HEAP_MEM_POOL_SIZE=100000

# C++ exception unwinding needs considerably more stack than the ztest defaults.
CONFIG_MAIN_STACK_SIZE=8192
CONFIG_ZTEST_STACK_SIZE=8192

# Logging And Debugging
CONFIG_LOG=y
CONFIG_TEST_RANDOM_GENERATOR=y
CONFIG_THREAD_ANALYZER=y
CONFIG_THREAD_ANALYZER_USE_LOG=y
CONFIG_THREAD_NAME=y
CONFIG_SYS_HEAP_RUNTIME_STATS=y
CONFIG_THREAD_ANALYZER_ISR_STACK_USAGE=n
CONFIG_TIMING_FUNCTIONS=y

# FS Config
CONFIG_FLASH=y
CONFIG_FLASH_MAP=y
CONFIG_FILE_SYSTEM=y
CONFIG_FILE_SYSTEM_LITTLEFS=y
CONFIG_FILE_SYSTEM_MKFS=y

CONFIG_ZCBOR=y

CONFIG_CRC=y

CONFIG_EERIE_LEAP_RT_CORE=y
CONFIG_EERIE_LEAP_CONFIGURATION=y
CONFIG_EERIE_LEAP_DEVICE_TREE=y
CONFIG_EERIE_LEAP_FS=y
CONFIG_EERIE_LEAP_RANDOM=y

CONFIG_EERIE_LEAP_DOMAIN_SYSTEM=y
```

## src/system_configuration_manager.cpp
```c
#include <algorithm>
#include <array>
#include <memory>
#include <span>
#include <vector>

#include <zephyr/kernel.h>
#include <zephyr/sys/crc.h>
#include <zephyr/ztest.h>

#include "configuration/cbor/cbor_system_config/cbor_system_config.h"
#include "configuration/services/cbor_configuration_service.h"
#include "domain/system_domain/configuration/system_configuration_manager.h"

#include "subsys/device_tree/dt_fs.h"
#include "subsys/fs/services/fs_service.h"

using namespace eerie_leap::configuration::services;
using namespace eerie_leap::subsys::device_tree;
using namespace eerie_leap::subsys::fs::services;
using namespace eerie_leap::domain::system_domain::models;
using namespace eerie_leap::domain::system_domain::configuration;

ZTEST_SUITE(system_configuration_manager, NULL, NULL, NULL, NULL, NULL);

ZTEST(system_configuration_manager, test_SystemConfigurationManager_Save_config_successfully_saved) {
    DtFs::InitInternalFs();
    const auto fs_service = std::make_shared<FsService>(DtFs::GetInternalFsMp());

    fs_service->Format();

    auto cbor_system_configuration_service = std::make_unique<CborConfigurationService<CborSystemConfig>>(
        "system_config", fs_service
    );
    const auto system_configuration_manager = std::make_shared<SystemConfigurationManager>(
        std::move(cbor_system_configuration_service)
    );

    const SystemConfiguration system_configuration(std::allocator_arg, Mrm::GetDefaultPmr());

    const bool result = system_configuration_manager->Update(system_configuration);
    zassert_true(result);

    const auto saved_system_configuration = system_configuration_manager->Get();

    zassert_equal(saved_system_configuration->HW_VERSION, system_configuration.HW_VERSION);
    zassert_equal(saved_system_configuration->SW_VERSION, system_configuration.SW_VERSION);
}

ZTEST(system_configuration_manager, test_SystemConfigurationManager_Save_config_and_Load) {
    DtFs::InitInternalFs();
    const auto fs_service = std::make_shared<FsService>(DtFs::GetInternalFsMp());

    fs_service->Format();

    auto cbor_system_configuration_service = std::make_unique<CborConfigurationService<CborSystemConfig>>(
        "system_config", fs_service
    );
    auto system_configuration_manager = std::make_shared<SystemConfigurationManager>(
        std::move(cbor_system_configuration_service)
    );

    SystemConfiguration system_configuration(std::allocator_arg, Mrm::GetDefaultPmr());
    system_configuration.device_id = 14;

    const bool result = system_configuration_manager->Update(system_configuration);
    zassert_true(result);

    cbor_system_configuration_service = std::make_unique<CborConfigurationService<CborSystemConfig>>(
        "system_config", fs_service
    );
    system_configuration_manager = nullptr;
    system_configuration_manager = std::make_shared<SystemConfigurationManager>(
        std::move(cbor_system_configuration_service)
    );

    const auto saved_system_configuration = system_configuration_manager->Get();

    zassert_equal(saved_system_configuration->device_id, system_configuration.device_id);
    zassert_equal(saved_system_configuration->HW_VERSION, SystemConfiguration::HW_VERSION);
    zassert_equal(saved_system_configuration->SW_VERSION, SystemConfiguration::SW_VERSION);
}

namespace {

std::shared_ptr<FsService> FormattedFs() {
    DtFs::InitInternalFs();
    auto fs_service = std::make_shared<FsService>(DtFs::GetInternalFsMp());
    fs_service->Format();
    return fs_service;
}

std::shared_ptr<SystemConfigurationManager> CreateManager(const std::shared_ptr<FsService>& fs_service) {
    return std::make_shared<SystemConfigurationManager>(
        std::make_unique<CborConfigurationService<CborSystemConfig>>("system_config", fs_service)
    );
}

uint32_t Crc(std::span<const uint8_t> data) {
    return crc32_ieee(data.data(), data.size());
}

// Can take the filesystem away from under a manager.
class UnmountableFsService : public FsService {
public:
    using FsService::FsService;
    using FsService::Unmount;
};

// The same two-element array with the other length encoding than zcbor's.
std::vector<uint8_t> OtherArrayEncoding(std::span<const uint8_t> cbor) {
    constexpr uint8_t INDEFINITE_ARRAY = 0x9F;
    constexpr uint8_t BREAK = 0xFF;
    constexpr uint8_t TWO_ELEMENT_ARRAY = 0x82;

    if(cbor.front() == INDEFINITE_ARRAY) {
        zassert_equal(cbor.back(), BREAK);
        std::vector<uint8_t> other{ TWO_ELEMENT_ARRAY };
        other.insert(other.end(), cbor.begin() + 1, cbor.end() - 1);
        return other;
    }

    zassert_equal(cbor.front(), TWO_ELEMENT_ARRAY);
    std::vector<uint8_t> other{ INDEFINITE_ARRAY };
    other.insert(other.end(), cbor.begin() + 1, cbor.end());
    other.push_back(BREAK);
    return other;
}

} // namespace

ZTEST(system_configuration_manager, test_SystemConfigurationManager_ApplyCborConfiguration_keeps_the_senders_encoding) {
    const auto fs_service = FormattedFs();
    auto manager = CreateManager(fs_service);

    const auto exported = manager->GetCborConfiguration();
    zassert_false(exported.empty());
    const auto received = OtherArrayEncoding(exported);

    zassert_true(manager->ApplyCborConfiguration(received));

    const auto stored = manager->GetCborConfiguration();
    zassert_true(std::ranges::equal(stored, received));
    zassert_equal(manager->GetCborConfigurationInfo().size, received.size());
    zassert_equal(manager->GetCborConfigurationInfo().crc, Crc(received));

    manager = CreateManager(fs_service);
    zassert_equal(manager->GetCborConfigurationInfo().crc, Crc(received), "The CRC survives a reload");
}

ZTEST(system_configuration_manager, test_SystemConfigurationManager_ApplyCborConfiguration_rejects_trailing_bytes) {
    const auto fs_service = FormattedFs();
    const auto manager = CreateManager(fs_service);

    const auto before = manager->GetCborConfigurationInfo();
    auto padded = manager->GetCborConfiguration();
    padded.push_back(0x00);

    std::array<char, 64> reason{};
    zassert_false(manager->ApplyCborConfiguration(padded, reason));
    zassert_str_equal(reason.data(), "Malformed CBOR");
    zassert_equal(manager->GetCborConfigurationInfo().crc, before.crc);
}

ZTEST(system_configuration_manager, test_SystemConfigurationManager_ApplyCborConfiguration_reports_a_failed_store) {
    DtFs::InitInternalFs();
    const auto fs_service = std::make_shared<UnmountableFsService>(DtFs::GetInternalFsMp());
    fs_service->Format();
    const auto manager = CreateManager(fs_service);
    const auto exported = manager->GetCborConfiguration();

    fs_service->Unmount();

    std::array<char, 64> reason{};
    zassert_false(manager->ApplyCborConfiguration(exported, reason));
    zassert_str_equal(reason.data(), "Could not store the configuration");

    zassert_true(fs_service->Initialize(), "Mounted again for the other tests");
}

ZTEST(system_configuration_manager, test_SystemConfigurationManager_Update_reports_the_crc_of_its_own_encoding) {
    const auto fs_service = FormattedFs();
    const auto manager = CreateManager(fs_service);
    zassert_true(manager->ApplyCborConfiguration(OtherArrayEncoding(manager->GetCborConfiguration())));

    SystemConfiguration system_configuration(std::allocator_arg, Mrm::GetDefaultPmr());
    system_configuration.device_id = 21;
    zassert_true(manager->Update(system_configuration));

    const auto stored = manager->GetCborConfiguration();
    zassert_equal(manager->GetCborConfigurationInfo().size, stored.size());
    zassert_equal(manager->GetCborConfigurationInfo().crc, Crc(stored));
}
```
