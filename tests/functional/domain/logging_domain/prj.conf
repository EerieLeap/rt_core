## CMakeLists.txt
```
cmake_minimum_required(VERSION 3.20.0)

set(RT_CORE_TEST_FLASH_DISK ON)
include(${CMAKE_CURRENT_SOURCE_DIR}/../../../rt_core_test.cmake)

find_package(Zephyr REQUIRED HINTS $ENV{ZEPHYR_BASE})
project(functional_logging_domain)

file(GLOB_RECURSE TEST_SOURCES src/*.c src/*.cpp)

target_sources(app PRIVATE ${TEST_SOURCES})

# MemoryStreamBuf
target_include_directories(app PRIVATE ${CMAKE_CURRENT_SOURCE_DIR}/../../../common)
```

## Kconfig
```
menu "Zephyr"
source "Kconfig.zephyr"
endmenu

config EERIE_LEAP_FS_SD_THREAD_STACK_SIZE
	int "SD thread stack size"
	default 2048

config EERIE_LEAP_SD_CHECK_INTERVAL_MS
	int "SD check interval ms"
	default 1000

config LOGGING_TEST_DUMP_DIR
	string "Host directory the log_writer_service suite copies a finalized file into (empty: not copied)"
	default ""
	depends on ARCH_POSIX
	help
	  Only native_sim reaches the host file system: it links the host libc, so std::ofstream
	  writes there. Other platforms do not link std::ofstream at all.
```

## prj.conf
```kconfig
CONFIG_ZTEST=y

# Language and Compiler
CONFIG_CPP=y
CONFIG_PICOLIBC=y
CONFIG_STD_CPP23=y
CONFIG_REQUIRES_FULL_LIBCPP=y
CONFIG_CPP_EXCEPTIONS=y
CONFIG_CPP_RTTI=y

# Memory
CONFIG_HEAP_MEM_POOL_SIZE=100000

# C++ exception unwinding needs considerably more stack than the ztest defaults.
CONFIG_MAIN_STACK_SIZE=8192
CONFIG_ZTEST_STACK_SIZE=8192

# ThreadBase::InitializeStack() falls back to k_thread_stack_alloc() for the work queues.
CONFIG_THREAD_STACK_INFO=y
CONFIG_DYNAMIC_THREAD=y
CONFIG_DYNAMIC_THREAD_ALLOC=y

# Logging And Debugging
CONFIG_LOG=y
CONFIG_TEST_RANDOM_GENERATOR=y
CONFIG_THREAD_ANALYZER=y
CONFIG_THREAD_ANALYZER_USE_LOG=y
CONFIG_THREAD_NAME=y
CONFIG_SYS_HEAP_RUNTIME_STATS=y
CONFIG_THREAD_ANALYZER_ISR_STACK_USAGE=n
CONFIG_TIMING_FUNCTIONS=y
CONFIG_CRC=y

# FS Config: a FAT volume on a flash disk, as the SD card the writer logs to.
CONFIG_DISK_DRIVERS=y
CONFIG_DISK_DRIVER_FLASH=y
CONFIG_FLASH=y
CONFIG_FLASH_MAP=y
CONFIG_FILE_SYSTEM=y
CONFIG_FILE_SYSTEM_MKFS=y
CONFIG_DISK_ACCESS=y

CONFIG_FAT_FILESYSTEM_ELM=y
CONFIG_FS_FATFS_MKFS=y
CONFIG_FS_FATFS_MOUNT_MKFS=y
CONFIG_FS_FATFS_LFN=y

CONFIG_ZCBOR=y

# CANBus: the processing service links the CAN frame router.
CONFIG_CAN=y
CONFIG_CAN_FD_MODE=y

CONFIG_EERIE_LEAP_RT_CORE=y
CONFIG_EERIE_LEAP_CONFIGURATION=y
CONFIG_EERIE_LEAP_ADC=y
CONFIG_EERIE_LEAP_CANBUS=y
CONFIG_EERIE_LEAP_DEVICE_TREE=y
CONFIG_EERIE_LEAP_EVENT_BUS=y
CONFIG_EERIE_LEAP_FS=y
CONFIG_EERIE_LEAP_GPIO=y
CONFIG_EERIE_LEAP_LUA_SCRIPT=y
CONFIG_EERIE_LEAP_EXPRESSION_ENGINE=y
CONFIG_EERIE_LEAP_MDF=y
CONFIG_EERIE_LEAP_RANDOM=y
CONFIG_EERIE_LEAP_TIME=y

CONFIG_EERIE_LEAP_DOMAIN_ADC=y
CONFIG_EERIE_LEAP_DOMAIN_CANBUS=y
CONFIG_EERIE_LEAP_DOMAIN_SENSOR=y
CONFIG_EERIE_LEAP_DOMAIN_LOGGING=y

# sensors_apply_while_logging.cpp restarts processing under a running writer.
CONFIG_EERIE_LEAP_CONTROLLER_SENSORS=y

# The log header names the product and its versions; log_writer_supervisor.cpp reads them back.
# Neither matches MakeTestLoggerMetadata(), so a header from the rig's factory cannot pass for one
# from the supervisor's.
CONFIG_EERIE_LEAP_DOMAIN_SYSTEM=y
CONFIG_EERIE_LEAP_PRODUCT_ID=50178
CONFIG_EERIE_LEAP_HW_VERSION_MAJOR=2
CONFIG_EERIE_LEAP_HW_VERSION_MINOR=1
CONFIG_EERIE_LEAP_SW_VERSION_MAJOR=1
CONFIG_EERIE_LEAP_SW_VERSION_MINOR=2
CONFIG_EERIE_LEAP_SW_VERSION_PATCH=3

# test_SyncFollowsTheConfiguredInterval counts syncs over one second.
CONFIG_EERIE_LEAP_LOG_SYNC_INTERVAL_MS=300
# The test volume is 1 MiB; the free-space tests set their minimum in bytes.
CONFIG_EERIE_LEAP_LOG_MIN_FREE_SPACE_MB=0
```

## src/log_end_times.cpp
```c
#include <chrono>
#include <cstdint>
#include <cstring>
#include <ctime>
#include <memory>
#include <string>
#include <vector>

#include <zephyr/kernel.h>
#include <zephyr/sys/timeutil.h>
#include <zephyr/ztest.h>

#include "domain/logging_domain/services/log_end_times.h"

#include "logging_test_support.h"

using namespace logging_test_support;
using eerie_leap::domain::logging_domain::services::LogEndTimes;

namespace {

int64_t NowMs(const LogWriterRig& rig) {
    return std::chrono::duration_cast<std::chrono::milliseconds>(rig.time_service->GetCurrentTime().time_since_epoch())
        .count();
}

std::string IndexPath() {
    return std::string(LogFileNaming::LOGS_DIR) + "/" + LogFileNaming::END_TIMES_FILE_NAME;
}

// The log files in the logs directory, without the end-time index.
std::vector<std::string> ListLogNames(const FsService& fs_service) {
    std::vector<std::string> names;

    for(const auto& name : fs_service.ListFiles(LogFileNaming::LOGS_DIR)) {
        if(name.ends_with(".mf4"))
            names.push_back(name);
    }

    return names;
}

std::shared_ptr<LogEndTimes> AttachEndTimes(const LogWriterRig& rig) {
    auto end_times = std::make_shared<LogEndTimes>(rig.fs_service);
    rig.log_writer_service->SetEndTimes(end_times);

    return end_times;
}

std::string ReadIndex(FsService& fs_service) {
    if(!fs_service.Exists(IndexPath()))
        return {};

    const auto content = ReadWholeFile(fs_service, IndexPath());

    return { content.begin(), content.end() };
}

} // namespace

ZTEST_SUITE(log_end_times, NULL, NULL, ResetAfterTest, NULL, NULL);

ZTEST(log_end_times, test_SessionInfoFollowsTheSession) {
    const auto sensors = MakeLoggedSensors();
    auto rig = MakeLogWriterRig(sensors);

    zassert_false(rig.log_writer_service->GetSessionInfo().has_value(), "no session before Start()");

    const int64_t before_ms = NowMs(rig);
    zassert_true(rig.log_writer_service->Start(), "Start must succeed");
    const int64_t after_ms = NowMs(rig);

    const auto names = ListLogNames(*rig.fs_service);
    zassert_equal(names.size(), 1);

    const auto started = rig.log_writer_service->GetSessionInfo();
    zassert_true(started.has_value(), "a session runs after Start()");
    zassert_true(started->since_ms >= before_ms && started->since_ms <= after_ms, "since_ms is the start time");
    zassert_str_equal(started->file_name.data(), names[0].c_str(), "the open file's name, without directory");
    zassert_true(started->file_bytes > 0, "the header is counted from the start");

    PublishReadings(rig, sensors, 1);
    k_msleep(350);

    const auto running = rig.log_writer_service->GetSessionInfo();
    zassert_true(running.has_value());
    zassert_equal(running->since_ms, started->since_ms, "the session's start does not move");
    zassert_true(running->file_bytes >= started->file_bytes, "the bytes of the file only grow");
    zassert_true(
        rig.log_writer_service->IsOpenFile(std::string(LogFileNaming::LOGS_DIR) + "/" + running->file_name.data())
    );

    zassert_true(rig.log_writer_service->Stop());
    zassert_false(rig.log_writer_service->GetSessionInfo().has_value(), "no session after Stop()");
}

ZTEST(log_end_times, test_AnEndTimeIsRecordedAtStop) {
    const auto sensors = MakeLoggedSensors();
    auto rig = MakeLogWriterRig(sensors);
    const auto end_times = AttachEndTimes(rig);

    zassert_true(rig.log_writer_service->Start());
    const int64_t start_ms = NowMs(rig);
    k_msleep(350);

    const auto names = ListLogNames(*rig.fs_service);
    zassert_equal(names.size(), 1);
    zassert_false(end_times->Find(names[0]).has_value(), "an open file has no end yet");

    zassert_true(rig.log_writer_service->Stop());
    const int64_t stop_ms = NowMs(rig);

    const auto end_ms = end_times->Find(names[0]);
    zassert_true(end_ms.has_value(), "a finalized file's end is recorded");
    zassert_true(*end_ms >= start_ms - 1000 && *end_ms <= stop_ms, "the end lies within the session");

    // Persisted: a new index reads it back.
    LogEndTimes reloaded(rig.fs_service);
    reloaded.Load();
    zassert_equal(reloaded.Find(names[0]), end_ms, "the end time survives a reload");
}

ZTEST(log_end_times, test_AnEndTimeIsRecordedAtARotation) {
    const auto sensors = MakeLoggedSensors();
    auto rig = MakeLogWriterRig(sensors);
    const auto end_times = AttachEndTimes(rig);

    rig.log_writer_service->SetSizeLimitsForTesting(2048, 0);
    zassert_true(rig.log_writer_service->Start());

    const auto first_names = ListLogNames(*rig.fs_service);
    zassert_equal(first_names.size(), 1);

    uint8_t sequence = 0;
    zassert_true(
        WaitFor(
            [&] {
                for(int i = 0; i < 2; i++)
                    PublishFrame(rig, *sensors[1], sequence++, rig.time_service->GetCurrentTime());

                return rig.log_writer_service->GetStats().rotations >= 1;
            },
            5000
        ),
        "the frames must reach the size limit"
    );

    zassert_true(end_times->Find(first_names[0]).has_value(), "the rotated file's end is recorded at once");

    const auto names = ListLogNames(*rig.fs_service);
    zassert_true(names.size() >= 2);
    const auto info = rig.log_writer_service->GetSessionInfo();
    zassert_true(info.has_value());

    const std::string open_name = info->file_name.data();
    zassert_true(rig.log_writer_service->Stop());
    zassert_true(end_times->Find(open_name).has_value(), "the last file's end is recorded at Stop()");
}

ZTEST(log_end_times, test_AFileThatCouldNotBeFinalizedHasNoEndTime) {
    const auto sensors = MakeLoggedSensors();
    auto rig = MakeLogWriterRig(sensors);
    const auto end_times = AttachEndTimes(rig);
    const std::string filler_path = "end_times_fill.bin";

    zassert_true(rig.log_writer_service->Start());
    const auto names = ListLogNames(*rig.fs_service);
    zassert_equal(names.size(), 1);

    FillVolume(*rig.fs_service, filler_path);

    uint8_t sequence = 0;
    zassert_true(
        WaitFor(
            [&] {
                PublishFrame(rig, *sensors[1], sequence++, rig.time_service->GetCurrentTime());

                return rig.log_writer_service->HasFailed();
            },
            5000
        ),
        "a full volume must fail the session"
    );
    zassert_true(
        rig.log_writer_service->GetSessionInfo().has_value(), "a failed session still runs until it is stopped"
    );

    zassert_true(rig.log_writer_service->Stop());
    zassert_false(rig.log_writer_service->GetSessionInfo().has_value());

    RemoveFiller(*rig.fs_service, filler_path);

    zassert_false(end_times->Find(names[0]).has_value(), "a file left unfinalized gets no end time");
    zassert_equal(end_times->Size(), 0);
}

ZTEST(log_end_times, test_LoadDropsTheEntriesOfDeletedLogsAndRewritesTheFile) {
    const auto fs_service = GetFormattedFsService();
    zassert_true(fs_service->CreateDirectory(LogFileNaming::LOGS_DIR));

    const std::vector<uint8_t> content(8, 0x5A);
    for(const char* name : { "a.mf4", "b.mf4", "c.mf4" })
        zassert_true(fs_service->WriteFile(std::string(LogFileNaming::LOGS_DIR) + "/" + name, content.data(), 8));

    {
        LogEndTimes end_times(fs_service);
        end_times.Record("a.mf4", 1000);
        end_times.Record("b.mf4", 2000);
        end_times.Record("c.mf4", 3000);
        end_times.Record("c.mf4", 3500);
        end_times.Record("gone.mf4", 4000);
    }

    zassert_true(fs_service->DeleteFile(std::string(LogFileNaming::LOGS_DIR) + "/b.mf4"));

    LogEndTimes reloaded(fs_service);
    reloaded.Load();

    zassert_equal(reloaded.Find("a.mf4"), 1000);
    zassert_false(reloaded.Find("b.mf4").has_value(), "the entry of a deleted log is dropped");
    zassert_false(reloaded.Find("gone.mf4").has_value(), "the entry of a log that never existed is dropped");
    zassert_equal(reloaded.Find("c.mf4"), 3500, "the last record of a name wins");
    zassert_equal(reloaded.Size(), 2);

    zassert_str_equal(ReadIndex(*fs_service).c_str(), "1000 a.mf4\n3500 c.mf4\n", "the file is rewritten pruned");

    // Never serves the index as a log.
    zassert_false(fs_service->ListFiles(LogFileNaming::LOGS_DIR).empty());
}

ZTEST(log_end_times, test_ACorruptFileStartsWhatCanBeRead) {
    const auto fs_service = GetFormattedFsService();
    zassert_true(fs_service->CreateDirectory(LogFileNaming::LOGS_DIR));

    const std::vector<uint8_t> content(8, 0x5A);
    zassert_true(fs_service->WriteFile(std::string(LogFileNaming::LOGS_DIR) + "/a.mf4", content.data(), 8));

    const std::string corrupt = "garbage\n1000 a.mf4\n12x b.mf4\n\n-\n";
    zassert_true(fs_service->WriteFile(IndexPath(), corrupt.data(), corrupt.size()));

    LogEndTimes end_times(fs_service);
    end_times.Load();

    zassert_equal(end_times.Find("a.mf4"), 1000);
    zassert_equal(end_times.Size(), 1);
    zassert_str_equal(ReadIndex(*fs_service).c_str(), "1000 a.mf4\n", "the readable part is kept");

    LogEndTimes missing(GetFormattedFsService());
    fs_service->DeleteFile(IndexPath());
    missing.Load();
    zassert_equal(missing.Size(), 0, "a missing file is an empty index");
}

ZTEST(log_end_times, test_TheIndexKeepsTheNewestEntriesOnly) {
    const auto fs_service = GetFormattedFsService();
    zassert_true(fs_service->CreateDirectory(LogFileNaming::LOGS_DIR));

    LogEndTimes end_times(fs_service);
    constexpr size_t EXTRA = 5;
    for(size_t i = 0; i < LogEndTimes::MAX_ENTRIES + EXTRA; i++)
        end_times.Record("log_" + std::to_string(i) + ".mf4", static_cast<int64_t>(i));

    zassert_equal(end_times.Size(), LogEndTimes::MAX_ENTRIES, "the index is capped");
    zassert_false(end_times.Find("log_0.mf4").has_value(), "the oldest entries leave first");
    zassert_false(end_times.Find("log_4.mf4").has_value());
    zassert_equal(end_times.Find("log_5.mf4"), 5);
    zassert_equal(
        end_times.Find("log_" + std::to_string(LogEndTimes::MAX_ENTRIES + EXTRA - 1) + ".mf4"),
        static_cast<int64_t>(LogEndTimes::MAX_ENTRIES + EXTRA - 1)
    );
}

namespace {

constexpr size_t ID_BLOCK_SIZE = 64;

struct FileClock {
    int64_t start_ms;
    uint8_t time_class;
    bool says_set;
    bool says_uptime;
};

// The HD block's start (ms) and time class, and the file's `clock` property.
FileClock ReadFileClock(FsService& fs_service, const std::string& name) {
    const auto bytes = ReadWholeFile(fs_service, std::string(LogFileNaming::LOGS_DIR) + "/" + name);
    zassert_true(bytes.size() > ID_BLOCK_SIZE + 24, "the file holds no header");
    zassert_equal(std::string(bytes.begin() + ID_BLOCK_SIZE, bytes.begin() + ID_BLOCK_SIZE + 4), "##HD");

    uint64_t link_count = 0;
    std::memcpy(&link_count, bytes.data() + ID_BLOCK_SIZE + 16, sizeof(link_count));
    const size_t fields = ID_BLOCK_SIZE + 24 + static_cast<size_t>(link_count) * 8;

    uint64_t start_ns = 0;
    std::memcpy(&start_ns, bytes.data() + fields, sizeof(start_ns));

    const std::string text(bytes.begin(), bytes.end());

    return FileClock{ .start_ms = static_cast<int64_t>(start_ns / 1'000'000ULL),
        .time_class = bytes[fields + 8 + 2 + 2 + 1],
        .says_set = text.contains("<e name=\"clock\">set</e>"),
        .says_uptime = text.contains("<e name=\"clock\">uptime</e>") };
}

// The `YYYYMMDDTHHMMSS` of a file name, as Unix seconds.
int64_t NameSeconds(const std::string& name) {
    const auto at = name.find('T') - 8;
    std::tm time_utc{};
    time_utc.tm_year = std::stoi(name.substr(at, 4)) - 1900;
    time_utc.tm_mon = std::stoi(name.substr(at + 4, 2)) - 1;
    time_utc.tm_mday = std::stoi(name.substr(at + 6, 2));
    time_utc.tm_hour = std::stoi(name.substr(at + 9, 2));
    time_utc.tm_min = std::stoi(name.substr(at + 11, 2));
    time_utc.tm_sec = std::stoi(name.substr(at + 13, 2));

    return timeutil_timegm(&time_utc);
}

constexpr int64_t DAY_MS = 24LL * 3600 * 1000;

} // namespace

ZTEST(log_end_times, test_AStartAfterASetIsOnRealTime) {
    const auto sensors = MakeLoggedSensors();
    auto rig = MakeLogWriterRig(sensors);
    const auto end_times = AttachEndTimes(rig);

    const int64_t wall_ms = NowMs(rig) + 400 * DAY_MS;
    rig.time_service->SetWallClock(std::chrono::system_clock::time_point(std::chrono::milliseconds(wall_ms)));

    zassert_true(rig.log_writer_service->Start());
    k_msleep(350);
    zassert_true(rig.log_writer_service->Stop());

    const auto names = ListLogNames(*rig.fs_service);
    zassert_equal(names.size(), 1);

    const auto clock = ReadFileClock(*rig.fs_service, names[0]);
    zassert_true(clock.says_set && !clock.says_uptime, "the file says its start is real time");
    zassert_equal(clock.time_class, 10, "an external time source");
    zassert_true(clock.start_ms >= wall_ms && clock.start_ms < wall_ms + 5000, "the HD start is real time");
    zassert_equal(NameSeconds(names[0]), clock.start_ms / 1000, "the name is the start on the file's clock");

    const auto end_ms = end_times->Find(names[0]);
    zassert_true(end_ms.has_value());
    zassert_true(*end_ms >= clock.start_ms && *end_ms < clock.start_ms + 5000, "end_ms is on the file's clock");
}

ZTEST(log_end_times, test_AStartBeforeASetStaysOnTheUnitsClock) {
    const auto sensors = MakeLoggedSensors();
    auto rig = MakeLogWriterRig(sensors);
    const auto end_times = AttachEndTimes(rig);

    zassert_true(rig.log_writer_service->Start());
    const int64_t start_ms = NowMs(rig);
    k_msleep(150);
    rig.time_service->SetWallClock(
        std::chrono::system_clock::time_point(std::chrono::milliseconds(start_ms + 400 * DAY_MS))
    );
    k_msleep(200);
    zassert_true(rig.log_writer_service->Stop());

    const auto names = ListLogNames(*rig.fs_service);
    zassert_equal(names.size(), 1);

    const auto clock = ReadFileClock(*rig.fs_service, names[0]);
    zassert_true(clock.says_uptime && !clock.says_set, "a set while logging changes nothing in the file");
    zassert_equal(clock.time_class, 0);
    zassert_true(clock.start_ms >= start_ms - 1000 && clock.start_ms <= start_ms + 1000, "the HD start is unit time");
    zassert_equal(NameSeconds(names[0]), clock.start_ms / 1000);

    const auto end_ms = end_times->Find(names[0]);
    zassert_true(end_ms.has_value());
    zassert_true(*end_ms < start_ms + 5000, "end_ms stays on the unit's clock");
}

ZTEST(log_end_times, test_ARotationKeepsTheClockOfItsStart) {
    const auto sensors = MakeLoggedSensors();
    auto rig = MakeLogWriterRig(sensors);
    const auto end_times = AttachEndTimes(rig);

    const int64_t wall_ms = NowMs(rig) + 400 * DAY_MS;
    rig.time_service->SetWallClock(std::chrono::system_clock::time_point(std::chrono::milliseconds(wall_ms)));

    rig.log_writer_service->SetSizeLimitsForTesting(2048, 0);
    zassert_true(rig.log_writer_service->Start());

    // A later set must not reach the files of this start.
    rig.time_service->SetWallClock(
        std::chrono::system_clock::time_point(std::chrono::milliseconds(wall_ms + 400 * DAY_MS))
    );

    uint8_t sequence = 0;
    zassert_true(
        WaitFor(
            [&] {
                for(int i = 0; i < 2; i++)
                    PublishFrame(rig, *sensors[1], sequence++, rig.time_service->GetCurrentTime());

                return rig.log_writer_service->GetStats().rotations >= 1;
            },
            5000
        ),
        "the frames must reach the size limit"
    );
    zassert_true(rig.log_writer_service->Stop());

    const auto names = ListLogNames(*rig.fs_service);
    zassert_true(names.size() >= 2);

    for(const auto& name : names) {
        const auto clock = ReadFileClock(*rig.fs_service, name);
        zassert_true(clock.says_set, "every file of the start is on real time");
        zassert_equal(clock.time_class, 10);
        zassert_true(clock.start_ms >= wall_ms && clock.start_ms < wall_ms + 60'000, "and on the first set's offset");
        zassert_equal(NameSeconds(name), clock.start_ms / 1000);

        const auto end_ms = end_times->Find(name);
        zassert_true(end_ms.has_value());
        zassert_true(*end_ms >= clock.start_ms && *end_ms < wall_ms + 60'000, "end_ms is on the same clock");
    }
}
```

## src/log_writer_probe.h
```c
#pragma once

#include <atomic>
#include <chrono>
#include <cstdint>
#include <functional>
#include <ios>
#include <memory>
#include <optional>
#include <streambuf>
#include <utility>
#include <vector>

#include <zephyr/kernel.h>

#include "domain/logging_domain/loggers/i_logger.h"
#include "domain/sensor_domain/models/sensor_reading.h"
#include "subsys/threading/scoped_mutex.h"

namespace logging_test_support {

using eerie_leap::domain::logging_domain::loggers::ILogger;
using eerie_leap::domain::logging_domain::loggers::LogFileEnd;
using eerie_leap::domain::logging_domain::loggers::LogFileStart;
using eerie_leap::domain::sensor_domain::models::SensorReading;
using eerie_leap::subsys::threading::ScopedMutex;

// Hands every call to the logger it wraps, and records when the writer thread called it: the uptime
// of each tick that offered a reading, and the thread that finalized the file. On request it holds
// a reading for a while, so a Stop() arrives in the middle of a tick, refuses one the way a stream
// that failed does, or throws from StopLogging() so a stop fails.
class ProbeLogger : public ILogger<SensorReading> {
private:
    std::shared_ptr<ILogger<SensorReading>> inner_;
    int64_t last_call_ticks_ = -1;

public:
    static constexpr size_t MAX_TICKS = 512;
    static constexpr int32_t HOLD_MS = 200;

    // Writer thread only; read once the service is stopped.
    std::vector<int64_t> tick_times;

    std::atomic<bool> refuse_next_reading = false;
    std::atomic<bool> hold_next_reading = false;
    // The next this many StopLogging() calls throw, which a stop cannot get past.
    std::atomic<int> stop_throws = 0;
    std::atomic<k_tid_t> stop_thread = nullptr;
    std::atomic<bool> is_held_reading_done = false;
    std::atomic<bool> stop_found_held_reading_done = false;
    k_sem held_reading_started{};

    explicit ProbeLogger(std::shared_ptr<ILogger<SensorReading>> inner) :
        inner_(std::move(inner)) {
        tick_times.reserve(MAX_TICKS);
        k_sem_init(&held_reading_started, 0, 1);
    }

    const char* GetFileExtension() const override {
        return inner_->GetFileExtension();
    }

    bool StartLogging(std::streambuf& stream, const LogFileStart& start) override {
        return inner_->StartLogging(stream, start);
    }

    bool StopLogging(const LogFileEnd& end) override {
        if(stop_throws > 0) {
            stop_throws--;
            throw std::ios_base::failure("The probe refuses to finalize.");
        }

        stop_thread = k_current_get();
        stop_found_held_reading_done = is_held_reading_done.load();

        return inner_->StopLogging(end);
    }

    bool LogReading(const std::chrono::system_clock::time_point& time, const SensorReading& reading) override {
        // Every call of one tick shares its uptime where code takes no time (native_sim).
        const int64_t now = k_uptime_ticks();
        if(now != last_call_ticks_ && tick_times.size() < MAX_TICKS)
            tick_times.push_back(now);
        last_call_ticks_ = now;

        if(refuse_next_reading.exchange(false))
            throw std::ios_base::failure("The probe refuses the record.");

        if(!hold_next_reading.exchange(false))
            return inner_->LogReading(time, reading);

        k_sem_give(&held_reading_started);
        k_msleep(HOLD_MS);

        const bool is_logged = inner_->LogReading(time, reading);
        is_held_reading_done = true;

        return is_logged;
    }

    [[nodiscard]] uint64_t GetBytesWritten() const override {
        return inner_->GetBytesWritten();
    }
};

// A logger factory that wraps every logger another one builds in a new ProbeLogger, so a case can
// reach the probe of the session that runs now across restarts. Shared, so the factory the writer
// holds keeps it, not the test's stack.
class ProbeLoggerFactory : public std::enable_shared_from_this<ProbeLoggerFactory> {
public:
    using LoggerFactory = std::function<std::shared_ptr<ILogger<SensorReading>>()>;

private:
    LoggerFactory inner_;

    mutable k_mutex lock_{};
    std::shared_ptr<ProbeLogger> current_;
    int count_ = 0;

    explicit ProbeLoggerFactory(LoggerFactory inner) :
        inner_(std::move(inner)) {
        k_mutex_init(&lock_);
    }

    // On the thread that starts the writer.
    std::shared_ptr<ILogger<SensorReading>> Create() {
        auto inner = inner_();
        if(inner == nullptr)
            return nullptr;

        auto probe = std::make_shared<ProbeLogger>(std::move(inner));

        ScopedMutex guard(lock_);
        current_ = probe;
        count_++;

        return probe;
    }

public:
    static std::shared_ptr<ProbeLoggerFactory> Make(LoggerFactory inner) {
        return std::shared_ptr<ProbeLoggerFactory>(new ProbeLoggerFactory(std::move(inner)));
    }

    LoggerFactory AsFactory() {
        return [self = shared_from_this()] {
            return self->Create();
        };
    }

    // The probe of the latest start; null before the first.
    std::shared_ptr<ProbeLogger> Current() const {
        ScopedMutex guard(lock_);

        return current_;
    }

    int GetCount() const {
        ScopedMutex guard(lock_);

        return count_;
    }
};

} // namespace logging_test_support
```

## src/log_writer_service.cpp
```c
#include <algorithm>
#include <cctype>
#include <chrono>
#include <cmath>
#include <cstdint>
#include <memory>
#include <string>
#include <string_view>
#include <vector>

#ifdef CONFIG_ARCH_POSIX
    #include <fstream>
#endif

#include <eerie_memory.hpp>
#include <zephyr/kernel.h>
#include <zephyr/ztest.h>

#include "domain/sensor_domain/models/sensor_limits.h"

#include "logging_test_support.h"

using namespace logging_test_support;
using eerie_leap::domain::sensor_domain::models::SensorLimits;

namespace {

// native_sim links the host libc, so the finalized file can be handed to asammdf on the host.
void DumpToHost([[maybe_unused]] const std::vector<uint8_t>& content) {
#ifdef CONFIG_ARCH_POSIX
    const std::string_view dump_dir;
    if(dump_dir.empty())
        return;

    const std::string path = std::string(dump_dir) + "/logging_functional_dump.mf4";

    std::ofstream file(path, std::ios::binary | std::ios::trunc);
    zassert_true(file.is_open(), "the dump file %s could not be opened", path.c_str());
    // NOLINTNEXTLINE(cppcoreguidelines-pro-type-reinterpret-cast): ostream::write() takes chars, the content is bytes
    file.write(reinterpret_cast<const char*>(content.data()), static_cast<std::streamsize>(content.size()));
    zassert_true(file.good(), "the dump file %s could not be written", path.c_str());
#endif
}

} // namespace

ZTEST_SUITE(log_writer_service, NULL, NULL, ResetAfterTest, NULL, NULL);

ZTEST(log_writer_service, test_StartAndStopProduceAFinalizedFile) {
    const auto sensors = MakeLoggedSensors();
    auto rig = MakeLogWriterRig(sensors);
    zassert_equal(
        rig.logging_configuration_manager->Get()->logging_interval_ms, 100,
        "the default configuration ticks every 100 ms"
    );

    constexpr uint8_t PUBLISHED_FRAMES = 7;
    std::vector<std::chrono::system_clock::time_point> published_times;

    zassert_true(rig.log_writer_service->Start(), "Start must succeed on a formatted volume with a logger");
    for(uint8_t i = 0; i < PUBLISHED_FRAMES; i++) {
        published_times.push_back(PublishReadings(rig, sensors, i));
        k_sleep(K_MSEC(50));
    }
    // One more tick drains the frames queued after the last one.
    k_sleep(K_MSEC(150));
    zassert_true(rig.log_writer_service->Stop(), "Stop must finalize and close the file");

    const auto stats = rig.log_writer_service->GetStats();
    zassert_true(stats.ticks >= 4, "500 ms at 100 ms must run at least 4 ticks (got %u)", stats.ticks);
    zassert_equal(stats.write_errors, 0, "nothing may fail on an empty volume");
    zassert_equal(stats.frames, PUBLISHED_FRAMES, "every queued raw frame is logged (got %u)", stats.frames);
    zassert_true(stats.readings >= 3, "each tick sees a new value timestamp (got %u readings)", stats.readings);

    const auto files = rig.fs_service->ListFiles(LogFileNaming::LOGS_DIR);
    zassert_equal(files.size(), 1, "one Start must leave exactly one file (found %zu)", files.size());

    const std::string path = std::string(LogFileNaming::LOGS_DIR) + "/" + files[0];
    const auto content = ReadWholeFile(*rig.fs_service, path);

    zassert_true(content.size() >= ID_BLOCK_SIZE + BLOCK_HEADER_SIZE, "the file is shorter than an MDF header");
    zassert_mem_equal(content.data(), "MDF     ", 8, "a stopped file must carry the finalized identifier");

    AssertFinalizedFile(content, "the stopped file");
    zassert_equal(
        stats.bytes, FinalizedDataEnd(content), "the logger's byte count must match the data, the event not counted"
    );

    // Two frames 50 ms apart are drained by one tick, and each keeps the time it was published at.
    const auto records = ReadDataRecords(content);
    zassert_equal(
        records.frame_times.size(), PUBLISHED_FRAMES, "one CAN record per frame (got %zu)", records.frame_times.size()
    );
    for(size_t i = 0; i < records.frame_times.size(); i++) {
        zassert_equal(records.frame_sequences[i], i, "frame %zu is out of order", i);

        const double expected = SecondsSinceFileStart(content, published_times[i]);
        zassert_within(
            records.frame_times[i], expected, 1e-6, "frame %zu at %f s, published at %f s after the start", i,
            records.frame_times[i], expected
        );
    }

    zassert_equal(records.value_times.size(), stats.readings, "one value record per logged reading");
    for(size_t i = 0; i < records.value_times.size(); i++) {
        const auto match = std::ranges::find_if(published_times, [&](const auto& time) {
            return std::abs(SecondsSinceFileStart(content, time) - records.value_times[i]) < 1e-6;
        });
        zassert_true(
            match != published_times.end(), "value %zu at %f s is no published sample time", i, records.value_times[i]
        );

        if(i > 0)
            zassert_true(
                records.value_times[i] > records.value_times[i - 1], "value times must strictly increase at %zu", i
            );
    }

    DumpToHost(content);
}

// Frames the frame queued while logging was stopped predate the file: they are not logged, and
// they do not take the queue places of the frames that arrive after the start.
ZTEST(log_writer_service, test_FramesQueuedBeforeStartAreNotLogged) {
    const auto sensors = MakeLoggedSensors();
    auto rig = MakeLogWriterRig(sensors);

    for(size_t i = 0; i < SensorLimits::RAW_CAN_QUEUE_SIZE + 4; i++)
        PublishFrame(rig, *sensors[1], 0xF0, rig.time_service->GetCurrentTime());
    k_sleep(K_MSEC(20));

    zassert_true(rig.log_writer_service->Start(), "Start must succeed on a formatted volume with a logger");

    constexpr uint8_t PUBLISHED_FRAMES = 3;
    for(uint8_t i = 0; i < PUBLISHED_FRAMES; i++)
        PublishFrame(rig, *sensors[1], i, rig.time_service->GetCurrentTime());

    k_sleep(K_MSEC(250));
    zassert_true(rig.log_writer_service->Stop(), "Stop must finalize and close the file");

    const auto stats = rig.log_writer_service->GetStats();
    zassert_equal(stats.frames, PUBLISHED_FRAMES, "only the frames after the start are logged (got %u)", stats.frames);
    zassert_equal(stats.frames_dropped, 0, "drops before the start are not this file's (got %u)", stats.frames_dropped);

    const auto files = rig.fs_service->ListFiles(LogFileNaming::LOGS_DIR);
    zassert_equal(files.size(), 1, "one Start must leave exactly one file (found %zu)", files.size());

    const auto content = ReadWholeFile(*rig.fs_service, std::string(LogFileNaming::LOGS_DIR) + "/" + files[0]);
    const auto records = ReadDataRecords(content);
    zassert_equal(
        records.frame_times.size(), PUBLISHED_FRAMES, "one CAN record per frame after the start (got %zu)",
        records.frame_times.size()
    );
    for(size_t i = 0; i < records.frame_sequences.size(); i++)
        zassert_equal(records.frame_sequences[i], i, "frame %zu must be one published after the start", i);
}

// Without log_only_new_data a sample is held: written at its own time, then again at every tick.
ZTEST(log_writer_service, test_HeldSampleIsRepeatedAtEveryTick) {
    const auto sensors = MakeLoggedSensors();
    auto rig = MakeLogWriterRig(sensors, false);

    zassert_true(rig.log_writer_service->Start(), "Start must succeed on a formatted volume with a logger");
    const auto published_time = rig.time_service->GetCurrentTime();
    PublishValue(rig, *sensors[0], 5, published_time);

    k_sleep(K_MSEC(550));
    zassert_true(rig.log_writer_service->Stop(), "Stop must finalize and close the file");

    const auto files = rig.fs_service->ListFiles(LogFileNaming::LOGS_DIR);
    zassert_equal(files.size(), 1, "one Start must leave exactly one file (found %zu)", files.size());

    const auto content = ReadWholeFile(*rig.fs_service, std::string(LogFileNaming::LOGS_DIR) + "/" + files[0]);
    const auto records = ReadDataRecords(content);

    zassert_true(
        records.value_times.size() >= 4, "550 ms at 100 ms must repeat the sample (got %zu records)",
        records.value_times.size()
    );
    zassert_within(
        records.value_times[0], SecondsSinceFileStart(content, published_time), 1e-6,
        "the first record carries the sample's own time"
    );

    for(size_t i = 0; i < records.value_times.size(); i++) {
        zassert_within(records.values[i], 10.5F, 1e-4F, "record %zu must hold the one sample", i);

        if(i > 0)
            zassert_true(
                records.value_times[i] > records.value_times[i - 1], "value times must strictly increase at %zu", i
            );
    }
}

ZTEST(log_writer_service, test_FailingSensorIsLoggedInvalidUntilItRecovers) {
    const auto sensors = MakeLoggedSensors();
    auto rig = MakeLogWriterRig(sensors, false);

    zassert_true(rig.log_writer_service->Start(), "Start must succeed on a formatted volume with a logger");
    PublishValue(rig, *sensors[0], 5, rig.time_service->GetCurrentTime());
    k_sleep(K_MSEC(250));

    // The pipeline commits a failed reading as it is, with its own time and no value.
    SensorReading failed(sensors[0].get());
    failed.source = ReadingSource::PROCESSING;
    failed.timestamp = rig.time_service->GetCurrentTime();
    failed.SetError(ReadingError::READER_FAILED);
    rig.frame->AddOrUpdateReading(failed);
    k_sleep(K_MSEC(250));

    PublishValue(rig, *sensors[0], 7, rig.time_service->GetCurrentTime());
    k_sleep(K_MSEC(250));
    zassert_true(rig.log_writer_service->Stop(), "Stop must finalize and close the file");

    const auto files = rig.fs_service->ListFiles(LogFileNaming::LOGS_DIR);
    zassert_equal(files.size(), 1, "one Start must leave exactly one file (found %zu)", files.size());

    const auto content = ReadWholeFile(*rig.fs_service, std::string(LogFileNaming::LOGS_DIR) + "/" + files[0]);
    const auto records = ReadDataRecords(content);

    // valid (10.5) ... invalid (0, bits 0 and 1) ... valid again (10.7)
    size_t first_invalid = records.values.size();
    size_t last_invalid = 0;
    for(size_t i = 0; i < records.values.size(); i++) {
        if(records.value_invalid_masks[i] != 0) {
            first_invalid = std::min(first_invalid, i);
            last_invalid = i;
            zassert_equal(
                records.value_invalid_masks[i], 0x03,
                "a failed reading has neither a value nor a raw value (record %zu)", i
            );
            zassert_equal(records.values[i], 0.0F, "an invalid value is written as 0 (record %zu)", i);
        }
    }

    zassert_true(
        first_invalid > 0 && first_invalid < records.values.size(),
        "the failure must show up after the first good samples"
    );
    zassert_true(
        last_invalid >= first_invalid + 1, "the failure is held while it lasts (records %zu..%zu)", first_invalid,
        last_invalid
    );
    zassert_within(records.values[first_invalid - 1], 10.5F, 1e-4F, "before the failure the good sample is logged");
    zassert_true(last_invalid + 1 < records.values.size(), "the recovered sensor must be logged after the failure");
    zassert_within(records.values[last_invalid + 1], 10.7F, 1e-4F, "after recovery the new sample is logged valid");
    zassert_equal(records.value_invalid_masks[last_invalid + 1], 0, "a recovered sample clears the bits");
}

ZTEST(log_writer_service, test_SyncFollowsTheConfiguredInterval) {
    static_assert(CONFIG_EERIE_LEAP_LOG_SYNC_INTERVAL_MS == 300, "the suite configures a 300 ms sync interval");

    const auto rig = MakeLogWriterRig();

    zassert_true(rig.log_writer_service->Start(), "Start must succeed on a formatted volume with a logger");
    k_sleep(K_MSEC(1000));

    const auto stats = rig.log_writer_service->GetStats();
    zassert_true(rig.log_writer_service->Stop(), "Stop must finalize and close the file");

    zassert_true(stats.ticks >= 9, "1000 ms at 100 ms must run at least 9 ticks (got %u)", stats.ticks);
    zassert_between_inclusive(
        stats.syncs, 2, 4, "1000 ms at a 300 ms interval is 3 syncs, give or take one tick (got %u)", stats.syncs
    );
    zassert_equal(stats.write_errors, 0, "a sync on an empty volume must not fail");
}

// What the assets group asks before it reads or deletes a log: a path relative to the volume, as
// the group builds it from the store's directory and a file name. FAT folds ASCII case.
ZTEST(log_writer_service, test_IsOpenFileTellsTheFileTheWriterHasOpen) {
    const auto rig = MakeLogWriterRig();
    const std::string other_path = std::string(LogFileNaming::LOGS_DIR) + "/log_data_20000101T000000Z_0000.mf4";

    zassert_false(rig.log_writer_service->IsOpenFile(other_path), "a writer that never started has no file open");
    zassert_false(rig.log_writer_service->IsOpenFile(""), "no path is the open file");

    zassert_true(rig.log_writer_service->Start(), "Start must succeed on a formatted volume with a logger");

    const auto files = rig.fs_service->ListFiles(LogFileNaming::LOGS_DIR);
    zassert_equal(files.size(), 1, "Start opens one file (found %zu)", files.size());
    const std::string path = std::string(LogFileNaming::LOGS_DIR) + "/" + files[0];

    zassert_true(rig.log_writer_service->IsOpenFile(path), "the file Start opened is open");

    std::string upper_case = path;
    std::ranges::transform(upper_case, upper_case.begin(), [](unsigned char c) {
        return static_cast<char>(std::toupper(c));
    });
    zassert_true(rig.log_writer_service->IsOpenFile(upper_case), "the path is compared ignoring case");

    zassert_false(rig.log_writer_service->IsOpenFile(other_path), "another file is not the open one");
    zassert_false(
        rig.log_writer_service->IsOpenFile(files[0]), "the path is relative to the volume, not to the directory"
    );
    zassert_false(rig.log_writer_service->IsOpenFile(LogFileNaming::LOGS_DIR), "the directory is not the open file");
    zassert_false(rig.log_writer_service->IsOpenFile(""), "no path is the open file");

    zassert_true(rig.log_writer_service->Stop(), "Stop must finalize and close the file");
    zassert_false(rig.log_writer_service->IsOpenFile(path), "a stopped writer has no file open");
    zassert_false(rig.log_writer_service->IsOpenFile(upper_case), "a stopped writer has no file open");

    zassert_true(rig.log_writer_service->Start(), "a stopped writer starts again");
    const auto next_files = rig.fs_service->ListFiles(LogFileNaming::LOGS_DIR);
    zassert_equal(next_files.size(), 2, "the second Start opens a second file (found %zu)", next_files.size());

    size_t open_files = 0;
    for(const auto& name : next_files) {
        if(rig.log_writer_service->IsOpenFile(std::string(LogFileNaming::LOGS_DIR) + "/" + name))
            open_files++;
    }
    zassert_equal(open_files, 1, "exactly one of the files is open (found %zu)", open_files);
    zassert_false(rig.log_writer_service->IsOpenFile(path), "the first session's file is closed for good");

    zassert_true(rig.log_writer_service->Stop(), "Stop must finalize and close the file");
}

// What the assets group asks before it serves the log being written: the size as of the last sync,
// from the moment the file is named, and nothing for any other file or once it is closed.
ZTEST(log_writer_service, test_GetGrowingSizeIsTheSizeAtTheLastSync) {
    const auto rig = MakeLogWriterRig();
    const std::string other_path = std::string(LogFileNaming::LOGS_DIR) + "/log_data_20000101T000000Z_0000.mf4";

    zassert_false(rig.log_writer_service->GetGrowingSize(other_path).has_value(), "a writer that never started");
    zassert_false(rig.log_writer_service->GetGrowingSize("").has_value(), "no path is the open file");

    zassert_true(rig.log_writer_service->Start(), "Start must succeed on a formatted volume with a logger");

    const auto files = rig.fs_service->ListFiles(LogFileNaming::LOGS_DIR);
    zassert_equal(files.size(), 1, "Start opens one file (found %zu)", files.size());
    const std::string path = std::string(LogFileNaming::LOGS_DIR) + "/" + files[0];

    // Start() synced the header: the synced size is the header's.
    const auto header_size = rig.log_writer_service->GetGrowingSize(path);
    zassert_true(header_size.has_value(), "the open file is growing");
    zassert_true(header_size.value() > 0, "the header is synced when Start returns");
    zassert_equal(rig.fs_service->GetFileSize(path).value_or(0), header_size.value(), "the volume shows the header");

    std::string upper_case = path;
    std::ranges::transform(upper_case, upper_case.begin(), [](unsigned char c) {
        return static_cast<char>(std::toupper(c));
    });
    zassert_true(rig.log_writer_service->GetGrowingSize(upper_case).has_value(), "compared as IsOpenFile() does");
    zassert_false(rig.log_writer_service->GetGrowingSize(other_path).has_value(), "another file does not grow");

    // Syncs follow; the synced size never goes back.
    k_sleep(K_MSEC(1000));

    const auto synced = rig.log_writer_service->GetGrowingSize(path);
    zassert_true(synced.has_value());
    zassert_true(synced.value() >= header_size.value(), "the synced size does not shrink");

    zassert_true(rig.log_writer_service->Stop(), "Stop must finalize and close the file");
    zassert_false(rig.log_writer_service->GetGrowingSize(path).has_value(), "a stopped writer has no file open");
    zassert_false(rig.log_writer_service->GetGrowingSize(upper_case).has_value(), "a stopped writer has no file open");
}

// The header is synced at Start(), so a volume that refuses writes fails the Start instead of
// a tick an interval later, and no empty file is left behind.
ZTEST(log_writer_service, test_StartFailsWhenTheHeaderCannotReachTheVolume) {
    const auto rig = MakeLogWriterRig();
    const std::string filler_path = "start_fill.bin";

    // Created before the fill so that Start() gets as far as the file, not just the directory.
    zassert_true(
        rig.fs_service->CreateDirectory(LogFileNaming::LOGS_DIR),
        "the data directory could not be created on an empty volume"
    );

    const std::vector<uint8_t> chunk(4096, 0xA5);
    int appends = 0;
    while(appends < 1024 && rig.fs_service->WriteFile(filler_path, chunk.data(), chunk.size(), true))
        appends++;
    zassert_true(appends > 0 && appends < 1024, "the volume did not fill up");

    zassert_false(rig.log_writer_service->Start(), "Start must fail when the header cannot be synced");

    const auto files = rig.fs_service->ListFiles(LogFileNaming::LOGS_DIR);
    zassert_equal(files.size(), 0, "a failed Start must not leave a file behind (found %zu)", files.size());

    if(!rig.fs_service->DeleteFile(filler_path))
        zassert_true(rig.fs_service->Format(), "the filler could neither be deleted nor formatted away");

    zassert_true(rig.log_writer_service->Start(), "Start must succeed once the volume has room again");
    zassert_true(rig.log_writer_service->Stop(), "Stop must finalize and close the file");
}
```

## src/log_writer_timing.cpp
```c
// The log writer's deadlines against the clock. native_sim only, where code takes no simulated
// time: every tick lands on its deadline, so periods and phases come out exact.
#include <cstdint>
#include <cstdlib>
#include <memory>

#include <zephyr/kernel.h>
#include <zephyr/ztest.h>

#include "domain/sensor_domain/models/sensor_limits.h"

#include "log_writer_probe.h"
#include "logging_test_support.h"

#ifdef CONFIG_BOARD_NATIVE_SIM

using namespace logging_test_support;
using eerie_leap::domain::sensor_domain::models::SensorLimits;

namespace {

int64_t MsToTicks(int64_t ms) {
    return static_cast<int64_t>(k_ms_to_ticks_ceil64(static_cast<uint64_t>(ms)));
}

// The rig over MakeLoggedSensors() with a probe around the logger, and a held value in the frame,
// so that every tick offers the logger a reading and the probe sees every tick.
std::shared_ptr<ProbeLogger> AttachProbe(LogWriterRig& rig, const Sensor& value_sensor) {
    auto probe = std::make_shared<ProbeLogger>(rig.logger_factory());
    rig.log_writer_service->SetLoggerFactory([probe] {
        return probe;
    });

    PublishValue(rig, value_sensor, 1, rig.time_service->GetCurrentTime());

    return probe;
}

} // namespace

ZTEST_SUITE(log_writer_timing, NULL, NULL, ResetAfterTest, NULL, NULL);

// Before Phase 4 the tick re-armed a relative interval when it ended: the tick's own duration and
// the kernel's rounding of a relative timeout up to the next tick edge added to every period.
// Absolute deadlines add neither.
ZTEST(log_writer_timing, test_TwentyMillisecondTicksKeepTheirPhase) {
    constexpr int64_t INTERVAL_MS = 20;
    constexpr size_t TICKS = 100;

    const auto sensors = MakeLoggedSensors();
    auto rig = MakeLogWriterRig(sensors, false);
    StoreLoggingConfiguration(rig, INTERVAL_MS);
    const auto probe = AttachProbe(rig, *sensors[0]);

    const int64_t interval_ticks = MsToTicks(INTERVAL_MS);
    const int64_t start_ticks = k_uptime_ticks();
    zassert_true(rig.log_writer_service->Start(), "Start must succeed on a formatted volume with a logger");
    k_sleep(K_TIMEOUT_ABS_TICKS(start_ticks + static_cast<int64_t>(TICKS) * interval_ticks + interval_ticks / 2));
    zassert_true(rig.log_writer_service->Stop(), "Stop must finalize and close the file");

    const auto& times = probe->tick_times;
    zassert_true(times.size() >= TICKS, "%zu ticks in %zu intervals", times.size(), TICKS);
    zassert_true(
        std::abs(times[0] - (start_ticks + interval_ticks)) <= 1,
        "the first tick is one interval after Start(), not %lld ticks", static_cast<long long>(times[0] - start_ticks)
    );

    // No drift: every tick on the phase the first one set, within one kernel tick.
    for(size_t i = 1; i < TICKS; i++) {
        const int64_t deviation = times[i] - times[0] - static_cast<int64_t>(i) * interval_ticks;
        zassert_true(
            std::abs(deviation) <= 1, "tick %zu is %lld kernel ticks off the phase", i,
            static_cast<long long>(deviation)
        );
    }

    const int64_t total_ticks = times[TICKS - 1] - times[0];
    const int64_t expected_ticks = static_cast<int64_t>(TICKS - 1) * interval_ticks;
    zassert_true(
        std::abs(total_ticks - expected_ticks) <= 1, "mean period %lld/%zu kernel ticks, %lld expected per tick",
        static_cast<long long>(total_ticks), TICKS - 1, static_cast<long long>(interval_ticks)
    );

    const auto stats = rig.log_writer_service->GetStats();
    zassert_equal(stats.overruns, 0, "a tick that takes no time overruns nothing (got %u)", stats.overruns);
}

// A drain that empties a full raw queue may have left frames behind: the next tick comes a quarter
// of an interval later, and the ones after it an interval apart again.
ZTEST(log_writer_timing, test_AFullDrainBringsTheNextTickForward) {
    constexpr int64_t INTERVAL_MS = 200;

    const auto sensors = MakeLoggedSensors();
    auto rig = MakeLogWriterRig(sensors, false);
    StoreLoggingConfiguration(rig, INTERVAL_MS);
    const auto probe = AttachProbe(rig, *sensors[0]);

    const int64_t start_ticks = k_uptime_ticks();
    zassert_true(rig.log_writer_service->Start(), "Start must succeed on a formatted volume with a logger");
    for(size_t i = 0; i < SensorLimits::RAW_CAN_QUEUE_SIZE; i++)
        PublishFrame(rig, *sensors[1], static_cast<uint8_t>(i), rig.time_service->GetCurrentTime());

    k_sleep(K_TIMEOUT_ABS_TICKS(start_ticks + MsToTicks(500)));
    zassert_true(rig.log_writer_service->Stop(), "Stop must finalize and close the file");

    const auto stats = rig.log_writer_service->GetStats();
    zassert_equal(
        stats.frames, SensorLimits::RAW_CAN_QUEUE_SIZE, "every queued frame is logged (got %u)", stats.frames
    );
    zassert_equal(stats.frames_dropped, 0, "a queue filled to its size drops nothing (got %u)", stats.frames_dropped);

    const auto& times = probe->tick_times;
    zassert_equal(times.size(), 3, "ticks at 200, 250 and 450 ms (got %zu)", times.size());
    zassert_true(
        std::abs(times[0] - start_ticks - MsToTicks(INTERVAL_MS)) <= 1, "the first tick is one interval after Start()"
    );
    zassert_true(
        std::abs(times[1] - times[0] - MsToTicks(INTERVAL_MS / 4)) <= 1,
        "the tick after a full drain comes a quarter interval later, not %lld kernel ticks",
        static_cast<long long>(times[1] - times[0])
    );
    zassert_true(
        std::abs(times[2] - times[1] - MsToTicks(INTERVAL_MS)) <= 1,
        "the next one an interval later, not %lld kernel ticks", static_cast<long long>(times[2] - times[1])
    );
}

#endif // CONFIG_BOARD_NATIVE_SIM
```
