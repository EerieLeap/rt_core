## CMakeLists.txt
```
cmake_minimum_required(VERSION 3.20.0)

include(${CMAKE_CURRENT_SOURCE_DIR}/../../rt_core_test.cmake)

find_package(Zephyr REQUIRED HINTS $ENV{ZEPHYR_BASE})
project(functional_dfu)

include(${RT_CORE_DIR}/cmake/image_identity.cmake)

# ======== Test images ========
#
# Firmware images signed at configure time with MCUboot's imgtool and the committed development key,
# from a small payload each, and embedded as arrays in a generated header (dfu_test_images.h). They
# differ in the identity TLV they carry: this unit's, another product's, another board's, a malformed
# one, none at all, and one whose protected TLVs are more than a unit accepts.

set(TEST_PRODUCT_ID 4660)
set(TEST_PAYLOAD_SIZE 6000)
# What the slots of boards/native_sim.overlay are; imgtool wants the size to know what fits.
set(TEST_SLOT_SIZE 0x10000)

if(DEFINED ZEPHYR_MCUBOOT_MODULE_DIR AND EXISTS "${ZEPHYR_MCUBOOT_MODULE_DIR}/scripts/imgtool.py")
    set(IMGTOOL ${PYTHON_EXECUTABLE} ${ZEPHYR_MCUBOOT_MODULE_DIR}/scripts/imgtool.py)
else()
    find_program(IMGTOOL_PROGRAM imgtool)
    if(NOT IMGTOOL_PROGRAM)
        message(FATAL_ERROR "imgtool is needed to sign the test images: the mcuboot module's scripts/imgtool.py, or imgtool on PATH.")
    endif()
    set(IMGTOOL ${IMGTOOL_PROGRAM})
endif()

set(SIGNING_KEY ${RT_CORE_DIR}/keys/dev-ec-p256.pem)
set(IMAGE_DIR ${CMAKE_CURRENT_BINARY_DIR}/test_images)
file(MAKE_DIRECTORY ${IMAGE_DIR})
set_property(DIRECTORY APPEND PROPERTY CMAKE_CONFIGURE_DEPENDS ${SIGNING_KEY})

set(IMAGES_HEADER ${IMAGE_DIR}/dfu_test_images.h)
file(WRITE ${IMAGES_HEADER}
"// Generated by CMakeLists.txt: the signed test images.
#pragma once

#include <cstdint>

namespace dfu_test::images {

")

# sign_test_image(<name> <payload seed> <version> [imgtool arguments...])
#
# Signs a payload of TEST_PAYLOAD_SIZE bytes built from <payload seed> and appends to the header:
# <NAME> (the image file), <NAME>_SHA256 (the hash of the file as hex text, which the upload sends as
# `sha`) and <NAME>_VERSION (the version img_mgmt lists).
function(sign_test_image name seed version)
    set(payload ${IMAGE_DIR}/${name}.payload.bin)
    set(image ${IMAGE_DIR}/${name}.bin)

    string(LENGTH "${seed}" seed_length)
    math(EXPR repeats "${TEST_PAYLOAD_SIZE} / ${seed_length} + 1")
    string(REPEAT "${seed}" ${repeats} pattern)
    string(SUBSTRING "${pattern}" 0 ${TEST_PAYLOAD_SIZE} pattern)
    file(WRITE ${payload} "${pattern}")

    execute_process(
        COMMAND ${IMGTOOL} sign
            --key ${SIGNING_KEY}
            --header-size 0x200
            --pad-header
            --align 4
            --version ${version}
            --slot-size ${TEST_SLOT_SIZE}
            ${ARGN}
            ${payload} ${image}
        RESULT_VARIABLE result
        OUTPUT_VARIABLE output
        ERROR_VARIABLE output
    )
    if(NOT result EQUAL 0)
        message(FATAL_ERROR "imgtool failed to sign the test image ${name}:\n${output}")
    endif()

    file(READ ${image} hex HEX)
    string(REGEX REPLACE "([0-9a-f][0-9a-f])" "0x\\1," bytes "${hex}")
    file(SHA256 ${image} sha256)

    # The version as img_mgmt prints it: major.minor.revision, and .build when it is not 0.
    string(REPLACE "+" "." printed_version "${version}")
    string(REGEX REPLACE "\\.0$" "" printed_version "${printed_version}")

    string(TOUPPER ${name} upper)
    file(APPEND ${IMAGES_HEADER}
"inline constexpr uint8_t ${upper}[] = {${bytes}};
inline constexpr char ${upper}_SHA256[] = \"${sha256}\";
inline constexpr char ${upper}_VERSION[] = \"${printed_version}\";

")
endfunction()

eerie_leap_image_identity_hex(${TEST_PRODUCT_ID} "${CONFIG_BOARD_TARGET}" own_identity)

math(EXPR other_product "${TEST_PRODUCT_ID} + 1")
eerie_leap_image_identity_hex(${other_product} "${CONFIG_BOARD_TARGET}" other_product_identity)
eerie_leap_image_identity_hex(${TEST_PRODUCT_ID} "other_board/soc/core" other_board_identity)

# A TLV that is not an identity: a wrong format byte, and a board length that exceeds the value.
set(malformed_identity "0x02a8")
# 130 bytes of another protected TLV, so that the protected area is above the 128 bytes a unit accepts.
string(REPEAT "ab" 130 filler_hex)

sign_test_image(good "0123456789abcdef" 1.2.3+4 --custom-tlv ${EERIE_LEAP_IMAGE_IDENTITY_TLV_TAG} ${own_identity})
sign_test_image(good_other "fedcba9876543210" 1.2.4+5 --custom-tlv ${EERIE_LEAP_IMAGE_IDENTITY_TLV_TAG} ${own_identity})
sign_test_image(wrong_product "0123456789abcdef" 1.2.3+4 --custom-tlv ${EERIE_LEAP_IMAGE_IDENTITY_TLV_TAG} ${other_product_identity})
sign_test_image(wrong_board "0123456789abcdef" 1.2.3+4 --custom-tlv ${EERIE_LEAP_IMAGE_IDENTITY_TLV_TAG} ${other_board_identity})
sign_test_image(bad_identity "0123456789abcdef" 1.2.3+4 --custom-tlv ${EERIE_LEAP_IMAGE_IDENTITY_TLV_TAG} ${malformed_identity})
sign_test_image(no_identity "0123456789abcdef" 1.2.3+4)
sign_test_image(
    oversize_tlvs "0123456789abcdef" 1.2.3+4
    --custom-tlv ${EERIE_LEAP_IMAGE_IDENTITY_TLV_TAG} ${own_identity}
    --custom-tlv 0xa1 0x${filler_hex}
)

file(APPEND ${IMAGES_HEADER} "} // namespace dfu_test::images\n")

# ======== Test application ========

file(GLOB_RECURSE TEST_SOURCES src/*.c src/*.cpp)

target_sources(app PRIVATE ${TEST_SOURCES})

# The tests include img_mgmt.h and MCUboot's dfu/mcuboot.h, which need bootutil's headers.
target_link_libraries(app PRIVATE MCUBOOT_BOOTUTIL)

# The test client injects requests with smp_rx_req().
target_include_directories(app PRIVATE
    ${IMAGE_DIR}
    ${RT_CORE_DIR}/tests/common
    ${ZEPHYR_BASE}/subsys/mgmt/mcumgr/transport/include
)

target_compile_definitions(app PRIVATE
    DFU_TEST_PRODUCT_ID=${TEST_PRODUCT_ID}
    DFU_TEST_PAYLOAD_SIZE=${TEST_PAYLOAD_SIZE}
)
```

## prj.conf
```kconfig
CONFIG_ZTEST=y

# Language and Compiler
CONFIG_CPP=y
CONFIG_PICOLIBC=y
CONFIG_STD_CPP23=y
CONFIG_REQUIRES_FULL_LIBCPP=y
CONFIG_CPP_EXCEPTIONS=y
CONFIG_CPP_RTTI=y

# Memory
CONFIG_HEAP_MEM_POOL_SIZE=200000

# C++ exception unwinding needs considerably more stack than the ztest defaults.
CONFIG_MAIN_STACK_SIZE=8192
CONFIG_ZTEST_STACK_SIZE=8192

# Logging And Debugging
CONFIG_LOG=y
CONFIG_TEST_RANDOM_GENERATOR=y
CONFIG_THREAD_NAME=y

# ThreadBase::InitializeStack() falls back to k_thread_stack_alloc().
CONFIG_THREAD_STACK_INFO=y
CONFIG_DYNAMIC_THREAD=y
CONFIG_DYNAMIC_THREAD_ALLOC=y

# The image slots: native_sim's flash simulator with the partitions of boards/native_sim.overlay. MCUboot
# itself and its swap mode are set by the scenarios (testcase.yaml).
CONFIG_FLASH=y
CONFIG_FLASH_MAP=y

CONFIG_EERIE_LEAP_RT_CORE=y
CONFIG_EERIE_LEAP_SMP=y
CONFIG_EERIE_LEAP_DFU=y

# The image signing step and DfuController need the unit's product ID (CMakeLists.txt signs the test images
# for the same one).
CONFIG_EERIE_LEAP_CONFIGURATION=y
CONFIG_EERIE_LEAP_DOMAIN_SYSTEM=y
CONFIG_EERIE_LEAP_PRODUCT_ID=4660

# DfuController's timing, short for the tests that run it for real: it ticks every quarter of the
# watchdog timeout (native_sim has no watchdog0, so only the tick uses it).
CONFIG_EERIE_LEAP_DFU_CONFIRM_DELAY_MS=300
CONFIG_EERIE_LEAP_DFU_WATCHDOG_TIMEOUT_MS=400
```

## boards/native_sim.overlay
```dts
/*
 * Two small image slots on native_sim's flash simulator, for the firmware update suite.
 *
 * The stock slots are 420 KB each, many times what a test image needs, and the application's overlay
 * (app/boards) puts the internal file system over them. 64 KB (16 sectors of 4 KB) hold the test
 * images (about 7 KB) and the swap trailers of both swap modes, and the sector count keeps erases quick.
 * The mcuboot, scratch and storage partitions stay where they are.
 */
&flash0 {
	partitions {
		/delete-node/ partition@c000;
		/delete-node/ partition@75000;

		slot0_partition: partition@c000 {
			compatible = "zephyr,mapped-partition";
			label = "image-0";
			reg = <0x0000c000 DT_SIZE_K(64)>;
		};

		slot1_partition: partition@1c000 {
			compatible = "zephyr,mapped-partition";
			label = "image-1";
			reg = <0x0001c000 DT_SIZE_K(64)>;
		};
	};
};
```

## src/dfu_controller.cpp
```c
#include <atomic>
#include <cstdint>
#include <functional>
#include <memory>
#include <optional>
#include <vector>

#include <zephyr/kernel.h>
#include <zephyr/ztest.h>

#include "controllers/dfu_controller.h"
#include "subsys/dfu/zephyr_watchdog.h"

#include "dfu_test_support.h"

// bootutil_public.c: writes the trailer magic of a slot. It is not in the public header.
extern "C" int boot_write_magic(const struct flash_area* fap);

using namespace dfu_test;

using eerie_leap::controllers::DfuController;
using eerie_leap::subsys::dfu::IBootControl;
using eerie_leap::subsys::dfu::ImageConfirmationConfig;
using eerie_leap::subsys::dfu::IWatchdog;
using eerie_leap::subsys::dfu::ZephyrWatchdog;
using eerie_leap::subsys::threading::WorkQueueThread;

namespace {

constexpr uint8_t STATUS = 0;

// The timing of the injected configuration: ticks every 100 ms, and a probe may wait 200 ms.
constexpr ImageConfirmationConfig FAKE_CONFIG{
    .self_confirm = true,
    .boot_deadline_ms = 600,
    .confirm_delay_ms = 300,
    .watchdog_timeout_ms = 400,
};

// The same, with a confirmation delay that outlasts the tests which block a queue after boot complete: they
// must not race the confirmation.
constexpr ImageConfirmationConfig SLOW_CONFIRM_CONFIG{
    .self_confirm = true,
    .boot_deadline_ms = 600,
    .confirm_delay_ms = 3000,
    .watchdog_timeout_ms = 400,
};

class FakeBootControl final : public IBootControl {
public:
    std::atomic<bool> is_confirmed{ false };
    std::atomic<int> confirm_calls{ 0 };

    [[nodiscard]] bool IsConfirmed() const override {
        return is_confirmed.load();
    }

    [[nodiscard]] int Confirm() override {
        confirm_calls++;
        is_confirmed = true;

        return 0;
    }
};

class FakeWatchdog final : public IWatchdog {
public:
    std::atomic<int> installs{ 0 };
    std::atomic<int> starts{ 0 };
    std::atomic<int> feeds{ 0 };
    std::atomic<int> disables{ 0 };

    [[nodiscard]] int Install(uint32_t) override {
        installs++;
        return 0;
    }

    [[nodiscard]] int Start() override {
        starts++;
        return 0;
    }

    [[nodiscard]] int Feed() override {
        feeds++;
        return 0;
    }

    [[nodiscard]] int Disable() override {
        disables++;
        return 0;
    }
};

// A work queue of its own, so that a test can keep it busy. One for the whole suite: a queue's thread
// outlives any object that a test could keep its stack in.
class TestWorkQueue {
private:
    k_work_q work_q_{};
    K_KERNEL_STACK_MEMBER(stack_, 2048) {};

public:
    TestWorkQueue() {
        k_work_queue_init(&work_q_);
        k_work_queue_start(&work_q_, stack_, K_KERNEL_STACK_SIZEOF(stack_), K_PRIO_PREEMPT(10), nullptr);
    }

    static TestWorkQueue& Instance() {
        static TestWorkQueue instance;

        return instance;
    }

    TestWorkQueue(const TestWorkQueue&) = delete;
    TestWorkQueue& operator=(const TestWorkQueue&) = delete;
    TestWorkQueue(TestWorkQueue&&) = delete;
    TestWorkQueue& operator=(TestWorkQueue&&) = delete;
    ~TestWorkQueue() = default;

    k_work_q* Get() {
        return &work_q_;
    }
};

// Blocks a work queue's thread until released.
struct Blocker {
    k_work work{};
    k_sem release{};

    Blocker() {
        k_sem_init(&release, 0, 1);
        k_work_init(&work, [](k_work* item) {
            k_sem_take(&CONTAINER_OF(item, Blocker, work)->release, K_FOREVER);
        });
    }

    void Block(k_work_q* work_q) {
        k_work_submit_to_queue(work_q, &work);
    }

    // Lets the queue go on and waits until the work is done with this object.
    void Release() {
        k_sem_give(&release);

        k_work_sync sync{};
        k_work_flush(&work, &sync);
    }
};

bool WaitFor(const std::function<bool()>& condition, int timeout_ms) {
    for(int waited = 0; waited < timeout_ms; waited += 10) {
        if(condition())
            return true;

        k_msleep(10);
    }

    return condition();
}

// Marks the running image (slot 0) unconfirmed, as MCUboot leaves it after a swap for a test: the trailer
// has the magic, and image_ok is not set.
void MarkSlot0Unconfirmed() {
    const flash_area* area = OpenSlot(SLOT0_ID);
    zassert_equal(boot_write_magic(area), 0);
    flash_area_close(area);

    zassert_false(boot_is_img_confirmed(), "The slot trailer does not mark slot 0 unconfirmed");
}

struct dfu_controller_fixture {
    SmpTestClient client;
    FakeBootControl boot_control;
    FakeWatchdog watchdog;
    std::optional<DfuController> controller;
    // Owned by the fixture, not by a test: a failed assertion leaves the test body without running its
    // destructors, and a blocker that is gone while its work still holds the static queue would wedge the
    // rest of the suite.
    std::vector<std::unique_ptr<Blocker>> blockers;

    Blocker& NewBlocker() {
        blockers.push_back(std::make_unique<Blocker>());

        return *blockers.back();
    }

    // Lets every blocked queue go on, and forgets the blockers.
    void ReleaseBlockers() {
        for(const auto& blocker : blockers)
            blocker->Release();

        blockers.clear();
    }
};

void* SetUp() {
    return new dfu_controller_fixture();
}

// Every test starts with an empty slot 0 (a confirmed image, as a preprogrammed one counts) and no controller.
void Before(void* data) {
    auto* fixture = static_cast<dfu_controller_fixture*>(data);

    fixture->ReleaseBlockers();
    fixture->controller.reset();
    fixture->boot_control.is_confirmed = false;
    fixture->boot_control.confirm_calls = 0;
    fixture->watchdog.installs = 0;
    fixture->watchdog.starts = 0;
    fixture->watchdog.feeds = 0;
    fixture->watchdog.disables = 0;

    EraseSlot(SLOT0_ID);
    EraseSlot(SLOT1_ID);
}

void After(void* data) {
    auto* fixture = static_cast<dfu_controller_fixture*>(data);

    // The blocked queues first: the probes of the controller wait for their work items.
    fixture->ReleaseBlockers();
    fixture->controller.reset();
}

void TearDown(void* data) {
    delete static_cast<dfu_controller_fixture*>(data);
}

} // namespace

ZTEST_SUITE(dfu_controller, NULL, SetUp, Before, After, TearDown);

ZTEST_F(dfu_controller, test_confirmed_image_arms_nothing) {
    fixture->controller.emplace();
    zassert_equal(fixture->controller->Initialize(), 0);

    zassert_equal(fixture->controller->GetState(), DfuState::CONFIRMED);

    const Response response = fixture->client.Read(SmpGroupId::DFU, STATUS);
    zassert_true(response.IsOk());
    zassert_true(response.Flag("confirmed"));
    zassert_equal(response.Value("state"), std::to_underlying(DfuState::CONFIRMED));
    zassert_false(response.Has("confirm_in_ms"));
    zassert_true(response.Has("reset_cause"));

    // Boot complete has nothing to do, and nothing runs in the background.
    fixture->controller->ReportBootComplete();
    k_msleep(100);
    zassert_equal(fixture->controller->GetState(), DfuState::CONFIRMED);
    zassert_true(boot_is_img_confirmed());
}

ZTEST_F(dfu_controller, test_confirmed_image_skips_the_probes) {
    TestWorkQueue& work_q = TestWorkQueue::Instance();
    Blocker& blocker = fixture->NewBlocker();

    fixture->controller.emplace(fixture->boot_control, &fixture->watchdog, FAKE_CONFIG);
    fixture->boot_control.is_confirmed = true;
    zassert_equal(fixture->controller->Initialize(), 0);

    // A stuck queue changes nothing for a confirmed image.
    blocker.Block(work_q.Get());
    fixture->controller->RegisterLivenessProbe("stuck", work_q.Get());
    k_msleep(300);

    zassert_equal(fixture->controller->GetState(), DfuState::CONFIRMED);
    zassert_equal(fixture->watchdog.installs.load(), 0, "A confirmed image must not arm the watchdog");
    zassert_equal(fixture->watchdog.feeds.load(), 0);

    blocker.Release();
}

#ifndef CONFIG_EERIE_LEAP_DFU_BENCH_FAULT_NO_REPORT

// The real bootutil on the flash simulator: slot 0 with the trailer of an unconfirmed image.
ZTEST_F(dfu_controller, test_unconfirmed_image_confirms_after_boot_complete) {
    zassert_false(ZephyrWatchdog::IsSupported(), "native_sim has no watchdog0");

    MarkSlot0Unconfirmed();

    fixture->controller.emplace();
    zassert_equal(fixture->controller->Initialize(), 0);
    zassert_equal(fixture->controller->GetState(), DfuState::VERIFYING);

    Response response = fixture->client.Read(SmpGroupId::DFU, STATUS);
    zassert_true(response.IsOk());
    zassert_false(response.Flag("confirmed"));
    zassert_equal(response.Value("state"), std::to_underlying(DfuState::VERIFYING));
    zassert_false(response.Has("confirm_in_ms"));

    // Without boot complete the image stays as it is, however long it runs.
    k_msleep(3 * CONFIG_EERIE_LEAP_DFU_CONFIRM_DELAY_MS);
    zassert_equal(fixture->controller->GetState(), DfuState::VERIFYING);
    zassert_false(boot_is_img_confirmed());

    fixture->controller->ReportBootComplete();
    zassert_equal(fixture->controller->GetState(), DfuState::CONFIRMING);

    response = fixture->client.Read(SmpGroupId::DFU, STATUS);
    zassert_true(response.IsOk());
    zassert_false(response.Flag("confirmed"));
    zassert_equal(response.Value("state"), std::to_underlying(DfuState::CONFIRMING));
    zassert_true(response.Has("confirm_in_ms"));
    zassert_true(response.Value("confirm_in_ms") <= CONFIG_EERIE_LEAP_DFU_CONFIRM_DELAY_MS);

    zassert_true(
        WaitFor(
            [] {
                return boot_is_img_confirmed();
            },
            3 * CONFIG_EERIE_LEAP_DFU_CONFIRM_DELAY_MS + 500
        ),
        "The image did not confirm itself"
    );
    zassert_true(WaitFor(
        [&] {
            return fixture->controller->GetState() == DfuState::CONFIRMED;
        },
        500
    ));

    response = fixture->client.Read(SmpGroupId::DFU, STATUS);
    zassert_true(response.IsOk());
    zassert_true(response.Flag("confirmed"));
    zassert_equal(response.Value("state"), std::to_underlying(DfuState::CONFIRMED));
    zassert_false(response.Has("confirm_in_ms"));
}

// A client that confirms through img_mgmt makes the controller stand down.
ZTEST_F(dfu_controller, test_client_confirm_stands_down) {
    MarkSlot0Unconfirmed();

    fixture->controller.emplace();
    zassert_equal(fixture->controller->Initialize(), 0);
    zassert_equal(fixture->controller->GetState(), DfuState::VERIFYING);

    zassert_equal(boot_write_img_confirmed(), 0);

    zassert_true(WaitFor(
        [&] {
            return fixture->controller->GetState() == DfuState::CONFIRMED;
        },
        2000
    ));
}

ZTEST_F(dfu_controller, test_unconfirmed_image_arms_the_watchdog_and_disables_it_once_confirmed) {
    fixture->controller.emplace(fixture->boot_control, &fixture->watchdog, FAKE_CONFIG);
    zassert_equal(fixture->controller->Initialize(), 0);

    zassert_equal(fixture->controller->GetState(), DfuState::VERIFYING);
    zassert_equal(fixture->watchdog.installs.load(), 1);
    zassert_equal(fixture->watchdog.starts.load(), 1);

    zassert_true(
        WaitFor(
            [&] {
                return fixture->watchdog.feeds.load() >= 2;
            },
            500
        ),
        "A healthy verifying image feeds the watchdog"
    );

    fixture->controller->ReportBootComplete();

    zassert_true(WaitFor(
        [&] {
            return fixture->controller->GetState() == DfuState::CONFIRMED;
        },
        2000
    ));
    zassert_equal(fixture->boot_control.confirm_calls.load(), 1);
    zassert_true(WaitFor(
        [&] {
            return fixture->watchdog.disables.load() == 1;
        },
        500
    ));
}

ZTEST_F(dfu_controller, test_a_stuck_queue_stops_the_feeding) {
    TestWorkQueue& work_q = TestWorkQueue::Instance();
    Blocker& blocker = fixture->NewBlocker();

    fixture->controller.emplace(fixture->boot_control, &fixture->watchdog, SLOW_CONFIRM_CONFIG);
    zassert_equal(fixture->controller->Initialize(), 0);
    fixture->controller->RegisterLivenessProbe("test_queue", work_q.Get());
    fixture->controller->ReportBootComplete();

    zassert_true(WaitFor(
        [&] {
            return fixture->watchdog.feeds.load() >= 2;
        },
        500
    ));

    blocker.Block(work_q.Get());

    zassert_true(
        WaitFor(
            [&] {
                return fixture->controller->GetState() == DfuState::FAILED;
            },
            1000
        ),
        "A stuck probe must fail the image"
    );

    const int feeds = fixture->watchdog.feeds.load();
    k_msleep(300);
    zassert_equal(fixture->watchdog.feeds.load(), feeds, "A failed image must not feed the watchdog");
    zassert_equal(fixture->boot_control.confirm_calls.load(), 0, "A failed image must not confirm");

    blocker.Release();
}

// A queue that is stuck from the moment the boot completes never runs its probe: the image fails and is never
// confirmed, although the confirmation delay (300 ms) ends before the probe's time is up and the failure is found.
ZTEST_F(dfu_controller, test_a_queue_stuck_at_boot_complete_fails_the_image_without_confirming) {
    TestWorkQueue& work_q = TestWorkQueue::Instance();
    Blocker& blocker = fixture->NewBlocker();

    fixture->controller.emplace(fixture->boot_control, &fixture->watchdog, FAKE_CONFIG);
    zassert_equal(fixture->controller->Initialize(), 0);
    fixture->controller->RegisterLivenessProbe("test_queue", work_q.Get());
    blocker.Block(work_q.Get());
    fixture->controller->ReportBootComplete();

    zassert_true(
        WaitFor(
            [&] {
                return fixture->controller->GetState() == DfuState::FAILED;
            },
            1000
        ),
        "A stuck probe must fail the image"
    );
    k_msleep(300);
    zassert_equal(fixture->boot_control.confirm_calls.load(), 0, "The image must not confirm with a probe outstanding");

    blocker.Release();
}

// While the image verifies, a unit that is still booting may keep its queues from running for a long time.
ZTEST_F(dfu_controller, test_a_stuck_queue_does_not_fail_a_verifying_image) {
    TestWorkQueue& work_q = TestWorkQueue::Instance();
    Blocker& blocker = fixture->NewBlocker();

    fixture->controller.emplace(fixture->boot_control, &fixture->watchdog, FAKE_CONFIG);
    zassert_equal(fixture->controller->Initialize(), 0);
    fixture->controller->RegisterLivenessProbe("test_queue", work_q.Get());
    blocker.Block(work_q.Get());

    // Well past what a probe may wait, still inside the boot deadline.
    k_msleep(350);
    zassert_equal(fixture->controller->GetState(), DfuState::VERIFYING);
    const int feeds = fixture->watchdog.feeds.load();
    zassert_true(feeds >= 2, "The watchdog is fed while the boot may still complete");

    blocker.Release();
}

// The queue of a WorkQueueThread is kept alive for its probe, whoever else releases it.
ZTEST_F(dfu_controller, test_a_probe_keeps_its_queue_alive) {
    auto queue_thread = std::make_shared<WorkQueueThread>("dfu_test_queue", 2048, 5);
    zassert_true(queue_thread->Initialize());

    fixture->controller.emplace(fixture->boot_control, &fixture->watchdog, FAKE_CONFIG);
    zassert_equal(fixture->controller->Initialize(), 0);
    fixture->controller->RegisterLivenessProbe("owned_queue", queue_thread);
    queue_thread.reset();

    fixture->controller->ReportBootComplete();

    zassert_true(WaitFor(
        [&] {
            return fixture->controller->GetState() == DfuState::CONFIRMED;
        },
        2000
    ));
}

// A queue that is not running cannot be probed: it is skipped, and the unit goes on.
ZTEST_F(dfu_controller, test_a_queue_that_is_not_running_is_skipped) {
    const auto queue_thread = std::make_shared<WorkQueueThread>("dfu_test_idle", 2048, 5);

    fixture->controller.emplace(fixture->boot_control, &fixture->watchdog, FAKE_CONFIG);
    zassert_equal(fixture->controller->Initialize(), 0);
    fixture->controller->RegisterLivenessProbe("idle_queue", queue_thread);
    fixture->controller->RegisterLivenessProbe("missing_queue", std::shared_ptr<WorkQueueThread>());
    fixture->controller->ReportBootComplete();

    zassert_true(WaitFor(
        [&] {
            return fixture->controller->GetState() == DfuState::CONFIRMED;
        },
        2000
    ));
}

ZTEST_F(dfu_controller, test_a_running_queue_keeps_the_image_healthy) {
    TestWorkQueue& work_q = TestWorkQueue::Instance();

    fixture->controller.emplace(fixture->boot_control, &fixture->watchdog, FAKE_CONFIG);
    zassert_equal(fixture->controller->Initialize(), 0);
    fixture->controller->RegisterLivenessProbe("test_queue", work_q.Get());
    fixture->controller->ReportBootComplete();

    zassert_true(WaitFor(
        [&] {
            return fixture->controller->GetState() == DfuState::CONFIRMED;
        },
        2000
    ));
    zassert_equal(fixture->boot_control.confirm_calls.load(), 1);
}

#endif // !CONFIG_EERIE_LEAP_DFU_BENCH_FAULT_NO_REPORT

ZTEST_F(dfu_controller, test_a_missed_deadline_stops_the_feeding) {
    fixture->controller.emplace(fixture->boot_control, &fixture->watchdog, FAKE_CONFIG);
    zassert_equal(fixture->controller->Initialize(), 0);

    zassert_true(WaitFor(
        [&] {
            return fixture->controller->GetState() == DfuState::FAILED;
        },
        FAKE_CONFIG.boot_deadline_ms + 500
    ));

    const int feeds = fixture->watchdog.feeds.load();
    k_msleep(300);
    zassert_equal(fixture->watchdog.feeds.load(), feeds);

    // Too late: the report does not revive a failed image.
    fixture->controller->ReportBootComplete();
    zassert_equal(fixture->controller->GetState(), DfuState::FAILED);

    const Response response = fixture->client.Read(SmpGroupId::DFU, STATUS);
    zassert_true(response.IsOk());
    zassert_false(response.Flag("confirmed"));
    zassert_equal(response.Value("state"), std::to_underlying(DfuState::FAILED));
}

#ifdef CONFIG_EERIE_LEAP_DFU_BENCH_FAULT_NO_REPORT

// The no_report bench fault: an unconfirmed image never gets to confirm itself.
ZTEST_F(dfu_controller, test_bench_fault_ignores_boot_complete) {
    fixture->controller.emplace(fixture->boot_control, &fixture->watchdog, FAKE_CONFIG);
    zassert_equal(fixture->controller->Initialize(), 0);

    fixture->controller->ReportBootComplete();
    zassert_equal(fixture->controller->GetState(), DfuState::VERIFYING);

    zassert_true(WaitFor(
        [&] {
            return fixture->controller->GetState() == DfuState::FAILED;
        },
        FAKE_CONFIG.boot_deadline_ms + 500
    ));
    zassert_equal(fixture->boot_control.confirm_calls.load(), 0);
}

// A confirmed image runs normally, whatever the fault: a reverted image is not hurt by it.
ZTEST_F(dfu_controller, test_bench_fault_leaves_a_confirmed_image_alone) {
    fixture->boot_control.is_confirmed = true;
    fixture->controller.emplace(fixture->boot_control, &fixture->watchdog, FAKE_CONFIG);
    zassert_equal(fixture->controller->Initialize(), 0);

    fixture->controller->ReportBootComplete();
    zassert_equal(fixture->controller->GetState(), DfuState::CONFIRMED);
}

#endif // CONFIG_EERIE_LEAP_DFU_BENCH_FAULT_NO_REPORT
```

## src/dfu_group.cpp
```c
#include <zephyr/ztest.h>

#include "dfu_test_support.h"

using namespace dfu_test;

struct dfu_group_fixture {
    Unit* unit = nullptr;
};

namespace {

constexpr uint8_t STATUS = 0;

void* SetUp() {
    static dfu_group_fixture fixture{};
    fixture.unit = new Unit();

    return &fixture;
}

void Before(void* data) {
    auto* fixture = static_cast<dfu_group_fixture*>(data);

    fixture->unit->Start();
    fixture->unit->status_source.status = DfuStatus{};
}

void TearDown(void* data) {
    delete static_cast<dfu_group_fixture*>(data)->unit;
}

} // namespace

ZTEST_SUITE(dfu_group, NULL, SetUp, Before, NULL, TearDown);

ZTEST_F(dfu_group, test_status_of_a_confirmed_image) {
    const Response response = fixture->unit->client.Read(SmpGroupId::DFU, STATUS);

    zassert_true(response.IsOk());
    zassert_true(response.Flag("confirmed"));
    zassert_equal(response.Value("state"), std::to_underlying(DfuState::CONFIRMED));
    zassert_false(response.Has("confirm_in_ms"), "Only a confirming image has a time left");
    zassert_equal(response.Value("reset_cause"), 0);
}

ZTEST_F(dfu_group, test_status_while_verifying) {
    fixture->unit->status_source.status = {
        .confirmed = false,
        .state = DfuState::VERIFYING,
        .confirm_in_ms = std::nullopt,
        .reset_cause = 0x04,
    };

    const Response response = fixture->unit->client.Read(SmpGroupId::DFU, STATUS);

    zassert_true(response.IsOk());
    zassert_false(response.Flag("confirmed"));
    zassert_equal(response.Value("state"), std::to_underlying(DfuState::VERIFYING));
    zassert_false(response.Has("confirm_in_ms"));
    zassert_equal(response.Value("reset_cause"), 0x04);
}

ZTEST_F(dfu_group, test_status_while_confirming_has_the_time_left) {
    fixture->unit->status_source.status = {
        .confirmed = false,
        .state = DfuState::CONFIRMING,
        .confirm_in_ms = 12345,
        .reset_cause = 0x10,
    };

    const Response response = fixture->unit->client.Read(SmpGroupId::DFU, STATUS);

    zassert_true(response.IsOk());
    zassert_false(response.Flag("confirmed"));
    zassert_equal(response.Value("state"), std::to_underlying(DfuState::CONFIRMING));
    zassert_equal(response.Value("confirm_in_ms"), 12345);
    zassert_equal(response.Value("reset_cause"), 0x10);
}

ZTEST_F(dfu_group, test_status_of_a_failed_confirmation) {
    fixture->unit->status_source.status = {
        .confirmed = false,
        .state = DfuState::FAILED,
        .confirm_in_ms = std::nullopt,
        .reset_cause = 0,
    };

    const Response response = fixture->unit->client.Read(SmpGroupId::DFU, STATUS);

    zassert_true(response.IsOk());
    zassert_equal(response.Value("state"), std::to_underlying(DfuState::FAILED));
}

ZTEST_F(dfu_group, test_status_is_read_only) {
    const Response response = fixture->unit->client.Write(SmpGroupId::DFU, STATUS, CborMap().Build());

    zassert_false(response.IsOk());
}

ZTEST_F(dfu_group, test_unregistered_group_is_not_served) {
    Unit& unit = *fixture->unit;
    unit.group.reset();

    const auto response = unit.client.Send(smp_test::SmpOperation::READ, SmpGroupId::DFU, STATUS, CborMap().Build());

    // MCUmgr answers a group it does not know with an error.
    zassert_true(response.has_value());
    zassert_false(response->IsOk());
}
```

## src/dfu_test_support.h
```c
#pragma once

#include <algorithm>
#include <array>
#include <cstddef>
#include <cstdint>
#include <cstring>
#include <memory>
#include <optional>
#include <span>
#include <string>
#include <string_view>
#include <vector>

#include <zephyr/dfu/mcuboot.h>
#include <zephyr/mgmt/mcumgr/mgmt/mgmt_defines.h>
#include <zephyr/storage/flash_map.h>
#include <zephyr/ztest.h>

#include "dfu_test_images.h"
#include "smp_test_client.h"
#include "subsys/dfu/dfu_status.h"
#include "subsys/dfu/image_identity.h"
#include "subsys/dfu/image_upload_guard.h"
#include "subsys/dfu/mcuboot_headers.h"
#include "subsys/dfu/smp/dfu_mgmt_group.h"

namespace dfu_test {

using eerie_leap::subsys::dfu::DfuState;
using eerie_leap::subsys::dfu::DfuStatus;
using eerie_leap::subsys::dfu::IDfuStatusSource;
using eerie_leap::subsys::dfu::ImageIdentity;
using eerie_leap::subsys::dfu::ImageUploadGuard;
using eerie_leap::subsys::dfu::smp::DfuMgmtGroup;
using eerie_leap::subsys::smp::SmpGroupId;
using smp_test::Bytes;
using smp_test::CborMap;
using smp_test::Response;
using smp_test::SmpTestClient;

// MCUmgr's groups of Zephyr, which SmpGroupId (the application's groups) does not name.
inline constexpr auto IMG_GROUP = static_cast<SmpGroupId>(MGMT_GROUP_ID_IMAGE);
inline constexpr uint8_t IMG_STATE = 0;
inline constexpr uint8_t IMG_UPLOAD = 1;

// DfuError, as the dfu group sends them.
inline constexpr uint32_t ERROR_NO_IDENTITY = 2;
inline constexpr uint32_t ERROR_WRONG_PRODUCT = 3;
inline constexpr uint32_t ERROR_WRONG_BOARD = 4;
inline constexpr uint32_t ERROR_BAD_IDENTITY = 5;

inline constexpr size_t SLOT_SIZE = 0x10000;
inline constexpr size_t CHUNK_SIZE = 512;
inline constexpr size_t SHA_SIZE = 32;

using Image = std::span<const uint8_t>;

// The identity of this unit, which the images are signed for (CMakeLists.txt).
inline ImageIdentity OwnIdentity() {
    const auto identity = ImageIdentity::Create(DFU_TEST_PRODUCT_ID, CONFIG_BOARD_TARGET);
    zassert_true(identity.has_value());

    return *identity;
}

// A source of the dfu group's STATUS that says what a test sets.
class FakeStatusSource : public IDfuStatusSource {
public:
    DfuStatus status;

    [[nodiscard]] DfuStatus GetStatus() const override {
        return status;
    }
};

// The unit: image management of Zephyr, the upload guard and the dfu group, and a client.
struct Unit {
    FakeStatusSource status_source;
    std::optional<ImageUploadGuard> guard;
    std::optional<DfuMgmtGroup> group;
    SmpTestClient client;

    Unit() {
        Start();
    }

    // Registers the guard and the group.
    void Start() {
        guard.emplace(OwnIdentity());
        guard->Register();
        group.emplace(status_source);
        group->Register();
    }
};

// The flash area of an image slot.
inline const flash_area* OpenSlot(uint8_t area_id) {
    const flash_area* area = nullptr;
    zassert_equal(flash_area_open(area_id, &area), 0);

    return area;
}

inline constexpr uint8_t SLOT0_ID = PARTITION_ID(slot0_partition);
inline constexpr uint8_t SLOT1_ID = PARTITION_ID(slot1_partition);

// Erases an image slot, trailer included.
inline void EraseSlot(uint8_t area_id) {
    const flash_area* area = OpenSlot(area_id);
    zassert_equal(flash_area_flatten(area, 0, area->fa_size), 0);
    flash_area_close(area);
}

// Whether the first 32 bytes of the image in slot 1 (where MCUboot's mode puts it) are erased.
inline bool IsSlot1HeaderErased() {
    const flash_area* area = OpenSlot(SLOT1_ID);
    std::array<uint8_t, 32> header{};
    zassert_equal(flash_area_read(area, boot_get_image_start_offset(SLOT1_ID), header.data(), header.size()), 0);
    flash_area_close(area);

    return std::ranges::all_of(header, [](uint8_t byte) {
        return byte == 0xFF;
    });
}

// The SHA-256 of an image file, which the images header names as text.
inline Bytes ParseSha(std::string_view hex) {
    Bytes sha;
    for(size_t i = 0; i + 1 < hex.size(); i += 2) {
        const std::string pair(hex.substr(i, 2));
        sha.push_back(static_cast<uint8_t>(std::stoul(pair, nullptr, 16)));
    }
    zassert_equal(sha.size(), SHA_SIZE);

    return sha;
}

// The offset at which the protected TLVs of an image end: the chunk that holds the byte before it
// completes the identity.
inline size_t ProtectedAreaEnd(Image image) {
    uint16_t header_size = 0;
    uint16_t protected_size = 0;
    uint32_t payload_size = 0;
    std::memcpy(&header_size, image.data() + 8, sizeof(header_size));
    std::memcpy(&protected_size, image.data() + 10, sizeof(protected_size));
    std::memcpy(&payload_size, image.data() + 12, sizeof(payload_size));

    return static_cast<size_t>(header_size) + payload_size + protected_size;
}

// One upload request: the chunk at @p offset; the first one also names the size and the hash.
inline Response SendChunk(
    SmpTestClient& client,
    Image image,
    std::string_view sha,
    size_t offset,
    size_t chunk_size,
    size_t declared_size
) {
    const size_t length = std::min(chunk_size, image.size() - offset);

    CborMap body;
    body.Put("off", static_cast<uint32_t>(offset));
    if(offset == 0) {
        body.Put("len", static_cast<uint32_t>(declared_size));
        body.Put("sha", ParseSha(sha));
    }
    body.Put("data", image.subspan(offset, length));

    return client.Write(IMG_GROUP, IMG_UPLOAD, body.Build());
}

// What an upload came to.
struct UploadOutcome {
    // The offset of the chunk that was refused, or of the last one that was sent.
    size_t refused_at = 0;
    bool is_refused = false;
    Response last;
};

// Sends the image chunk by chunk, from @p start, until it is complete or a chunk gets an error.
inline UploadOutcome
Upload(SmpTestClient& client, Image image, std::string_view sha, size_t chunk_size = CHUNK_SIZE, size_t start = 0) {
    UploadOutcome outcome;

    size_t offset = start;
    while(offset < image.size()) {
        outcome.refused_at = offset;
        outcome.last = SendChunk(client, image, sha, offset, chunk_size, image.size());
        if(!outcome.last.IsOk()) {
            outcome.is_refused = true;
            return outcome;
        }

        // The unit says where it wants the next chunk, which is where this one ended unless it has the data.
        const size_t next = outcome.last.Value("off");
        zassert_true(next > offset || next == image.size(), "The unit asks for offset %zu after %zu", next, offset);
        offset = next;
    }

    return outcome;
}

// The images img_mgmt lists: one entry per slot that holds one.
inline Response ReadImages(SmpTestClient& client) {
    return client.Read(IMG_GROUP, IMG_STATE);
}

} // namespace dfu_test
```
