## CMakeLists.txt
```
cmake_minimum_required(VERSION 3.20.0)

set(RT_CORE_TEST_SIM_FLASH ON)
include(${CMAKE_CURRENT_SOURCE_DIR}/../../rt_core_test.cmake)

find_package(Zephyr REQUIRED HINTS $ENV{ZEPHYR_BASE})
project(functional_controllers)

file(GLOB_RECURSE TEST_SOURCES src/*.c src/*.cpp)

target_sources(app PRIVATE ${TEST_SOURCES})
```

## prj.conf
```kconfig
CONFIG_ZTEST=y

# Language and Compiler
CONFIG_CPP=y
CONFIG_PICOLIBC=y
CONFIG_STD_CPP23=y
CONFIG_REQUIRES_FULL_LIBCPP=y
CONFIG_CPP_EXCEPTIONS=y
CONFIG_CPP_RTTI=y

# Memory
CONFIG_HEAP_MEM_POOL_SIZE=200000

# C++ exception unwinding needs considerably more stack than the ztest defaults.
CONFIG_MAIN_STACK_SIZE=8192
CONFIG_ZTEST_STACK_SIZE=8192

# Logging And Debugging
CONFIG_LOG=y
CONFIG_TEST_RANDOM_GENERATOR=y
CONFIG_THREAD_NAME=y

# ThreadBase::InitializeStack() falls back to k_thread_stack_alloc().
CONFIG_THREAD_STACK_INFO=y
CONFIG_DYNAMIC_THREAD=y
CONFIG_DYNAMIC_THREAD_ALLOC=y

# FS Config
CONFIG_FLASH=y
CONFIG_FLASH_MAP=y
CONFIG_FILE_SYSTEM=y
CONFIG_FILE_SYSTEM_LITTLEFS=y
CONFIG_FILE_SYSTEM_MKFS=y

CONFIG_ZCBOR=y

CONFIG_CRC=y

# CANBus
CONFIG_CAN=y
CONFIG_CAN_FD_MODE=y

CONFIG_EERIE_LEAP_RT_CORE=y
CONFIG_EERIE_LEAP_CONFIGURATION=y
CONFIG_EERIE_LEAP_ADC=y
CONFIG_EERIE_LEAP_CANBUS=y
CONFIG_EERIE_LEAP_CDMP=y
CONFIG_EERIE_LEAP_DEVICE_TREE=y
CONFIG_EERIE_LEAP_FS=y
CONFIG_EERIE_LEAP_GPIO=y
CONFIG_EERIE_LEAP_LUA_SCRIPT=y
CONFIG_EERIE_LEAP_EXPRESSION_ENGINE=y
CONFIG_EERIE_LEAP_RANDOM=y
CONFIG_EERIE_LEAP_THREADING=y
CONFIG_EERIE_LEAP_TIME=y

CONFIG_EERIE_LEAP_DOMAIN_CANBUS=y
CONFIG_EERIE_LEAP_DOMAIN_CANBUS_COM=y
CONFIG_EERIE_LEAP_DOMAIN_SCRIPT=y
CONFIG_EERIE_LEAP_DOMAIN_SENSOR=y

CONFIG_EERIE_LEAP_CONTROLLER_CANBUS=y
# Without CONFIG_ADC the ADC layer builds its simulator; the test passes no ADC, as rt_gauge does.
CONFIG_EERIE_LEAP_CONTROLLER_SENSORS=y
```

## src/adc_configuration_controller.cpp
```c
#include <memory>
#include <zephyr/kernel.h>
#include <zephyr/ztest.h>

#include "configuration/cbor/cbor_adc_config/cbor_adc_config.h"
#include "configuration/services/cbor_configuration_service.h"

#include "subsys/device_tree/dt_fs.h"
#include "subsys/fs/services/fs_service.h"

#include "domain/sensor_domain/configuration/adc_configuration_manager.h"

using namespace eerie_leap::utilities::voltage_interpolator;
using namespace eerie_leap::configuration::services;
using namespace eerie_leap::subsys::fs::services;
using namespace eerie_leap::subsys::device_tree;
using namespace eerie_leap::subsys::adc;
using namespace eerie_leap::subsys::adc::utilities;
using namespace eerie_leap::subsys::adc::models;
using namespace eerie_leap::domain::sensor_domain::configuration;

ZTEST_SUITE(adc_configuration_manager, NULL, NULL, NULL, NULL, NULL);

AdcConfiguration adc_configuration_manager_GetTestConfiguration() {
    std::pmr::vector<CalibrationData> adc_calibration_data_samples {
        {0.0, 0.0},
        {5.0, 5.0}
    };

    auto adc_calibration_data_samples_ptr = std::make_shared<std::pmr::vector<CalibrationData>>(adc_calibration_data_samples);
    auto adc_calibrator = std::make_shared<AdcCalibrator>(InterpolationMethod::LINEAR, adc_calibration_data_samples_ptr);

    auto adc_channel_configuration = std::make_shared<AdcChannelConfiguration>(adc_calibrator);

    std::vector<std::shared_ptr<AdcChannelConfiguration>> channel_configurations;
    channel_configurations.reserve(8);
    for(int i = 0; i < 8; i++)
        channel_configurations.push_back(adc_channel_configuration);

    AdcConfiguration adc_configuration;
    adc_configuration.samples = 40;
    adc_configuration.channel_configurations =
        std::make_shared<std::vector<std::shared_ptr<AdcChannelConfiguration>>>(channel_configurations);

    return adc_configuration;
}

ZTEST(adc_configuration_manager, test_AdcConfigurationManager_Save_config_successfully_saved) {
    DtFs::InitInternalFs();
    auto fs_service = std::make_shared<FsService>(DtFs::GetInternalFsMp());

    fs_service->Format();

    AdcFactory adc_factory(nullptr);
    auto adc_manager = adc_factory.Create();
    adc_manager->Initialize();

    auto adc_configuration_service = std::make_unique<CborConfigurationService<CborAdcConfig>>("adc_config", fs_service);
    auto json_configuration_service = std::make_unique<JsonConfigurationService<JsonAdcConfig>>("adc_config", fs_service);
    auto adc_configuration_manager = std::make_shared<AdcConfigurationManager>(
        std::move(adc_configuration_service), std::move(json_configuration_service), adc_manager);

    auto adc_configuration = adc_configuration_manager_GetTestConfiguration();

    bool result = adc_configuration_manager->Update(adc_configuration);
    zassert_true(result);

    adc_manager = adc_configuration_manager->Get();

    for(int i = 0; i < adc_manager->GetChannelCount(); i++) {
        auto adc_channel_configuration = adc_manager->GetChannelConfiguration(i);

        zassert_true(adc_channel_configuration->calibrator != nullptr);
        zassert_equal(adc_channel_configuration->calibrator->GetInterpolationMethod(), InterpolationMethod::LINEAR);

        auto calibration_table = adc_channel_configuration->calibrator->GetCalibrationTable();
        zassert_equal(calibration_table->size(), 2);
        zassert_equal(calibration_table->at(0).voltage, 0.0);
        zassert_equal(calibration_table->at(0).value, 0.0);
        zassert_equal(calibration_table->at(1).voltage, 5.0);
        zassert_equal(calibration_table->at(1).value, 5.0);
    }
}

ZTEST(adc_configuration_manager, test_AdcConfigurationManager_Save_config_and_Load) {
    DtFs::InitInternalFs();
    auto fs_service = std::make_shared<FsService>(DtFs::GetInternalFsMp());

    fs_service->Format();

    AdcFactory adc_factory(nullptr);
    auto adc_manager = adc_factory.Create();
    adc_manager->Initialize();

    auto adc_configuration_service = std::make_unique<CborConfigurationService<CborAdcConfig>>("adc_config", fs_service);
    auto json_configuration_service = std::make_unique<JsonConfigurationService<JsonAdcConfig>>("adc_config", fs_service);
    auto adc_configuration_manager = std::make_shared<AdcConfigurationManager>(
        std::move(adc_configuration_service), std::move(json_configuration_service), adc_manager);

    auto adc_configuration = adc_configuration_manager_GetTestConfiguration();

    bool result = adc_configuration_manager->Update(adc_configuration);
    zassert_true(result);

    adc_configuration_service = std::make_unique<CborConfigurationService<CborAdcConfig>>("adc_config", fs_service);
    json_configuration_service = std::make_unique<JsonConfigurationService<JsonAdcConfig>>("adc_config", fs_service);
    adc_configuration_manager = nullptr;
    adc_configuration_manager = std::make_shared<AdcConfigurationManager>(
        std::move(adc_configuration_service), std::move(json_configuration_service), adc_manager);

    adc_manager = adc_configuration_manager->Get();

    for(int i = 0; i < adc_manager->GetChannelCount(); i++) {
        auto adc_channel_configuration = adc_manager->GetChannelConfiguration(i);

        zassert_true(adc_channel_configuration->calibrator != nullptr);
        zassert_equal(adc_channel_configuration->calibrator->GetInterpolationMethod(), InterpolationMethod::LINEAR);

        auto calibration_table = adc_channel_configuration->calibrator->GetCalibrationTable();
        zassert_equal(calibration_table->size(), 2);
        zassert_equal(calibration_table->at(0).voltage, 0.0);
        zassert_equal(calibration_table->at(0).value, 0.0);
        zassert_equal(calibration_table->at(1).voltage, 5.0);
        zassert_equal(calibration_table->at(1).value, 5.0);
    }
}
```

## src/canbus_controller.cpp
```c
#include <atomic>
#include <memory>

#include <zephyr/kernel.h>
#include <zephyr/ztest.h>

#include "subsys/device_tree/dt_fs.h"
#include "subsys/fs/services/fs_service.h"
#include "subsys/threading/i_service.h"
#include "subsys/threading/work_queue_thread.h"

#include "controllers/canbus_controller.h"
#include "domain/configuration_domain/services/configuration_service.h"

using eerie_leap::controllers::CanbusController;
using eerie_leap::domain::configuration_domain::services::ConfigurationService;
using eerie_leap::subsys::device_tree::DtFs;
using eerie_leap::subsys::fs::services::FsService;
using eerie_leap::subsys::threading::IService;
using eerie_leap::subsys::threading::ServiceState;
using eerie_leap::subsys::threading::WorkQueueThread;

namespace {

constexpr int RECONFIGURE_DELAY_MS = CONFIG_EERIE_LEAP_CONTROLLER_CANBUS_RECONFIGURE_DELAY_MS;

// A service on the CAN bus, which a reconfiguration stops and starts again.
class FakeDependentService : public IService {
public:
    std::atomic<int> stops = 0;
    std::atomic<int> starts = 0;

    bool Initialize() override {
        return true;
    }
    bool Start() override {
        starts++;
        return true;
    }
    bool Stop() override {
        stops++;
        return true;
    }
    [[nodiscard]] ServiceState GetState() const noexcept override {
        return ServiceState::RUNNING;
    }
};

} // namespace

ZTEST_SUITE(canbus_controller, NULL, NULL, NULL, NULL, NULL);

ZTEST(canbus_controller, test_a_configuration_update_takes_effect_after_the_delay) {
    DtFs::InitInternalFs();
    const auto fs_service = std::make_shared<FsService>(DtFs::GetInternalFsMp());
    fs_service->Format();

    const auto work_queue = std::make_shared<WorkQueueThread>("canbus_test_config_wq", 6144, 5);
    zassert_true(work_queue->Initialize());

    CanbusController controller(fs_service, work_queue, nullptr);
    zassert_equal(controller.Initialize(), 0);

    const auto service = std::make_shared<FakeDependentService>();
    controller.RegisterDependentService(service);

    const auto manager = controller.GetConfigurationManager();
    const auto configuration = manager->Get();

    zassert_true(manager->Update(*configuration));
    zassert_equal(service->stops.load(), 0, "The update reconfigured before returning");

    k_msleep(RECONFIGURE_DELAY_MS / 2);
    zassert_true(manager->Update(*configuration));

    k_msleep(RECONFIGURE_DELAY_MS * 3 / 4);
    zassert_equal(service->stops.load(), 0, "The second update did not restart the delay");

    k_msleep(RECONFIGURE_DELAY_MS);
    zassert_equal(service->stops.load(), 1, "The updates were not put into effect once");
    zassert_equal(service->starts.load(), 1);
}

// A CAN configuration stored on a unit reaches the configuration service's stored handler before the
// controller queues its reconfiguration, so a task the handler queues (the logging update stop's
// LOGGING broadcast, L9) runs first: the stop leaves before the COM service and its dependents stop. It
// holds with any delay, since the report comes before the CAN manager's own handler.
ZTEST(canbus_controller, test_a_task_queued_when_the_configuration_is_stored_runs_before_the_reconfiguration) {
    DtFs::InitInternalFs();
    const auto fs_service = std::make_shared<FsService>(DtFs::GetInternalFsMp());
    fs_service->Format();

    const auto work_queue = std::make_shared<WorkQueueThread>("canbus_test_order_wq", 6144, 5);
    zassert_true(work_queue->Initialize());

    const auto configuration_service = std::make_shared<ConfigurationService>();
    CanbusController controller(fs_service, work_queue, configuration_service);
    zassert_equal(controller.Initialize(), 0);

    const auto service = std::make_shared<FakeDependentService>();
    controller.RegisterDependentService(service);

    // What the queued task saw: the dependents' stops when it ran, -1 until it did.
    struct Seen {
        std::atomic<int> stops_when_run = -1;
        std::atomic<int> reports = 0;
    };
    const auto seen = std::make_shared<Seen>();
    configuration_service->RegisterConfigurationStoredHandler([seen, service, work_queue](ConfigurationService::Type) {
        seen->reports++;
        work_queue->Run([seen, service] {
            seen->stops_when_run = service->stops.load();
        });
    });

    const auto manager = controller.GetConfigurationManager();
    zassert_true(manager->Update(*manager->Get()));
    zassert_equal(seen->reports.load(), 1, "The store was reported");

    k_msleep(RECONFIGURE_DELAY_MS / 2);
    zassert_equal(seen->stops_when_run.load(), 0, "The task the report queued ran before the reconfiguration");
    zassert_equal(service->stops.load(), 0);

    k_msleep(RECONFIGURE_DELAY_MS);
    zassert_equal(service->stops.load(), 1, "and the reconfiguration followed");
    zassert_equal(seen->stops_when_run.load(), 0);

    configuration_service->RegisterConfigurationStoredHandler(nullptr);
}
```

## src/canbus_controller_assets.cpp
```c
// The CAN scripts as an asset kind: CanbusController registers them with the AssetsManager it is
// given when the unit has an SD service, answers for the scripts its messages use on any channel, and
// withdraws both when it goes. The volume of the suite serves as the SD card.
#ifdef CONFIG_EERIE_LEAP_ASSETS

    #include <memory>

    #include <zephyr/ztest.h>

    #include "script_assets_test_support.h"

using namespace script_assets_test;

ZTEST_SUITE(canbus_controller_assets, NULL, NULL, NULL, NULL, NULL);

ZTEST(canbus_controller_assets, test_the_can_scripts_are_registered_with_what_the_kind_needs) {
    const auto rig = MakeRig("can_assets_descriptor_wq");

    auto controller = MakeCanbusController(rig, rig.sd, rig.assets);
    zassert_true(rig.assets->GetProviders().empty(), "Nothing is registered before Initialize()");
    zassert_equal(controller->Initialize(), 0);

    const auto provider = rig.assets->Find(AssetKind::CAN_SCRIPTS);
    zassert_not_null(provider.get(), "The CAN scripts are registered once the controller is initialized");
    zassert_equal(provider->kind, AssetKind::CAN_SCRIPTS);
    zassert_true(provider->name == "can_scripts", "The kind's name");
    zassert_equal(provider->extensions.size(), 1);
    zassert_true(provider->extensions[0] == ".lua", "A Lua script");
    zassert_equal(provider->access, ALL_SCRIPT_ACCESS, "Read, write and delete");
    zassert_equal(provider->max_size, CONFIG_EERIE_LEAP_CAN_SCRIPT_MAX_SIZE);
    zassert_not_null(provider->store.get());
    zassert_true(provider->store->GetDirectory() == "scripts/can", "The directory of the kind on the SD volume");
    zassert_true(static_cast<bool>(provider->is_in_use), "A referenced script is not deleted");

    zassert_true(rig.fs_service->Exists("scripts/can"), "The store creates its directory on a mounted volume");
    zassert_is_null(rig.assets->Find(AssetKind::SENSOR_SCRIPTS).get(), "Only the CAN scripts are the controller's");
    zassert_equal(rig.assets->GetProviders().size(), 1);

    // The store is on the SD service the controller was given, not on its internal file system.
    zassert_true(provider->store->IsAvailable());
    rig.sd->SetAvailable(false);
    zassert_false(provider->store->IsAvailable(), "The store follows the SD service");
    zassert_true(rig.fs_service->IsAvailable(), "and not the internal file system");
    rig.sd->SetAvailable(true);
    zassert_true(provider->store->IsAvailable());
}

ZTEST(canbus_controller_assets, test_nothing_is_registered_without_an_sd_service_or_a_manager) {
    const auto rig = MakeRig("can_assets_missing_wq");
    WriteScript(*rig.fs_service, CAN_SCRIPT);

    {
        // Without an SD service the script path is not checked, so the message may name any script.
        auto without_sd = MakeCanbusController(rig, nullptr, rig.assets);
        zassert_equal(
            InitializeWithMessages(*without_sd, { { 0, 0x100, CAN_SCRIPT } }), 0,
            "A unit without an SD card initializes"
        );
        zassert_true(rig.assets->GetProviders().empty(), "No SD service, no CAN scripts");
        zassert_false(rig.assets->IsReferenced(CAN_SCRIPT), "and no referrer, though a message uses the script");
    }

    {
        // It loads the configuration the first one stored, which refers to the script.
        auto without_manager = MakeCanbusController(rig, rig.sd, nullptr);
        zassert_equal(without_manager->Initialize(), 0, "A unit without a registry initializes");
        zassert_true(rig.assets->GetProviders().empty());
        zassert_false(rig.assets->IsReferenced(CAN_SCRIPT));
    }
}

ZTEST(canbus_controller_assets, test_a_script_is_referenced_by_any_message_on_any_channel) {
    const auto rig = MakeRig("can_assets_referrer_wq");
    for(const char* script : { CAN_SCRIPT, DISABLED_CAN_SCRIPT, CAN_SCRIPT_IN_SENSOR_DIRECTORY })
        WriteScript(*rig.fs_service, script);

    auto controller = MakeCanbusController(rig, rig.sd, rig.assets);
    zassert_equal(
        InitializeWithMessages(
            *controller,
            {
                { 0, 0x100, CAN_SCRIPT },
                { 0, 0x101, DISABLED_CAN_SCRIPT, false },
                { 0, 0x102, "" },
                { 1, 0x200, CAN_SCRIPT_IN_SENSOR_DIRECTORY },
            }
        ),
        0
    );

    zassert_true(rig.assets->IsReferenced(CAN_SCRIPT), "A message uses the script");
    zassert_true(rig.assets->IsReferenced(DISABLED_CAN_SCRIPT), "A disabled message keeps its script");
    zassert_true(
        rig.assets->IsReferenced(CAN_SCRIPT_IN_SENSOR_DIRECTORY),
        "A message of another channel counts, and a script of the other kind's directory"
    );

    zassert_true(rig.assets->IsReferenced("SCRIPTS/Can/A.LUA"), "FAT folds the case of a name");
    zassert_true(rig.assets->IsReferenced("./scripts//can/a.lua"), "Empty names and . name nothing");

    zassert_false(rig.assets->IsReferenced("scripts/can/other.lua"), "No message uses it");
    zassert_false(rig.assets->IsReferenced("scripts/can"), "A directory is no script");
    zassert_false(rig.assets->IsReferenced("a.lua"), "The directory is part of the path");
    zassert_false(rig.assets->IsReferenced(""), "A message without a script refers to nothing");
}

ZTEST(canbus_controller_assets, test_only_deleting_a_referenced_script_is_refused) {
    const auto rig = MakeRig("can_assets_in_use_wq");
    WriteScript(*rig.fs_service, CAN_SCRIPT);
    WriteScript(*rig.fs_service, DISABLED_CAN_SCRIPT);

    auto controller = MakeCanbusController(rig, rig.sd, rig.assets);
    zassert_equal(
        InitializeWithMessages(
            *controller,
            {
                { 0, 0x100, CAN_SCRIPT },
                { 1, 0x200, DISABLED_CAN_SCRIPT, false },
            }
        ),
        0
    );

    const auto provider = rig.assets->Find(AssetKind::CAN_SCRIPTS);
    zassert_not_null(provider.get());

    zassert_true(provider->is_in_use(AssetAccess::DELETE, CAN_SCRIPT_NAME), "A referenced script is not deleted");
    zassert_true(provider->is_in_use(AssetAccess::DELETE, "A.LUA"), "whatever the case of its name");
    zassert_true(provider->is_in_use(AssetAccess::DELETE, "d.lua"), "also one of a disabled message");
    zassert_false(provider->is_in_use(AssetAccess::WRITE, CAN_SCRIPT_NAME), "A referenced script may be replaced");
    zassert_false(provider->is_in_use(AssetAccess::READ, CAN_SCRIPT_NAME), "or read");
    zassert_false(provider->is_in_use(AssetAccess::DELETE, "other.lua"), "Another script may be deleted");

    // The referrer reads the configuration in force, not the one the controller started with. The
    // reconfiguration it schedules is cancelled with the controller.
    StoreCanConfiguration(*controller->GetConfigurationManager(), { { 0, 0x100, "" } });
    zassert_false(provider->is_in_use(AssetAccess::DELETE, CAN_SCRIPT_NAME), "A script no message uses is deleted");
    zassert_false(provider->is_in_use(AssetAccess::DELETE, "d.lua"));
}

// A sensor may use a script from the CAN scripts' directory and a CAN message one from the sensors':
// each kind asks every referrer, not its own controller's alone.
ZTEST(canbus_controller_assets, test_a_script_of_either_kind_is_kept_while_either_controller_uses_it) {
    const auto rig = MakeRig("can_assets_cross_wq");
    WriteScript(*rig.fs_service, SENSOR_SCRIPT_IN_CAN_DIRECTORY);
    WriteScript(*rig.fs_service, CAN_SCRIPT_IN_SENSOR_DIRECTORY);

    auto sensors = MakeSensorsController(rig, rig.sd, rig.assets);
    zassert_equal(
        InitializeWithSensors(*sensors, { MakeSensor("in_can_directory", SENSOR_SCRIPT_IN_CAN_DIRECTORY) }), 0
    );

    auto canbus = MakeCanbusController(rig, rig.sd, rig.assets);
    zassert_equal(InitializeWithMessages(*canbus, { { 0, 0x100, CAN_SCRIPT_IN_SENSOR_DIRECTORY } }), 0);

    const auto sensor_scripts = rig.assets->Find(AssetKind::SENSOR_SCRIPTS);
    const auto can_scripts = rig.assets->Find(AssetKind::CAN_SCRIPTS);
    zassert_not_null(sensor_scripts.get());
    zassert_not_null(can_scripts.get());

    zassert_true(sensor_scripts->is_in_use(AssetAccess::DELETE, "s.lua"), "A CAN message uses a sensor script");
    zassert_true(can_scripts->is_in_use(AssetAccess::DELETE, "c.lua"), "A sensor uses a CAN script");
    zassert_false(sensor_scripts->is_in_use(AssetAccess::WRITE, "s.lua"));
    zassert_false(can_scripts->is_in_use(AssetAccess::READ, "c.lua"));

    // The sensors' controller goes: the CAN message still uses its script, the sensor no longer does.
    sensors.reset();
    zassert_true(rig.assets->IsReferenced(CAN_SCRIPT_IN_SENSOR_DIRECTORY));
    zassert_false(
        rig.assets->IsReferenced(SENSOR_SCRIPT_IN_CAN_DIRECTORY), "The sensors' referrer went with its controller"
    );
    zassert_is_null(rig.assets->Find(AssetKind::SENSOR_SCRIPTS).get());
    zassert_not_null(rig.assets->Find(AssetKind::CAN_SCRIPTS).get(), "The CAN scripts stay");
}

ZTEST(canbus_controller_assets, test_destroying_the_controller_withdraws_the_kind_and_its_referrer) {
    auto rig = MakeRig("can_assets_destroy_wq");
    WriteScript(*rig.fs_service, CAN_SCRIPT);

    std::shared_ptr<const eerie_leap::subsys::assets::AssetProvider> provider;
    {
        auto controller = MakeCanbusController(rig, rig.sd, rig.assets);
        zassert_equal(InitializeWithMessages(*controller, { { 0, 0x100, CAN_SCRIPT } }), 0);

        provider = rig.assets->Find(AssetKind::CAN_SCRIPTS);
        zassert_not_null(provider.get());
        zassert_true(rig.assets->IsReferenced(CAN_SCRIPT));
    }

    zassert_is_null(rig.assets->Find(AssetKind::CAN_SCRIPTS).get(), "The CAN scripts are no longer served");
    zassert_false(rig.assets->IsReferenced(CAN_SCRIPT), "and the messages no longer refer to anything");
    zassert_false(
        provider->is_in_use(AssetAccess::DELETE, CAN_SCRIPT_NAME),
        "A provider found before keeps working, and refuses nothing"
    );

    const std::weak_ptr<AssetsManager> weak_assets = rig.assets;
    rig.assets.reset();

    zassert_true(weak_assets.expired(), "Nothing the controller registered holds the registry");
    zassert_false(
        provider->is_in_use(AssetAccess::DELETE, CAN_SCRIPT_NAME), "A provider outliving its registry refuses nothing"
    );
}

#endif // CONFIG_EERIE_LEAP_ASSETS
```

## src/script_assets_test_support.h
```c
#pragma once

// What the controllers suite shares for the script asset kinds of SensorsController and
// CanbusController. Only with CONFIG_EERIE_LEAP_ASSETS: functional.controllers.assets.
#ifdef CONFIG_EERIE_LEAP_ASSETS

    #include <atomic>
    #include <cstddef>
    #include <cstdint>
    #include <initializer_list>
    #include <memory>
    #include <optional>
    #include <string>
    #include <string_view>
    #include <utility>
    #include <vector>

    #include <zephyr/ztest.h>

    #include "subsys/assets/asset_kind.h"
    #include "subsys/assets/assets_manager.h"
    #include "subsys/device_tree/dt_fs.h"
    #include "subsys/fs/services/fs_service.h"
    #include "subsys/threading/work_queue_thread.h"
    #include "subsys/time/boot_elapsed_time_provider.h"
    #include "subsys/time/rtc_provider.h"
    #include "subsys/time/time_service.h"
    #include "utilities/memory/memory_resource_manager.h"

    #include "controllers/canbus_controller.h"
    #include "controllers/sensors_controller.h"
    #include "domain/canbus_domain/models/can_channel_configuration.h"
    #include "domain/canbus_domain/models/can_message_configuration.h"
    #include "domain/canbus_domain/models/canbus_configuration.h"
    #include "domain/sensor_domain/models/sensor.h"
    #include "domain/sensor_domain/utilities/sensor_readings_frame.hpp"

namespace script_assets_test {

using eerie_leap::controllers::CanbusController;
using eerie_leap::controllers::SensorsController;
using eerie_leap::domain::canbus_domain::models::CanbusConfiguration;
using eerie_leap::domain::canbus_domain::models::CanChannelConfiguration;
using eerie_leap::domain::canbus_domain::models::CanMessageConfiguration;
using eerie_leap::domain::sensor_domain::models::Sensor;
using eerie_leap::domain::sensor_domain::models::SensorType;
using eerie_leap::domain::sensor_domain::utilities::SensorReadingsFrame;
using eerie_leap::subsys::assets::AssetAccess;
using eerie_leap::subsys::assets::AssetKind;
using eerie_leap::subsys::assets::AssetsManager;
using eerie_leap::subsys::assets::ToMask;
using eerie_leap::subsys::device_tree::DtFs;
using eerie_leap::subsys::fs::services::DirectoryEntry;
using eerie_leap::subsys::fs::services::FsService;
using eerie_leap::subsys::fs::services::IFsService;
using eerie_leap::subsys::threading::WorkQueueThread;
using eerie_leap::subsys::time::BootElapsedTimeProvider;
using eerie_leap::subsys::time::RtcProvider;
using eerie_leap::subsys::time::TimeService;
using eerie_leap::utilities::memory::Mrm;

// A script a configuration refers to, and what the controllers register. The suite's one volume serves
// as the SD card and as the internal file system.
inline constexpr const char* SENSOR_SCRIPT = "scripts/sensors/a.lua";
inline constexpr const char* SENSOR_SCRIPT_NAME = "a.lua";
inline constexpr const char* DISABLED_SENSOR_SCRIPT = "scripts/sensors/d.lua";
inline constexpr const char* OTHER_SENSOR_SCRIPT_NAME = "other.lua";
// In the CAN scripts' directory, though a sensor refers to it.
inline constexpr const char* SENSOR_SCRIPT_IN_CAN_DIRECTORY = "scripts/can/c.lua";
inline constexpr const char* CAN_SCRIPT = "scripts/can/a.lua";
inline constexpr const char* CAN_SCRIPT_NAME = "a.lua";
inline constexpr const char* DISABLED_CAN_SCRIPT = "scripts/can/d.lua";
// In the sensor scripts' directory, though a CAN message refers to it.
inline constexpr const char* CAN_SCRIPT_IN_SENSOR_DIRECTORY = "scripts/sensors/s.lua";

inline constexpr uint8_t ALL_SCRIPT_ACCESS = ToMask(AssetAccess::READ) | ToMask(AssetAccess::WRITE)
    | ToMask(AssetAccess::DELETE);

// The suite's volume as the SD card: every call goes to the real one, except IsAvailable(), which
// reports the switch. The controllers take it as their SD service, so a store built on the internal
// file system instead shows by not following the switch.
class SwitchableVolume final : public IFsService {
private:
    std::shared_ptr<IFsService> inner_;
    std::atomic<bool> is_available_ = true;

public:
    explicit SwitchableVolume(std::shared_ptr<IFsService> inner) :
        inner_(std::move(inner)) {}

    void SetAvailable(bool is_available) {
        is_available_ = is_available;
    }

    bool Initialize() override {
        return inner_->Initialize();
    }
    bool IsAvailable() const override {
        return is_available_;
    }
    bool WriteFile(std::string_view path, const void* data, size_t size, bool append) override {
        return inner_->WriteFile(path, data, size, append);
    }
    bool ReadFile(std::string_view path, void* data, size_t size, size_t& out_len) override {
        return inner_->ReadFile(path, data, size, out_len);
    }
    int OpenFile(std::string_view path, fs_mode_t flags, fs_file_t* file) override {
        return inner_->OpenFile(path, flags, file);
    }
    bool CreateDirectory(std::string_view path) override {
        return inner_->CreateDirectory(path);
    }
    bool Exists(std::string_view path) const override {
        return inner_->Exists(path);
    }
    bool DeleteFile(std::string_view path) override {
        return inner_->DeleteFile(path);
    }
    bool DeleteRecursive(std::string_view path) override {
        return inner_->DeleteRecursive(path);
    }
    int Rename(std::string_view from, std::string_view to) override {
        return inner_->Rename(from, to);
    }
    std::vector<std::string> ListFiles(std::string_view path) const override {
        return inner_->ListFiles(path);
    }
    int ListDirectory(
        std::string_view path,
        size_t first,
        size_t max_entries,
        std::vector<DirectoryEntry>& entries,
        size_t& count
    ) const override {
        return inner_->ListDirectory(path, first, max_entries, entries, count);
    }
    std::optional<size_t> GetFileSize(std::string_view path) const override {
        return inner_->GetFileSize(path);
    }
    uint64_t GetTotalSpace() const override {
        return inner_->GetTotalSpace();
    }
    uint64_t GetUsedSpace() const override {
        return inner_->GetUsedSpace();
    }
    bool Format() override {
        return inner_->Format();
    }
};

struct Rig {
    // The internal file system and, behind sd, the volume that stands in for the SD card.
    std::shared_ptr<FsService> fs_service;
    std::shared_ptr<SwitchableVolume> sd;
    std::shared_ptr<WorkQueueThread> work_queue;
    std::shared_ptr<TimeService> time_service;
    std::shared_ptr<SensorReadingsFrame> frame;
    std::shared_ptr<AssetsManager> assets;
};

// A formatted volume (also behind the SD service, a distinct object) and a configuration work queue, as
// the other cases of the suite.
inline Rig MakeRig(const char* work_queue_name) {
    DtFs::InitInternalFs();

    Rig rig;
    rig.fs_service = std::make_shared<FsService>(DtFs::GetInternalFsMp());
    rig.fs_service->Format();
    rig.sd = std::make_shared<SwitchableVolume>(rig.fs_service);

    rig.work_queue = std::make_shared<WorkQueueThread>(work_queue_name, 6144, 5);
    zassert_true(rig.work_queue->Initialize());

    rig.time_service = std::make_shared<TimeService>(
        std::make_shared<BootElapsedTimeProvider>(), std::make_shared<RtcProvider>()
    );
    rig.frame = std::make_shared<SensorReadingsFrame>();
    rig.assets = std::make_shared<AssetsManager>();

    return rig;
}

// An empty file: a configuration that refers to a script needs it to exist while the card is mounted,
// and a script of no bytes is never loaded.
inline void WriteScript(FsService& fs_service, std::string_view path) {
    const size_t slash = path.rfind('/');
    if(slash != std::string_view::npos)
        zassert_true(fs_service.CreateDirectory(path.substr(0, slash)), "The scripts directory was not created");

    zassert_true(fs_service.WriteFile(path, "", 0, false), "The script was not written");
}

inline std::shared_ptr<Sensor> MakeSensor(std::string_view id, std::string_view script_path, bool is_enabled = true) {
    auto sensor = std::make_shared<Sensor>(std::allocator_arg, Mrm::GetDefaultPmr(), id);
    sensor->configuration.type = SensorType::VIRTUAL_ANALOG;
    sensor->configuration.expression = "1 + 1";
    sensor->configuration.sampling_rate_ms = 20;
    sensor->configuration.script_path = script_path;
    sensor->is_enabled = is_enabled;

    return sensor;
}

// The SD volume and the registry are optional, as the controller takes them.
inline std::unique_ptr<SensorsController> MakeSensorsController(
    const Rig& rig,
    std::shared_ptr<IFsService> sd_fs_service,
    std::shared_ptr<AssetsManager> assets
) {

    return std::make_unique<SensorsController>(
        rig.fs_service, rig.work_queue, nullptr, rig.time_service, rig.frame, nullptr, nullptr, nullptr, nullptr,
        std::move(sd_fs_service), std::move(assets)
    );
}

// Initializes with @p sensors already stored, so that the controller's update handler does not fire.
inline int InitializeWithSensors(SensorsController& controller, std::vector<std::shared_ptr<Sensor>> sensors) {
    return controller.Initialize([&sensors](const auto& manager) {
        zassert_true(manager->Update(sensors), "The sensors were not stored");
    });
}

struct CanMessageSpec {
    uint8_t bus_channel;
    uint32_t frame_id;
    std::string_view script_path;
    bool is_enabled = true;
};

// Stores a configuration with the given messages on classical CAN channels, one channel per bus.
inline void StoreCanConfiguration(
    eerie_leap::domain::canbus_domain::configuration::CanbusConfigurationManager& manager,
    std::initializer_list<CanMessageSpec> specs
) {

    CanbusConfiguration configuration(std::allocator_arg, Mrm::GetDefaultPmr());

    for(const auto& spec : specs) {
        auto channel = configuration.channel_configurations.find(spec.bus_channel);
        if(channel == configuration.channel_configurations.end()) {
            CanChannelConfiguration new_channel(std::allocator_arg, Mrm::GetDefaultPmr());
            new_channel.type = eerie_leap::subsys::canbus::CanbusType::CLASSICAL_CAN;
            new_channel.bus_channel = spec.bus_channel;
            new_channel.bitrate = 500000;

            channel = configuration.channel_configurations.emplace(spec.bus_channel, std::move(new_channel)).first;
        }

        auto message = std::make_shared<CanMessageConfiguration>(std::allocator_arg, Mrm::GetDefaultPmr());
        message->frame_id = spec.frame_id;
        message->is_enabled = spec.is_enabled;
        message->name = "EL_FRAME_" + std::to_string(spec.frame_id);
        message->message_size = 8;
        message->send_interval_ms = 10;
        message->script_path = spec.script_path;

        channel->second.message_configurations.push_back(std::move(message));
    }

    zassert_true(manager.Update(configuration), "The CAN configuration was not stored");
}

inline std::unique_ptr<CanbusController>
MakeCanbusController(const Rig& rig, std::shared_ptr<IFsService> sd_fs_service, std::shared_ptr<AssetsManager> assets) {

    return std::make_unique<CanbusController>(
        rig.fs_service, rig.work_queue, nullptr, std::move(sd_fs_service), std::move(assets)
    );
}

// Initializes with @p specs already stored, so that the controller's update handler does not fire.
inline int InitializeWithMessages(CanbusController& controller, std::initializer_list<CanMessageSpec> specs) {
    return controller.Initialize([specs](const auto& manager) {
        StoreCanConfiguration(*manager, specs);
    });
}

} // namespace script_assets_test

#endif // CONFIG_EERIE_LEAP_ASSETS
```

## src/sensors_configuration_controller.cpp
```c
#include <memory>
#include <vector>
#include <zephyr/kernel.h>
#include <zephyr/ztest.h>
#include <eerie_memory.hpp>

#include "utilities/memory/memory_resource_manager.h"
#include "utilities/cbor/cbor_helpers.hpp"
#include "configuration/cbor/cbor_system_config/cbor_system_config.h"
#include "configuration/cbor/cbor_sensors_config/cbor_sensors_config.h"
#include "configuration/services/cbor_configuration_service.h"

#include "domain/sensor_domain/configuration/sensors_configuration_manager.h"

#include "subsys/device_tree/dt_fs.h"
#include "subsys/fs/services/i_fs_service.h"
#include "subsys/fs/services/fs_service.h"
#include "subsys/math_parser/expression_evaluator.h"

#include "utilities/voltage_interpolator/linear_voltage_interpolator.hpp"
#include "utilities/voltage_interpolator/cubic_spline_voltage_interpolator.hpp"

using namespace eerie_memory;
using namespace eerie_leap::utilities::memory;
using namespace eerie_leap::utilities::cbor;
using namespace eerie_leap::utilities::voltage_interpolator;
using namespace eerie_leap::configuration::services;
using namespace eerie_leap::domain::sensor_domain::configuration;
using namespace eerie_leap::domain::sensor_domain::models;
using namespace eerie_leap::subsys::device_tree;
using namespace eerie_leap::subsys::fs::services;
using namespace eerie_leap::subsys::math_parser;

ZTEST_SUITE(sensors_configuration_manager, NULL, NULL, NULL, NULL, NULL);

std::vector<std::shared_ptr<Sensor>> sensors_configuration_manager_SetupTestSensors() {
    std::pmr::vector<CalibrationData> calibration_data_1 {
        {0.0, 0.0},
        {3.3, 100.0}
    };
    auto calibration_data_1_ptr = std::make_shared<std::pmr::vector<CalibrationData>>(calibration_data_1);

    auto sensor_1 = std::make_shared<Sensor>(std::allocator_arg, Mrm::GetDefaultPmr(), "sensor_1");

    sensor_1->metadata.name = "Sensor 1";
    sensor_1->metadata.unit = "km/h";
    sensor_1->metadata.description = "Test Sensor 1";

    sensor_1->configuration.type = SensorType::PHYSICAL_ANALOG;
    sensor_1->configuration.channel = 0;
    sensor_1->configuration.sampling_rate_ms = 1000;
    sensor_1->configuration.voltage_interpolator = make_unique_pmr<LinearVoltageInterpolator>(Mrm::GetDefaultPmr(), calibration_data_1_ptr);
    sensor_1->configuration.expression_evaluator = make_unique_pmr<ExpressionEvaluator>(Mrm::GetDefaultPmr(), "x * 2 + sensor_2 + 1");

    std::pmr::vector<CalibrationData> calibration_data_2 {
        {0.0, 0.0},
        {1.0, 29.0},
        {2.0, 111.0},
        {2.5, 162.0},
        {3.3, 200.0}
    };
    auto calibration_data_2_ptr = std::make_shared<std::pmr::vector<CalibrationData>>(calibration_data_2);

    auto sensor_2 = std::make_shared<Sensor>(std::allocator_arg, Mrm::GetDefaultPmr(), "sensor_2");

    sensor_2->metadata.name = "Sensor 2";
    sensor_2->metadata.unit = "km/h";
    sensor_2->metadata.description = "Test Sensor 2";

    sensor_2->configuration.type = SensorType::PHYSICAL_ANALOG;
    sensor_2->configuration.channel = 1;
    sensor_2->configuration.sampling_rate_ms = 500;
    sensor_2->configuration.voltage_interpolator = make_unique_pmr<CubicSplineVoltageInterpolator>(Mrm::GetDefaultPmr(), calibration_data_2_ptr);
    sensor_2->configuration.expression_evaluator = make_unique_pmr<ExpressionEvaluator>(Mrm::GetDefaultPmr(), "x * 4 + 1.6");

    auto sensor_3 = std::make_shared<Sensor>(std::allocator_arg, Mrm::GetDefaultPmr(), "sensor_3");

    sensor_3->metadata.name = "Sensor 3";
    sensor_3->metadata.unit = "km/h";
    sensor_3->metadata.description = "Test Sensor 3";

    sensor_3->configuration.type = SensorType::VIRTUAL_ANALOG;
    sensor_3->configuration.channel = std::nullopt;
    sensor_3->configuration.sampling_rate_ms = 2000;
    sensor_3->configuration.expression_evaluator = make_unique_pmr<ExpressionEvaluator>(Mrm::GetDefaultPmr(), "sensor_1 + 8.34");

    auto sensor_4 = std::make_shared<Sensor>(std::allocator_arg, Mrm::GetDefaultPmr(), "sensor_4");

    sensor_4->metadata.name = "Sensor 4";
    sensor_4->metadata.unit = "km/h";
    sensor_4->metadata.description = "Test Sensor 4";

    sensor_4->configuration.type = SensorType::PHYSICAL_ANALOG;
    sensor_4->configuration.channel = 2;
    sensor_4->configuration.sampling_rate_ms = 2000;
    sensor_4->configuration.voltage_interpolator = make_unique_pmr<CubicSplineVoltageInterpolator>(Mrm::GetDefaultPmr(), calibration_data_2_ptr);

    std::vector<std::shared_ptr<Sensor>> sensors = {
        sensor_1, sensor_2, sensor_3, sensor_4 };

    return sensors;
}

ZTEST(sensors_configuration_manager, test_SensorsConfigurationManager_Save_config_successfully_saved) {
    DtFs::InitInternalFs();
    auto fs_service = std::make_shared<FsService>(DtFs::GetInternalFsMp());

    fs_service->Format();

    auto cbor_sensors_configuration_service = std::make_unique<CborConfigurationService<CborSensorsConfig>>("sensors_config", fs_service);

    auto sensors_configuration_manager = std::make_shared<SensorsConfigurationManager>(
        std::move(cbor_sensors_configuration_service),
        nullptr,
        16,
        16);

    auto sensors = sensors_configuration_manager_SetupTestSensors();
    sensors_configuration_manager->Update(sensors);

    auto saved_sensors = sensors_configuration_manager->Get();

    zassert_equal(saved_sensors->size(), sensors.size());

    for(size_t i = 0; i < sensors.size(); ++i) {
        std::shared_ptr<Sensor> saved_sensor = nullptr;
        for(size_t j = 0; j < saved_sensors->size(); ++j) {
            if(strcmp(saved_sensors->at(j)->id.c_str(), sensors[i]->id.c_str()) == 0) {
                saved_sensor = saved_sensors->at(j);
                break;
            }
        }
        zassert_true(saved_sensor != nullptr);

        zassert_true(saved_sensor->metadata.name == sensors[i]->metadata.name);
        zassert_true(saved_sensor->metadata.unit == sensors[i]->metadata.unit);
        zassert_true(saved_sensor->metadata.description == sensors[i]->metadata.description);

        zassert_true(saved_sensor->configuration.type == sensors[i]->configuration.type);
        if(saved_sensor->configuration.channel.has_value() && sensors[i]->configuration.channel.has_value()) {
            zassert_true(saved_sensor->configuration.channel.value() == sensors[i]->configuration.channel.value());
        } else {
            zassert_true(!saved_sensor->configuration.channel.has_value() && !sensors[i]->configuration.channel.has_value());
        }
        zassert_true(saved_sensor->configuration.sampling_rate_ms == sensors[i]->configuration.sampling_rate_ms);
        if(saved_sensor->configuration.voltage_interpolator != nullptr || sensors[i]->configuration.voltage_interpolator != nullptr)
            zassert_true(saved_sensor->configuration.voltage_interpolator->GetInterpolationMethod() == sensors[i]->configuration.voltage_interpolator->GetInterpolationMethod());
        if(saved_sensor->configuration.expression_evaluator != nullptr || sensors[i]->configuration.expression_evaluator != nullptr)
            zassert_true(saved_sensor->configuration.expression_evaluator->GetExpression() == sensors[i]->configuration.expression_evaluator->GetExpression());
    }
}

ZTEST(sensors_configuration_manager, test_SensorsConfigurationManager_Save_config_and_Load) {
    DtFs::InitInternalFs();
    auto fs_service = std::make_shared<FsService>(DtFs::GetInternalFsMp());

    fs_service->Format();

    auto cbor_sensors_configuration_service = std::make_unique<CborConfigurationService<CborSensorsConfig>>("sensors_config", fs_service);

    auto sensors_configuration_manager = std::make_shared<SensorsConfigurationManager>(
        std::move(cbor_sensors_configuration_service),
        nullptr,
        16,
        16);

    auto sensors = sensors_configuration_manager_SetupTestSensors();
    sensors_configuration_manager->Update(sensors);

    cbor_sensors_configuration_service = std::make_unique<CborConfigurationService<CborSensorsConfig>>("sensors_config", fs_service);
    sensors_configuration_manager = nullptr;
    sensors_configuration_manager = std::make_shared<SensorsConfigurationManager>(
        std::move(cbor_sensors_configuration_service),
        nullptr,
        16,
        16);

    auto saved_sensors = sensors_configuration_manager->Get();

    zassert_equal(saved_sensors->size(), sensors.size());

    for(size_t i = 0; i < sensors.size(); ++i) {
        std::shared_ptr<Sensor> saved_sensor = nullptr;
        for(size_t j = 0; j < saved_sensors->size(); ++j) {
            if(strcmp(saved_sensors->at(j)->id.c_str(), sensors[i]->id.c_str()) == 0) {
                saved_sensor = saved_sensors->at(j);
                break;
            }
        }
        zassert_true(saved_sensor != nullptr);

        zassert_true(saved_sensor->metadata.name == sensors[i]->metadata.name);
        zassert_true(saved_sensor->metadata.unit == sensors[i]->metadata.unit);
        zassert_true(saved_sensor->metadata.description == sensors[i]->metadata.description);

        zassert_true(saved_sensor->configuration.type == sensors[i]->configuration.type);
        if(saved_sensor->configuration.channel.has_value() && sensors[i]->configuration.channel.has_value()) {
            zassert_true(saved_sensor->configuration.channel.value() == sensors[i]->configuration.channel.value());
        } else {
            zassert_true(!saved_sensor->configuration.channel.has_value() && !sensors[i]->configuration.channel.has_value());
        }
        zassert_true(saved_sensor->configuration.sampling_rate_ms == sensors[i]->configuration.sampling_rate_ms);
        if(saved_sensor->configuration.voltage_interpolator != nullptr || sensors[i]->configuration.voltage_interpolator != nullptr)
            zassert_true(saved_sensor->configuration.voltage_interpolator->GetInterpolationMethod() == sensors[i]->configuration.voltage_interpolator->GetInterpolationMethod());
        if(saved_sensor->configuration.expression_evaluator != nullptr || sensors[i]->configuration.expression_evaluator != nullptr)
            zassert_true(saved_sensor->configuration.expression_evaluator->GetExpression() == sensors[i]->configuration.expression_evaluator->GetExpression());
    }
}

ZTEST(sensors_configuration_manager, test_SensorsConfigurationManager_Save_config_valid_sensor_id) {
    DtFs::InitInternalFs();
    auto fs_service = std::make_shared<FsService>(DtFs::GetInternalFsMp());

    fs_service->Format();

    auto cbor_sensors_configuration_service = std::make_unique<CborConfigurationService<CborSensorsConfig>>("sensors_config", fs_service);

    auto sensors_configuration_manager = std::make_shared<SensorsConfigurationManager>(
        std::move(cbor_sensors_configuration_service),
        nullptr,
        16,
        16);

    std::pmr::vector<CalibrationData> calibration_data_1 {
        {0.0, 0.0},
        {3.3, 100.0}
    };
    auto calibration_data_1_ptr = std::make_shared<std::pmr::vector<CalibrationData>>(calibration_data_1);

    auto sensor_1 = std::make_shared<Sensor>(std::allocator_arg, Mrm::GetDefaultPmr(), "sensor_1");

    sensor_1->metadata.name = "Sensor 1";
    sensor_1->metadata.unit = "km/h";
    sensor_1->metadata.description = "Test Sensor 1";

    sensor_1->configuration.type = SensorType::PHYSICAL_ANALOG;
    sensor_1->configuration.channel = 0;
    sensor_1->configuration.sampling_rate_ms = 100;
    sensor_1->configuration.voltage_interpolator = make_unique_pmr<CubicSplineVoltageInterpolator>(Mrm::GetDefaultPmr(), calibration_data_1_ptr);

    auto sensor_2 = std::make_shared<Sensor>(std::allocator_arg, Mrm::GetDefaultPmr(), "_sensor_2");

    sensor_2->metadata.name = "Sensor 2";
    sensor_2->metadata.unit = "km/h";
    sensor_2->metadata.description = "Test Sensor 2";

    sensor_2->configuration.type = SensorType::PHYSICAL_ANALOG;
    sensor_2->configuration.channel = 0;
    sensor_2->configuration.sampling_rate_ms = 100;
    sensor_2->configuration.voltage_interpolator = make_unique_pmr<CubicSplineVoltageInterpolator>(Mrm::GetDefaultPmr(), calibration_data_1_ptr);

    auto sensor_3 = std::make_shared<Sensor>(std::allocator_arg, Mrm::GetDefaultPmr(), "_");

    sensor_3->metadata.name = "Sensor 3";
    sensor_3->metadata.unit = "km/h";
    sensor_3->metadata.description = "Test Sensor 3";

    sensor_3->configuration.type = SensorType::PHYSICAL_ANALOG;
    sensor_3->configuration.channel = 0;
    sensor_3->configuration.sampling_rate_ms = 100;
    sensor_3->configuration.voltage_interpolator = make_unique_pmr<CubicSplineVoltageInterpolator>(Mrm::GetDefaultPmr(), calibration_data_1_ptr);

    std::vector<std::shared_ptr<Sensor>> sensors {
        sensor_1, sensor_2, sensor_3 };

    for(auto sensor : sensors)
        sensors_configuration_manager->Update({sensor});
}

ZTEST(sensors_configuration_manager, test_SensorsConfigurationManager_Save_config_invalid_sensor_id) {
    DtFs::InitInternalFs();
    auto fs_service = std::make_shared<FsService>(DtFs::GetInternalFsMp());

    fs_service->Format();

    auto cbor_sensors_configuration_service = std::make_unique<CborConfigurationService<CborSensorsConfig>>("sensors_config", fs_service);

    auto sensors_configuration_manager = std::make_shared<SensorsConfigurationManager>(
        std::move(cbor_sensors_configuration_service),
        nullptr,
        16,
        16);

    std::pmr::vector<CalibrationData> calibration_data_1 {
        {0.0, 0.0},
        {3.3, 100.0}
    };
    auto calibration_data_1_ptr = std::make_shared<std::pmr::vector<CalibrationData>>(calibration_data_1);

    auto sensor_1 = std::make_shared<Sensor>(std::allocator_arg, Mrm::GetDefaultPmr(), "1_sensor_1");

    sensor_1->metadata.name = "Sensor 1";
    sensor_1->metadata.unit = "km/h";
    sensor_1->metadata.description = "Test Sensor 1";

    sensor_1->configuration.type = SensorType::PHYSICAL_ANALOG;
    sensor_1->configuration.channel = 0;
    sensor_1->configuration.sampling_rate_ms = 100;
    sensor_1->configuration.voltage_interpolator = make_unique_pmr<CubicSplineVoltageInterpolator>(Mrm::GetDefaultPmr(), calibration_data_1_ptr);

    auto sensor_2 = std::make_shared<Sensor>(std::allocator_arg, Mrm::GetDefaultPmr(), "#sensor_2");

    sensor_2->metadata.name = "Sensor 2";
    sensor_2->metadata.unit = "km/h";
    sensor_2->metadata.description = "Test Sensor 2";

    sensor_2->configuration.type = SensorType::PHYSICAL_ANALOG;
    sensor_2->configuration.channel = 0;
    sensor_2->configuration.sampling_rate_ms = 100;
    sensor_2->configuration.voltage_interpolator = make_unique_pmr<CubicSplineVoltageInterpolator>(Mrm::GetDefaultPmr(), calibration_data_1_ptr);

    auto sensor_3 = std::make_shared<Sensor>(std::allocator_arg, Mrm::GetDefaultPmr(), "3");

    sensor_3->metadata.name = "Sensor 3";
    sensor_3->metadata.unit = "km/h";
    sensor_3->metadata.description = "Test Sensor 3";

    sensor_3->configuration.type = SensorType::PHYSICAL_ANALOG;
    sensor_3->configuration.channel = 0;
    sensor_3->configuration.sampling_rate_ms = 100;
    sensor_3->configuration.voltage_interpolator = make_unique_pmr<CubicSplineVoltageInterpolator>(Mrm::GetDefaultPmr(), calibration_data_1_ptr);

    std::vector<std::shared_ptr<Sensor>> sensors {
        sensor_1, sensor_2, sensor_3 };

    for(auto sensor : sensors)
        zassert_false(sensors_configuration_manager->Update({sensor}), "Invalid sensor configuration update expected to fail.");
}
```
