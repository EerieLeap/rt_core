## CMakeLists.txt
```
cmake_minimum_required(VERSION 3.20.0)

include(${CMAKE_CURRENT_SOURCE_DIR}/../../../rt_core_test.cmake)

find_package(Zephyr REQUIRED HINTS $ENV{ZEPHYR_BASE})
project(functional_subsys_smp_ble)

file(GLOB_RECURSE TEST_SOURCES src/*.c src/*.cpp)

target_sources(app PRIVATE ${TEST_SOURCES})
```

## prj.conf
```kconfig
CONFIG_ZTEST=y

# Language and Compiler
CONFIG_CPP=y
CONFIG_PICOLIBC=y
CONFIG_STD_CPP23=y
CONFIG_REQUIRES_FULL_LIBCPP=y
CONFIG_CPP_EXCEPTIONS=y
CONFIG_CPP_RTTI=y

# Memory
CONFIG_HEAP_MEM_POOL_SIZE=200000

# C++ exception unwinding needs considerably more stack than the ztest defaults.
CONFIG_MAIN_STACK_SIZE=8192
CONFIG_ZTEST_STACK_SIZE=8192

# Logging And Debugging
CONFIG_LOG=y
CONFIG_TEST_RANDOM_GENERATOR=y
CONFIG_THREAD_NAME=y

CONFIG_EERIE_LEAP_RT_CORE=y
CONFIG_EERIE_LEAP_SMP_BLE=y

# Short enough for a test to wait it out.
CONFIG_EERIE_LEAP_SMP_BLE_RX_TIMEOUT_MS=100
```

## src/smp_ble_router.cpp
```c
#include <zephyr/mgmt/mcumgr/mgmt/mgmt_defines.h>
#include <zephyr/ztest.h>

#include "smp_ble_test_support.h"

using namespace smp_ble_test;

namespace {

template<typename Condition>
bool WaitUntil(Condition condition) {
    for(int waited_ms = 0; waited_ms < RESPONSE_TIMEOUT_MS; waited_ms += 10) {
        if(condition())
            return true;

        k_msleep(10);
    }

    return condition();
}

} // namespace

ZTEST_SUITE(smp_ble_router, NULL, NULL, NULL, NULL, NULL);

ZTEST(smp_ble_router, test_local_route_reaches_the_smp_server) {
    const RouterHarness harness;

    harness.router->OnReceive(Routed(0, MakeEchoRequest("hello", 11)));

    auto packets = harness.link->WaitForPackets(1);
    zassert_equal(packets.size(), 1);
    ExpectEchoResponse(packets[0], 0, "hello", 11);
    zassert_true(harness.forwarder->forwarded.empty());
}

ZTEST(smp_ble_router, test_own_address_is_served_locally) {
    const RouterHarness harness;
    harness.forwarder->address = 5;
    harness.forwarder->reachable = { 7 };

    harness.router->OnReceive(Routed(5, MakeEchoRequest("self", 12)));

    auto packets = harness.link->WaitForPackets(1);
    zassert_equal(packets.size(), 1);
    ExpectEchoResponse(packets[0], 5, "self", 12);
    zassert_true(harness.forwarder->forwarded.empty());
}

ZTEST(smp_ble_router, test_packets_span_writes_and_notifications) {
    const RouterHarness harness;
    const std::string text = LongText(120);

    // One byte per write splits the route and the SMP header too.
    for(uint8_t byte : Routed(0, MakeEchoRequest(text, 13)))
        harness.router->OnReceive({ &byte, 1 });

    auto packets = harness.link->WaitForPackets(1);
    zassert_equal(packets.size(), 1);
    ExpectEchoResponse(packets[0], 0, text, 13);

    const auto sizes = harness.link->Sizes();
    zassert_true(sizes.size() > 1);
    zassert_true(std::ranges::all_of(sizes, [](size_t size) {
        return size <= 20;
    }));
}

ZTEST(smp_ble_router, test_one_write_may_hold_several_packets) {
    const RouterHarness harness;

    Bytes data = Routed(0, MakeEchoRequest("one", 1));
    const Bytes second = Routed(0, MakeEchoRequest("two", 2));
    data.insert(data.end(), second.begin(), second.end());

    harness.router->OnReceive(data);

    auto packets = harness.link->WaitForPackets(2);
    zassert_equal(packets.size(), 2);
    ExpectEchoResponse(packets[0], 0, "one", 1);
    ExpectEchoResponse(packets[1], 0, "two", 2);
}

ZTEST(smp_ble_router, test_peer_route_is_forwarded_and_its_response_notified) {
    const RouterHarness harness;
    harness.forwarder->address = 5;
    harness.forwarder->reachable = { 7 };

    const Bytes request = MakeEchoRequest("peer", 14);
    harness.router->OnReceive(Routed(7, request));

    zassert_equal(harness.forwarder->forwarded.size(), 1);
    zassert_equal(harness.forwarder->forwarded[0].first, 7);
    zassert_true(harness.forwarder->forwarded[0].second == request);

    Bytes body = { 0xA1, 0x61, 'r' };
    const Bytes text = CborText("peer");
    body.insert(body.end(), text.begin(), text.end());
    const Bytes response = MakePacket(SmpOperation::WRITE_RESPONSE, 0, 0, 14, body);
    harness.router->OnResponse(7, ToSmpPacket(response));

    auto packets = harness.link->WaitForPackets(1);
    zassert_equal(packets.size(), 1);
    zassert_equal(packets[0].route, 7);
    zassert_true(packets[0].packet == response);
}

ZTEST(smp_ble_router, test_image_chunk_of_the_largest_packet_is_forwarded_unchanged) {
    const RouterHarness harness;
    harness.forwarder->address = 5;
    harness.forwarder->reachable = { 7 };

    // An img_mgmt upload chunk (group 1) fills a whole packet buffer, and reaches the router in
    // writes of a small ATT payload; nothing in it is parsed but the header.
    const Bytes request = MakeImageChunkRequest(CONFIG_MCUMGR_TRANSPORT_NETBUF_SIZE, 30);
    zassert_equal(request.size(), CONFIG_MCUMGR_TRANSPORT_NETBUF_SIZE);

    const Bytes routed = Routed(7, request);
    for(size_t offset = 0; offset < routed.size(); offset += 20)
        harness.router->OnReceive(std::span(routed).subspan(offset, std::min<size_t>(20, routed.size() - offset)));

    zassert_equal(harness.forwarder->forwarded.size(), 1);
    zassert_equal(harness.forwarder->forwarded[0].first, 7);
    zassert_true(harness.forwarder->forwarded[0].second == request, "The forwarded packet differs");
    zassert_equal(harness.router->GetRxDroppedCount(), 0);
}

ZTEST(smp_ble_router, test_refused_forward_is_dropped) {
    const RouterHarness harness;
    harness.forwarder->reachable = { 7 };
    harness.forwarder->accept = false;

    harness.router->OnReceive(Routed(7, MakeEchoRequest("lost", 15)));

    zassert_equal(harness.router->GetRxDroppedCount(), 1);
    k_msleep(50);
    zassert_true(harness.link->Stream().empty());
}

ZTEST(smp_ble_router, test_unreachable_destination_gets_enoent) {
    for(const bool has_forwarder : { true, false }) {
        const RouterHarness harness(has_forwarder);

        harness.router->OnReceive(Routed(9, MakeEchoRequest("nobody", 16, SmpOperation::READ)));

        auto packets = harness.link->WaitForPackets(1);
        zassert_equal(packets.size(), 1);
        zassert_equal(packets[0].route, 9);
        zassert_equal(packets[0].header.operation, SmpOperation::READ_RESPONSE);
        zassert_equal(packets[0].header.version, 1);
        zassert_equal(packets[0].header.group, 0);
        zassert_equal(packets[0].header.command_id, 0);
        zassert_equal(packets[0].header.sequence, 16);
        zassert_true(FindInt(packets[0].Body(), "rc") == MGMT_ERR_ENOENT);

        if(has_forwarder)
            zassert_true(harness.forwarder->forwarded.empty());
    }
}

ZTEST(smp_ble_router, test_busy_link_resumes_when_a_notification_leaves) {
    const RouterHarness harness;
    harness.link->SetBudget(1);

    const std::string text = LongText(60);
    harness.router->OnReceive(Routed(0, MakeEchoRequest(text, 17)));

    k_msleep(100);
    zassert_equal(harness.link->Sizes().size(), 1, "Only one notification fits");

    harness.link->SetBudget(-1);
    harness.router->OnNotificationSent();

    auto packets = harness.link->WaitForPackets(1);
    zassert_equal(packets.size(), 1);
    ExpectEchoResponse(packets[0], 0, text, 17);
    zassert_equal(harness.router->GetTxDroppedCount(), 0);
}

ZTEST(smp_ble_router, test_disconnect_drops_a_partial_request) {
    const RouterHarness harness;

    const Bytes stale = Routed(0, MakeEchoRequest("stale", 18));
    harness.router->OnReceive(std::span(stale).first(6));
    harness.router->OnDisconnected();

    harness.router->OnReceive(Routed(0, MakeEchoRequest("fresh", 19)));

    auto packets = harness.link->WaitForPackets(1);
    zassert_equal(packets.size(), 1);
    ExpectEchoResponse(packets[0], 0, "fresh", 19);
}

ZTEST(smp_ble_router, test_disconnect_drops_pending_responses) {
    {
        const RouterHarness harness;
        harness.link->SetBudget(0);

        harness.router->OnReceive(Routed(0, MakeEchoRequest("late", 20)));
        k_msleep(100);

        harness.router->OnDisconnected();
        harness.link->SetBudget(-1);
        harness.router->OnNotificationSent();
        k_msleep(100);

        zassert_true(harness.link->Stream().empty());
        zassert_equal(harness.router->GetTxDroppedCount(), 1);
    }

    zassert_equal(CountFreePackets(), CONFIG_MCUMGR_TRANSPORT_NETBUF_COUNT);
}

ZTEST(smp_ble_router, test_stalled_request_times_out) {
    const RouterHarness harness;

    const Bytes stale = Routed(0, MakeEchoRequest("stale", 21));
    harness.router->OnReceive(std::span(stale).first(12));
    k_msleep(CONFIG_EERIE_LEAP_SMP_BLE_RX_TIMEOUT_MS + 50);

    harness.router->OnReceive(Routed(0, MakeEchoRequest("fresh", 22)));

    auto packets = harness.link->WaitForPackets(1);
    zassert_equal(packets.size(), 1);
    ExpectEchoResponse(packets[0], 0, "fresh", 22);
    zassert_equal(harness.router->GetRxDroppedCount(), 1);
}

ZTEST(smp_ble_router, test_oversized_packets_and_responses_are_skipped) {
    const RouterHarness harness;

    // Longer than a pool buffer; its body is skipped, not parsed as packets.
    const Bytes oversized = MakePacket(SmpOperation::WRITE, 0, 0, 23, Bytes(CONFIG_MCUMGR_TRANSPORT_NETBUF_SIZE, 0xA1));
    const Bytes routed = Routed(0, oversized);
    for(size_t offset = 0; offset < routed.size(); offset += 100)
        harness.router->OnReceive(std::span(routed).subspan(offset, std::min<size_t>(100, routed.size() - offset)));

    harness.router->OnReceive(Routed(0, MakePacket(SmpOperation::READ_RESPONSE, 0, 0, 24, { 0xA0 })));
    harness.router->OnReceive(Routed(0, MakeEchoRequest("after", 25)));

    auto packets = harness.link->WaitForPackets(1);
    zassert_equal(packets.size(), 1);
    ExpectEchoResponse(packets[0], 0, "after", 25);
    zassert_equal(harness.router->GetRxDroppedCount(), 2);
}

ZTEST(smp_ble_router, test_is_notifying_from_the_queued_response_to_its_last_fragment) {
    const RouterHarness harness;
    zassert_false(harness.router->IsNotifying());

    // One fragment goes, then the link has no buffer: the response stays queued and is retried.
    harness.link->SetBudget(1);
    const std::string text = LongText(60);
    harness.router->OnReceive(Routed(0, MakeEchoRequest(text, 30)));

    zassert_true(WaitUntil([&] {
        return harness.link->Sizes().size() == 1;
    }));
    zassert_true(harness.router->IsNotifying(), "The first fragment is out, the rest is not");
    k_msleep(50);
    zassert_true(harness.router->IsNotifying(), "A refused notification keeps the response queued");
    zassert_equal(harness.link->Sizes().size(), 1);

    // The last fragment leaves the flag with it.
    harness.link->SetBudget(-1);
    harness.router->OnNotificationSent();

    auto packets = harness.link->WaitForPackets(1);
    zassert_equal(packets.size(), 1);
    ExpectEchoResponse(packets[0], 0, text, 30);
    zassert_true(harness.link->Sizes().size() > 2, "The response spans several notifications");
    zassert_true(WaitUntil([&] {
        return !harness.router->IsNotifying();
    }));
}

ZTEST(smp_ble_router, test_is_notifying_while_a_refused_response_waits_for_the_first_fragment) {
    const RouterHarness harness;
    harness.link->SetBudget(0);

    harness.router->OnReceive(Routed(0, MakeEchoRequest("wait", 31)));

    zassert_true(WaitUntil([&] {
        return harness.router->IsNotifying();
    }));
    k_msleep(50);
    zassert_true(harness.router->IsNotifying());
    zassert_true(harness.link->Stream().empty());

    harness.link->SetBudget(-1);
    harness.router->OnNotificationSent();

    zassert_equal(harness.link->WaitForPackets(1).size(), 1);
    zassert_true(WaitUntil([&] {
        return !harness.router->IsNotifying();
    }));
}

ZTEST(smp_ble_router, test_is_notifying_until_every_queued_response_is_out) {
    const RouterHarness harness;
    harness.link->SetBudget(0);

    harness.router->OnReceive(Routed(0, MakeEchoRequest("one", 32)));
    harness.router->OnReceive(Routed(0, MakeEchoRequest("two", 33)));
    k_msleep(50);
    zassert_true(harness.router->IsNotifying());

    harness.link->SetBudget(-1);
    harness.router->OnNotificationSent();

    zassert_equal(harness.link->WaitForPackets(2).size(), 2);
    zassert_true(WaitUntil([&] {
        return !harness.router->IsNotifying();
    }));
}

ZTEST(smp_ble_router, test_is_notifying_ends_when_a_response_is_dropped) {
    {
        const RouterHarness harness;
        harness.link->SetBudget(0);

        harness.router->OnReceive(Routed(0, MakeEchoRequest("late", 34)));
        zassert_true(WaitUntil([&] {
            return harness.router->IsNotifying();
        }));

        harness.router->OnDisconnected();
        zassert_true(WaitUntil([&] {
            return !harness.router->IsNotifying();
        }));
        zassert_equal(harness.router->GetTxDroppedCount(), 1);
    }

    {
        // No notification fits at all, as on a link nobody subscribed to.
        const RouterHarness harness;
        harness.link->SetMaxSize(0);

        harness.router->OnReceive(Routed(0, MakeEchoRequest("none", 35)));
        zassert_true(WaitUntil([&] {
            return harness.router->GetTxDroppedCount() == 1;
        }));
        zassert_false(harness.router->IsNotifying());
    }
}

ZTEST(smp_ble_router, test_is_notifying_ends_with_a_response_from_another_unit) {
    const RouterHarness harness;
    harness.forwarder->address = 5;
    harness.forwarder->reachable = { 7 };
    harness.link->SetBudget(0);

    Bytes body = { 0xA1, 0x61, 'r' };
    const Bytes text = CborText("peer");
    body.insert(body.end(), text.begin(), text.end());
    harness.router->OnResponse(7, ToSmpPacket(MakePacket(SmpOperation::WRITE_RESPONSE, 0, 0, 36, body)));

    zassert_true(harness.router->IsNotifying());

    harness.link->SetBudget(-1);
    harness.router->OnNotificationSent();

    zassert_equal(harness.link->WaitForPackets(1).size(), 1);
    zassert_true(WaitUntil([&] {
        return !harness.router->IsNotifying();
    }));
}

ZTEST(smp_ble_router, test_info_reports_version_packet_size_and_requests_in_flight) {
    const auto info = SmpBleRouter::GetInfo();

    zassert_equal(info[0], SmpBleRouter::PROTOCOL_VERSION);
    zassert_equal(info[1] | (info[2] << 8), CONFIG_MCUMGR_TRANSPORT_NETBUF_SIZE);
    zassert_equal(info[3], CONFIG_EERIE_LEAP_SMP_BLE_REQUESTS_IN_FLIGHT);
}
```

## src/smp_ble_test_support.h
```c
#pragma once

#include <algorithm>
#include <cerrno>
#include <cstdint>
#include <memory>
#include <optional>
#include <set>
#include <span>
#include <string>
#include <string_view>
#include <utility>
#include <vector>

#include <zcbor_decode.h>
#include <zephyr/kernel.h>
#include <zephyr/ztest.h>

#include "subsys/bluetooth/i_ble_notifier.h"
#include "subsys/smp/ble/smp_ble_router.h"
#include "subsys/smp/i_smp_forwarder.h"
#include "subsys/smp/smp_header.h"
#include "subsys/smp/smp_packet.h"

namespace smp_ble_test {

using namespace eerie_leap::subsys::smp;
using namespace eerie_leap::subsys::smp::ble;

using Bytes = std::vector<uint8_t>;

inline constexpr int RESPONSE_TIMEOUT_MS = 2000;

inline Bytes
MakePacket(SmpOperation operation, uint16_t group, uint8_t command_id, uint8_t sequence, const Bytes& body) {
    const SmpHeader header{
        .operation = operation,
        .version = 1,
        .length = static_cast<uint16_t>(body.size()),
        .group = group,
        .sequence = sequence,
        .command_id = command_id,
    };

    Bytes packet(SmpHeader::SIZE);
    header.Encode(std::span<uint8_t, SmpHeader::SIZE>(packet.data(), SmpHeader::SIZE));
    packet.insert(packet.end(), body.begin(), body.end());

    return packet;
}

inline Bytes CborText(std::string_view text) {
    Bytes bytes;
    if(text.size() < 24) {
        bytes.push_back(static_cast<uint8_t>(0x60 | text.size()));
    } else {
        bytes.push_back(0x78);
        bytes.push_back(static_cast<uint8_t>(text.size()));
    }
    bytes.insert(bytes.end(), text.begin(), text.end());

    return bytes;
}

// os group (0), echo (0): {"d": text}
inline Bytes MakeEchoRequest(std::string_view text, uint8_t sequence, SmpOperation operation = SmpOperation::WRITE) {
    Bytes body = { 0xA1, 0x61, 'd' };
    auto value = CborText(text);
    body.insert(body.end(), value.begin(), value.end());

    return MakePacket(operation, 0, 0, sequence, body);
}

// img_mgmt group (1), upload (1): {"off": 0, "data": <bytes>}, sized so that the whole packet, header
// included, is @p packet_size bytes. The firmware update sends chunks of this kind.
inline Bytes MakeImageChunkRequest(size_t packet_size, uint8_t sequence) {
    // The map (1 byte), "off" and its value (4 + 1), "data" (5) and the head of a byte string of up to 64 KiB (3).
    constexpr size_t BODY_OVERHEAD = 1 + 4 + 1 + 5 + 3;
    const size_t data_size = packet_size - SmpHeader::SIZE - BODY_OVERHEAD;

    Bytes body = { 0xA2, 0x63, 'o', 'f', 'f', 0x00, 0x64, 'd', 'a', 't', 'a', 0x59 };
    body.push_back(static_cast<uint8_t>(data_size >> 8));
    body.push_back(static_cast<uint8_t>(data_size & 0xFF));
    for(size_t i = 0; i < data_size; i++)
        body.push_back(static_cast<uint8_t>(i * 7 + 3));

    return MakePacket(SmpOperation::WRITE, 1, 1, sequence, body);
}

inline Bytes Routed(uint8_t route, const Bytes& packet) {
    Bytes routed = { route };
    routed.insert(routed.end(), packet.begin(), packet.end());

    return routed;
}

inline std::string LongText(size_t size) {
    std::string text(size, ' ');
    for(size_t i = 0; i < size; i++)
        text[i] = static_cast<char>('a' + i % 26);

    return text;
}

inline SmpPacket ToSmpPacket(const Bytes& bytes) {
    SmpPacket packet = AllocateSmpPacket();
    zassert_not_null(packet.get(), "SMP pool exhausted");
    net_buf_add_mem(packet.get(), bytes.data(), bytes.size());

    return packet;
}

struct RoutedPacket {
    uint8_t route;
    SmpHeader header;
    Bytes packet;

    [[nodiscard]] std::span<const uint8_t> Body() const {
        return std::span(packet).subspan(SmpHeader::SIZE);
    }
};

// Cuts a notification stream into its [route][SMP packet] units.
inline std::vector<RoutedPacket> SplitStream(const Bytes& stream) {
    std::vector<RoutedPacket> packets;

    size_t offset = 0;
    while(stream.size() - offset >= 1 + SmpHeader::SIZE) {
        const auto header = SmpHeader::Parse(std::span(stream).subspan(offset + 1));
        const size_t size = header->GetPacketSize();
        if(stream.size() - offset < 1 + size)
            break;

        packets.push_back(
            {
                .route = stream[offset],
                .header = *header,
                .packet = Bytes(
                    stream.begin() + static_cast<std::ptrdiff_t>(offset + 1),
                    stream.begin() + static_cast<std::ptrdiff_t>(offset + 1 + size)
                ),
            }
        );
        offset += 1 + size;
    }

    return packets;
}

// Reads a text or unsigned value of a flat CBOR map.
inline std::optional<std::string> FindText(std::span<const uint8_t> body, std::string_view key) {
    ZCBOR_STATE_D(zsd, 2, body.data(), body.size(), 1, 0);
    if(!zcbor_map_start_decode(zsd))
        return std::nullopt;

    while(!zcbor_array_at_end(zsd)) {
        zcbor_string name{};
        if(!zcbor_tstr_decode(zsd, &name))
            return std::nullopt;

        zcbor_string value{};
        // NOLINTNEXTLINE(cppcoreguidelines-pro-type-reinterpret-cast): zcbor hands out text as bytes
        if(std::string_view(reinterpret_cast<const char*>(name.value), name.len) == key
            && zcbor_tstr_decode(zsd, &value))
            // NOLINTNEXTLINE(cppcoreguidelines-pro-type-reinterpret-cast): zcbor hands out text as bytes
            return std::string(reinterpret_cast<const char*>(value.value), value.len);

        if(!zcbor_any_skip(zsd, nullptr))
            return std::nullopt;
    }

    return std::nullopt;
}

inline std::optional<int32_t> FindInt(std::span<const uint8_t> body, std::string_view key) {
    ZCBOR_STATE_D(zsd, 2, body.data(), body.size(), 1, 0);
    if(!zcbor_map_start_decode(zsd))
        return std::nullopt;

    while(!zcbor_array_at_end(zsd)) {
        zcbor_string name{};
        if(!zcbor_tstr_decode(zsd, &name))
            return std::nullopt;

        int32_t value = 0;
        // NOLINTNEXTLINE(cppcoreguidelines-pro-type-reinterpret-cast): zcbor hands out text as bytes
        if(std::string_view(reinterpret_cast<const char*>(name.value), name.len) == key
            && zcbor_int32_decode(zsd, &value))
            return value;

        if(!zcbor_any_skip(zsd, nullptr))
            return std::nullopt;
    }

    return std::nullopt;
}

inline void ExpectEchoResponse(const RoutedPacket& response, uint8_t route, std::string_view text, uint8_t sequence) {
    zassert_equal(response.route, route);
    zassert_equal(response.header.operation, SmpOperation::WRITE_RESPONSE);
    zassert_equal(response.header.group, 0);
    zassert_equal(response.header.command_id, 0);
    zassert_equal(response.header.sequence, sequence);
    zassert_true(FindText(response.Body(), "r") == text, "Echo text differs");
}

// The central: records notifications, and runs out of buffers on demand.
class FakeLink : public eerie_leap::subsys::bluetooth::IBleNotifier {
private:
    mutable k_mutex lock_{};
    size_t max_size_ = 20;
    int budget_ = -1;
    Bytes stream_;
    std::vector<size_t> sizes_;

public:
    FakeLink() {
        k_mutex_init(&lock_);
    }

    void SetMaxSize(size_t size) {
        k_mutex_lock(&lock_, K_FOREVER);
        max_size_ = size;
        k_mutex_unlock(&lock_);
    }

    // Notifications accepted before -ENOMEM; negative for no limit.
    void SetBudget(int budget) {
        k_mutex_lock(&lock_, K_FOREVER);
        budget_ = budget;
        k_mutex_unlock(&lock_);
    }

    [[nodiscard]] size_t GetMaxNotificationSize() const override {
        k_mutex_lock(&lock_, K_FOREVER);
        const size_t size = max_size_;
        k_mutex_unlock(&lock_);

        return size;
    }

    int Notify(std::span<const uint8_t> fragment) override {
        k_mutex_lock(&lock_, K_FOREVER);

        if(budget_ == 0) {
            k_mutex_unlock(&lock_);
            return -ENOMEM;
        }
        if(budget_ > 0)
            budget_--;

        stream_.insert(stream_.end(), fragment.begin(), fragment.end());
        sizes_.push_back(fragment.size());
        k_mutex_unlock(&lock_);

        return 0;
    }

    [[nodiscard]] Bytes Stream() const {
        k_mutex_lock(&lock_, K_FOREVER);
        Bytes stream = stream_;
        k_mutex_unlock(&lock_);

        return stream;
    }

    [[nodiscard]] std::vector<size_t> Sizes() const {
        k_mutex_lock(&lock_, K_FOREVER);
        auto sizes = sizes_;
        k_mutex_unlock(&lock_);

        return sizes;
    }

    std::vector<RoutedPacket> WaitForPackets(size_t count) const {
        for(int waited_ms = 0; waited_ms < RESPONSE_TIMEOUT_MS; waited_ms += 10) {
            auto packets = SplitStream(Stream());
            if(packets.size() >= count)
                return packets;

            k_msleep(10);
        }

        return SplitStream(Stream());
    }
};

class FakeForwarder : public ISmpForwarder {
public:
    uint8_t address = 0;
    std::set<uint8_t> reachable;
    bool accept = true;
    std::vector<std::pair<uint8_t, Bytes>> forwarded;
    std::shared_ptr<ISmpResponseSink> response_sink;

    [[nodiscard]] uint8_t GetAddress() const override {
        return address;
    }
    [[nodiscard]] bool IsReachable(uint8_t target) const override {
        return reachable.contains(target);
    }

    bool Forward(uint8_t target, SmpPacket packet) override {
        if(!accept)
            return false;

        forwarded.emplace_back(target, Bytes(packet->data, packet->data + packet->len));
        return true;
    }

    void SetResponseSink(std::shared_ptr<ISmpResponseSink> sink) override {
        response_sink = std::move(sink);
    }
};

struct RouterHarness {
    std::shared_ptr<FakeLink> link = std::make_shared<FakeLink>();
    std::shared_ptr<FakeForwarder> forwarder;
    std::shared_ptr<SmpBleRouter> router;

    explicit RouterHarness(bool has_forwarder = true) {
        if(has_forwarder)
            forwarder = std::make_shared<FakeForwarder>();

        router = std::make_shared<SmpBleRouter>(link, forwarder);
        zassert_true(router->Initialize());
    }
};

// All pool buffers are back once nothing holds a packet any more.
inline size_t CountFreePackets() {
    std::vector<SmpPacket> packets;
    while(auto packet = AllocateSmpPacket())
        packets.push_back(std::move(packet));

    return packets.size();
}

} // namespace smp_ble_test
```
