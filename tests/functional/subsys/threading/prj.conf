## CMakeLists.txt
```
cmake_minimum_required(VERSION 3.20.0)

include(${CMAKE_CURRENT_SOURCE_DIR}/../../../rt_core_test.cmake)

find_package(Zephyr REQUIRED HINTS $ENV{ZEPHYR_BASE})
project(functional_subsys_threading)

file(GLOB_RECURSE TEST_SOURCES src/*.c src/*.cpp)

target_sources(app PRIVATE ${TEST_SOURCES})
```

## prj.conf
```kconfig
CONFIG_ZTEST=y

# Language and Compiler
CONFIG_CPP=y
CONFIG_PICOLIBC=y
CONFIG_STD_CPP23=y
CONFIG_REQUIRES_FULL_LIBCPP=y
CONFIG_CPP_EXCEPTIONS=y
CONFIG_CPP_RTTI=y

# Memory
CONFIG_HEAP_MEM_POOL_SIZE=200000

# C++ exception unwinding needs considerably more stack than the ztest defaults.
CONFIG_MAIN_STACK_SIZE=8192
CONFIG_ZTEST_STACK_SIZE=8192

# Logging And Debugging
CONFIG_LOG=y
CONFIG_TEST_RANDOM_GENERATOR=y
CONFIG_THREAD_NAME=y
CONFIG_THREAD_MONITOR=y

# ThreadBase::InitializeStack() falls back to k_thread_stack_alloc().
CONFIG_THREAD_STACK_INFO=y
CONFIG_DYNAMIC_THREAD=y
CONFIG_DYNAMIC_THREAD_ALLOC=y

CONFIG_EERIE_LEAP_RT_CORE=y
CONFIG_EERIE_LEAP_THREADING=y
```

## src/thread.cpp
```c
#include <stdexcept>
#include <string>

#include <zephyr/ztest.h>

#include "subsys/threading/thread.h"

using eerie_leap::subsys::threading::IThread;
using eerie_leap::subsys::threading::Thread;

namespace {

constexpr int STACK_SIZE = 8192;
// A thread that throws needs room for the unwinder: DWARF unwinding takes 6.5 to 9 KB on riscv64, malta,
// aarch64 and Xtensa, which leaves STACK_SIZE no margin.
constexpr int THROWING_STACK_SIZE = 16384;
constexpr int OVERSIZED_STACK_SIZE = 4 * 1024 * 1024;
constexpr int PRIORITY = 5;
constexpr int SYNC_TIMEOUT_MS = 500;
constexpr int IDLE_TIMEOUT_MS = 50;

// Blocks inside the entry point so the test can observe a live thread.
class BlockingWorker : public IThread {
private:
    k_sem entered_{};
    k_sem resume_{};
    atomic_t entries_{ ATOMIC_INIT(0) };
    atomic_t exits_{ ATOMIC_INIT(0) };

public:
    BlockingWorker() {
        k_sem_init(&entered_, 0, K_SEM_MAX_LIMIT);
        k_sem_init(&resume_, 0, K_SEM_MAX_LIMIT);
    }

    void ThreadEntry() override {
        atomic_inc(&entries_);
        k_sem_give(&entered_);
        k_sem_take(&resume_, K_FOREVER);
        atomic_inc(&exits_);
    }

    bool WaitForEntry(int timeout_ms) {
        return k_sem_take(&entered_, K_MSEC(timeout_ms)) == 0;
    }
    void Resume() {
        k_sem_give(&resume_);
    }

    [[nodiscard]] int Entries() const {
        return static_cast<int>(atomic_get(&entries_));
    }
    [[nodiscard]] int Exits() const {
        return static_cast<int>(atomic_get(&exits_));
    }
};

// Terminates on its own so Join() has something to wait for.
class SleepingWorker : public IThread {
private:
    int sleep_ms_;
    atomic_t entries_{ ATOMIC_INIT(0) };
    atomic_t finished_{ ATOMIC_INIT(0) };

public:
    explicit SleepingWorker(int sleep_ms) :
        sleep_ms_(sleep_ms) {}

    void ThreadEntry() override {
        atomic_inc(&entries_);
        k_sleep(K_MSEC(sleep_ms_));
        atomic_inc(&finished_);
    }

    [[nodiscard]] int Entries() const {
        return static_cast<int>(atomic_get(&entries_));
    }
    [[nodiscard]] int Finished() const {
        return static_cast<int>(atomic_get(&finished_));
    }
};

// Throws instead of returning, so the entry-point trampoline must catch it.
class ThrowingWorker : public IThread {
private:
    bool throw_std_exception_;
    atomic_t entries_{ ATOMIC_INIT(0) };

public:
    explicit ThrowingWorker(bool throw_std_exception) :
        throw_std_exception_(throw_std_exception) {}

    void ThreadEntry() override {
        atomic_inc(&entries_);

        if(throw_std_exception_)
            throw std::runtime_error("boom");

        throw 42; // NOLINT(bugprone-std-exception-baseclass): the case is about a thread entry that throws something that is not a std::exception
    }

    [[nodiscard]] int Entries() const {
        return static_cast<int>(atomic_get(&entries_));
    }
};

} // namespace

ZTEST_SUITE(thread, NULL, NULL, NULL, NULL, NULL);

ZTEST(thread, test_Start_is_ignored_before_Initialize) {
    BlockingWorker worker;
    Thread thread("uninitialized", &worker, STACK_SIZE, PRIORITY);

    zassert_false(thread.Start());

    zassert_is_null(thread.GetStack());
    zassert_is_null(thread.GetThread());
    zassert_false(thread.IsRunning());
    zassert_false(worker.WaitForEntry(IDLE_TIMEOUT_MS));
    zassert_equal(worker.Entries(), 0);
}

ZTEST(thread, test_Start_is_ignored_when_the_stack_cannot_be_allocated) {
    BlockingWorker worker;
    Thread thread("oversized", &worker, OVERSIZED_STACK_SIZE, PRIORITY);

    zassert_false(thread.Initialize());
    zassert_false(thread.Start());

    zassert_is_null(thread.GetStack());
    zassert_is_null(thread.GetThread());
    zassert_false(thread.IsRunning());
    zassert_false(worker.WaitForEntry(IDLE_TIMEOUT_MS));
}

ZTEST(thread, test_Initialize_allocates_the_stack_without_starting) {
    BlockingWorker worker;
    Thread thread("initialized", &worker, STACK_SIZE, PRIORITY);

    zassert_true(thread.Initialize());

    zassert_not_null(thread.GetStack());
    zassert_is_null(thread.GetThread());
    zassert_false(thread.IsRunning());
    zassert_false(worker.WaitForEntry(IDLE_TIMEOUT_MS));
}

ZTEST(thread, test_Start_runs_the_entry_point) {
    BlockingWorker worker;
    Thread thread("runner", &worker, STACK_SIZE, PRIORITY);

    thread.Initialize();

    zassert_true(thread.Start());
    zassert_true(worker.WaitForEntry(SYNC_TIMEOUT_MS));
    zassert_true(thread.IsRunning());
    zassert_not_null(thread.GetThread());

    worker.Resume();
    thread.Join();

    zassert_equal(worker.Entries(), 1);
    zassert_equal(worker.Exits(), 1);
    zassert_false(thread.IsRunning());
}

ZTEST(thread, test_Start_applies_the_thread_name) {
    BlockingWorker worker;
    Thread thread("named_worker", &worker, STACK_SIZE, PRIORITY);

    thread.Initialize();
    thread.Start();

    zassert_true(worker.WaitForEntry(SYNC_TIMEOUT_MS));
    zassert_equal(std::string(k_thread_name_get(thread.GetThread())), std::string("named_worker"));

    worker.Resume();
    thread.Join();
}

ZTEST(thread, test_Start_creates_a_preemptive_thread_by_default) {
    BlockingWorker worker;
    Thread thread("preemptive", &worker, STACK_SIZE, PRIORITY);

    thread.Initialize();
    thread.Start();

    zassert_true(worker.WaitForEntry(SYNC_TIMEOUT_MS));
    zassert_equal(k_thread_priority_get(thread.GetThread()), PRIORITY);

    worker.Resume();
    thread.Join();
}

ZTEST(thread, test_Start_creates_a_cooperative_thread_when_requested) {
    BlockingWorker worker;
    Thread thread("cooperative", &worker, STACK_SIZE, PRIORITY, true);

    thread.Initialize();
    thread.Start();

    zassert_true(worker.WaitForEntry(SYNC_TIMEOUT_MS));
    zassert_equal(k_thread_priority_get(thread.GetThread()), -PRIORITY);

    worker.Resume();
    thread.Join();
}

ZTEST(thread, test_Start_is_ignored_while_the_thread_is_running) {
    BlockingWorker worker;
    Thread thread("single_start", &worker, STACK_SIZE, PRIORITY);

    thread.Initialize();
    thread.Start();
    zassert_true(worker.WaitForEntry(SYNC_TIMEOUT_MS));

    zassert_false(thread.Start());

    zassert_false(worker.WaitForEntry(IDLE_TIMEOUT_MS));
    zassert_equal(worker.Entries(), 1);

    worker.Resume();
    thread.Join();
}

ZTEST(thread, test_Start_can_be_repeated_after_Join) {
    BlockingWorker worker;
    Thread thread("restarted", &worker, STACK_SIZE, PRIORITY);

    thread.Initialize();

    for(int i = 1; i <= 2; ++i) {
        thread.Start();

        zassert_true(worker.WaitForEntry(SYNC_TIMEOUT_MS));
        zassert_true(thread.IsRunning());

        worker.Resume();
        thread.Join();

        zassert_equal(worker.Entries(), i);
        zassert_equal(worker.Exits(), i);
    }
}

ZTEST(thread, test_Join_waits_for_the_entry_point_to_return) {
    SleepingWorker worker(100);
    Thread thread("joinable", &worker, STACK_SIZE, PRIORITY);

    thread.Initialize();
    thread.Start();

    zassert_equal(worker.Finished(), 0);

    thread.Join();

    zassert_equal(worker.Finished(), 1);
    zassert_false(thread.IsRunning());
}

ZTEST(thread, test_IsRunning_clears_itself_when_the_entry_point_returns) {
    SleepingWorker worker(50);
    Thread thread("self_terminating", &worker, STACK_SIZE, PRIORITY);

    thread.Initialize();
    thread.Start();

    zassert_true(thread.IsRunning());

    k_sleep(K_MSEC(200));

    zassert_equal(worker.Finished(), 1);
    zassert_false(thread.IsRunning());

    thread.Join();
}

ZTEST(thread, test_Start_can_be_repeated_after_the_entry_point_returned) {
    SleepingWorker worker(20);
    Thread thread("self_restarting", &worker, STACK_SIZE, PRIORITY);

    thread.Initialize();
    thread.Start();

    k_sleep(K_MSEC(150));
    zassert_equal(worker.Finished(), 1);

    thread.Start();

    k_sleep(K_MSEC(150));

    zassert_equal(worker.Entries(), 2);
    zassert_equal(worker.Finished(), 2);

    thread.Join();
}

ZTEST(thread, test_destructor_waits_for_the_entry_point_to_return) {
    SleepingWorker worker(150);

    {
        Thread thread("destroyed_while_running", &worker, STACK_SIZE, PRIORITY);
        thread.Initialize();
        thread.Start();

        zassert_equal(worker.Finished(), 0);
    }

    zassert_equal(worker.Finished(), 1);
}

ZTEST(thread, test_Join_is_ignored_when_the_thread_never_started) {
    BlockingWorker worker;
    Thread thread("never_started", &worker, STACK_SIZE, PRIORITY);

    thread.Join();
    thread.Initialize();
    thread.Join();

    zassert_false(thread.IsRunning());
    zassert_equal(worker.Entries(), 0);
}

ZTEST(thread, test_threads_run_independently_of_each_other) {
    constexpr int THREAD_COUNT = 3;

    BlockingWorker workers[THREAD_COUNT];
    Thread threads[] = { Thread("worker_0", &workers[0], STACK_SIZE, PRIORITY),
        Thread("worker_1", &workers[1], STACK_SIZE, PRIORITY), Thread("worker_2", &workers[2], STACK_SIZE, PRIORITY) };

    for(auto& thread : threads) {
        thread.Initialize();
        thread.Start();
    }

    for(auto& worker : workers)
        zassert_true(worker.WaitForEntry(SYNC_TIMEOUT_MS));

    for(auto& thread : threads)
        zassert_true(thread.IsRunning());

    zassert_true(threads[0].GetThread() != threads[1].GetThread());
    zassert_true(threads[1].GetThread() != threads[2].GetThread());

    for(auto& worker : workers)
        worker.Resume();

    for(auto& thread : threads)
        thread.Join();

    for(const auto& worker : workers)
        zassert_equal(worker.Exits(), 1);
}

ZTEST(thread, test_Start_survives_a_std_exception_thrown_from_the_entry_point) {
    ThrowingWorker worker(true);
    Thread thread("throws_std_exception", &worker, THROWING_STACK_SIZE, PRIORITY);

    thread.Initialize();
    thread.Start();
    thread.Join();

    zassert_equal(worker.Entries(), 1);
    zassert_false(thread.IsRunning());
}

ZTEST(thread, test_Start_survives_a_non_std_exception_thrown_from_the_entry_point) {
    ThrowingWorker worker(false);
    Thread thread("throws_non_std_exception", &worker, THROWING_STACK_SIZE, PRIORITY);

    thread.Initialize();
    thread.Start();
    thread.Join();

    zassert_equal(worker.Entries(), 1);
    zassert_false(thread.IsRunning());
}

ZTEST(thread, test_Start_can_be_repeated_after_the_entry_point_threw) {
    ThrowingWorker worker(true);
    Thread thread("restarted_after_throw", &worker, THROWING_STACK_SIZE, PRIORITY);

    thread.Initialize();

    for(int i = 1; i <= 2; ++i) {
        thread.Start();
        thread.Join();

        zassert_equal(worker.Entries(), i);
        zassert_false(thread.IsRunning());
    }
}
```

## src/work_queue_load_balancer.cpp
```c
#include <memory>
#include <stdexcept>
#include <vector>

#include <zephyr/ztest.h>

#include "subsys/threading/work_queue_load_balancer.h"

using eerie_leap::subsys::threading::WorkQueueLoadBalancer;
using eerie_leap::subsys::threading::WorkQueueThread;

namespace {

constexpr int STACK_SIZE = 2048;
constexpr int PRIORITY = 6;

// AddThread() reads GetWorkQueue(), so only initialized queues can join the balancer.
std::shared_ptr<WorkQueueThread> MakeQueueThread(const char* name) {
    auto queue_thread = std::make_shared<WorkQueueThread>(name, STACK_SIZE, PRIORITY);
    queue_thread->Initialize();

    return queue_thread;
}

class BalancedQueues {
private:
    std::vector<std::shared_ptr<WorkQueueThread>> queue_threads_;

public:
    WorkQueueLoadBalancer balancer;

    explicit BalancedQueues(int count) {
        static const char* names[] = { "wq_lb_0", "wq_lb_1", "wq_lb_2", "wq_lb_3" };

        for(int i = 0; i < count; ++i) {
            queue_threads_.push_back(MakeQueueThread(names[i]));
            balancer.AddThread(queue_threads_.back());
        }
    }

    BalancedQueues(const BalancedQueues&) = delete;
    BalancedQueues& operator=(const BalancedQueues&) = delete;
    BalancedQueues(BalancedQueues&&) = delete;
    BalancedQueues& operator=(BalancedQueues&&) = delete;

    ~BalancedQueues() {
        for(const auto& queue_thread : queue_threads_)
            queue_thread->Stop();
    }

    [[nodiscard]] const std::shared_ptr<WorkQueueThread>& At(int index) const {
        return queue_threads_[index];
    }
};

} // namespace

ZTEST_SUITE(work_queue_load_balancer, NULL, NULL, NULL, NULL, NULL);

ZTEST(work_queue_load_balancer, test_GetLeastLoadedQueue_returns_nothing_without_queues) {
    WorkQueueLoadBalancer balancer;

    zassert_true(balancer.GetLeastLoadedQueue() == nullptr);
}

ZTEST(work_queue_load_balancer, test_AddThread_rejects_a_queue_that_is_not_running) {
    BalancedQueues queues(2);

    const auto unstarted = std::make_shared<WorkQueueThread>("wq_lb_unstarted", STACK_SIZE, PRIORITY);
    bool threw = false;

    try {
        queues.balancer.AddThread(unstarted);
    } catch(const std::runtime_error&) {
        threw = true;
    }

    zassert_true(threw);

    // The rejected queue must not have disturbed the registered ones.
    zassert_equal(queues.balancer.GetLeastLoadedQueue(), queues.At(0));
    zassert_equal(queues.balancer.GetLeastLoadedQueue(), queues.At(1));
    zassert_equal(queues.balancer.GetLeastLoadedQueue(), queues.At(0));
}

ZTEST(work_queue_load_balancer, test_OnWorkComplete_ignores_an_unregistered_queue) {
    BalancedQueues queues(2);
    const auto outsider = MakeQueueThread("wq_lb_outsider");

    queues.balancer.OnWorkComplete(*outsider, 5000);

    zassert_equal(queues.balancer.GetLeastLoadedQueue(), queues.At(0));
    zassert_equal(queues.balancer.GetLeastLoadedQueue(), queues.At(1));

    outsider->Stop();
}

ZTEST(work_queue_load_balancer, test_GetLeastLoadedQueue_always_returns_the_only_queue) {
    BalancedQueues queues(1);

    for(int i = 0; i < 4; ++i)
        zassert_equal(queues.balancer.GetLeastLoadedQueue(), queues.At(0));
}

ZTEST(work_queue_load_balancer, test_GetLeastLoadedQueue_spreads_reservations_over_idle_queues) {
    BalancedQueues queues(3);

    zassert_equal(queues.balancer.GetLeastLoadedQueue(), queues.At(0));
    zassert_equal(queues.balancer.GetLeastLoadedQueue(), queues.At(1));
    zassert_equal(queues.balancer.GetLeastLoadedQueue(), queues.At(2));
    zassert_equal(queues.balancer.GetLeastLoadedQueue(), queues.At(0));
}

ZTEST(work_queue_load_balancer, test_OnWorkComplete_releases_the_reserved_capacity) {
    BalancedQueues queues(2);

    zassert_equal(queues.balancer.GetLeastLoadedQueue(), queues.At(0));

    queues.balancer.OnWorkComplete(*queues.At(0), 0);

    zassert_equal(queues.balancer.GetLeastLoadedQueue(), queues.At(0));
}

ZTEST(work_queue_load_balancer, test_GetLeastLoadedQueue_avoids_the_queue_with_recorded_load) {
    BalancedQueues queues(2);

    zassert_equal(queues.balancer.GetLeastLoadedQueue(), queues.At(0));
    queues.balancer.OnWorkComplete(*queues.At(0), 250);

    // The first queue carries 250 ms of load, so the idle one wins even though it is second.
    zassert_equal(queues.balancer.GetLeastLoadedQueue(), queues.At(1));
    queues.balancer.OnWorkComplete(*queues.At(1), 0);

    zassert_equal(queues.balancer.GetLeastLoadedQueue(), queues.At(1));
}

ZTEST(work_queue_load_balancer, test_pending_reservations_outweigh_recorded_load) {
    BalancedQueues queues(2);

    zassert_equal(queues.balancer.GetLeastLoadedQueue(), queues.At(0));
    queues.balancer.OnWorkComplete(*queues.At(0), 5);

    // Queue 0 scores 5 against queue 1's single outstanding reservation, worth 10.
    zassert_equal(queues.balancer.GetLeastLoadedQueue(), queues.At(1));
    zassert_equal(queues.balancer.GetLeastLoadedQueue(), queues.At(0));
}
```

## src/work_queue_thread.cpp
```c
#include <memory>
#include <stdexcept>
#include <string>

#include <zephyr/ztest.h>

#include "subsys/threading/work_queue_thread.h"

using eerie_leap::subsys::threading::WorkQueueTaskResult;
using eerie_leap::subsys::threading::WorkQueueThread;

namespace {

constexpr int STACK_SIZE = 4096;
constexpr int OVERSIZED_STACK_SIZE = 4 * 1024 * 1024;
constexpr int PRIORITY = 5;
constexpr int SYNC_TIMEOUT_MS = 1000;
constexpr int IDLE_TIMEOUT_MS = 100;

struct TaskProbe {
    k_sem finished{};
    atomic_t runs{ ATOMIC_INIT(0) };
    int reschedules;

    explicit TaskProbe(int reschedules = 0) :
        reschedules(reschedules) {
        k_sem_init(&finished, 0, K_SEM_MAX_LIMIT);
    }

    [[nodiscard]] int Runs() const {
        return static_cast<int>(atomic_get(&runs));
    }
    bool WaitForRun(int timeout_ms) {
        return k_sem_take(&finished, K_MSEC(timeout_ms)) == 0;
    }
};

WorkQueueTaskResult ProbeHandler(TaskProbe* probe) {
    const atomic_val_t previous_runs = atomic_inc(&probe->runs);
    k_sem_give(&probe->finished);

    return { .reschedule = previous_runs < probe->reschedules, .delay = K_MSEC(5) };
}

std::unique_ptr<WorkQueueThread> MakeQueueThread(const char* name) {
    auto queue_thread = std::make_unique<WorkQueueThread>(name, STACK_SIZE, PRIORITY);
    queue_thread->Initialize();

    return queue_thread;
}

template<typename TAction>
bool ThrowsRuntimeError(TAction&& action) {
    try {
        std::forward<TAction>(action)();
    } catch(const std::runtime_error&) {
        return true;
    } catch(...) {
        return false;
    }

    return false;
}

struct ThreadLookup {
    const char* name;
    bool found;
};

void MatchThreadName(const k_thread* thread, void* user_data) {
    auto* lookup = static_cast<ThreadLookup*>(user_data);
    // NOLINTNEXTLINE(cppcoreguidelines-pro-type-const-cast): k_thread_name_get() takes a non-const k_tid_t; the callback's const is fixed by Zephyr
    const char* name = k_thread_name_get(const_cast<k_thread*>(thread));

    if(name != nullptr && std::string(name) == lookup->name)
        lookup->found = true;
}

bool ThreadExists(const char* name) {
    ThreadLookup lookup{ name, false };
    k_thread_foreach(MatchThreadName, &lookup);

    return lookup.found;
}

} // namespace

ZTEST_SUITE(work_queue_thread, NULL, NULL, NULL, NULL, NULL);

ZTEST(work_queue_thread, test_an_unstarted_queue_rejects_every_operation) {
    WorkQueueThread queue_thread("wq_unstarted", STACK_SIZE, PRIORITY);

    zassert_true(ThrowsRuntimeError([&] {
        (void)queue_thread.GetWorkQueue();
    }));
    zassert_true(ThrowsRuntimeError([&] {
        queue_thread.Run([] {});
    }));
    zassert_true(ThrowsRuntimeError([&] {
        (void)queue_thread.CreateTask(ProbeHandler, std::make_unique<TaskProbe>());
    }));

    queue_thread.Stop();

    zassert_is_null(queue_thread.GetStack());
}

ZTEST(work_queue_thread, test_Initialize_starts_a_named_queue_thread) {
    auto queue_thread = MakeQueueThread("wq_named");

    auto* queue = queue_thread->GetWorkQueue();

    zassert_not_null(queue);
    zassert_not_null(queue->thread_id);
    zassert_not_null(queue_thread->GetStack());
    zassert_equal(std::string(k_thread_name_get(queue->thread_id)), std::string("wq_named"));
    zassert_equal(k_thread_priority_get(queue->thread_id), PRIORITY);

    queue_thread->Stop();
}

ZTEST(work_queue_thread, test_Initialize_is_ignored_when_the_queue_already_runs) {
    auto queue_thread = MakeQueueThread("wq_reinitialized");
    k_tid_t queue_tid = queue_thread->GetWorkQueue()->thread_id;

    zassert_true(queue_thread->Initialize());
    zassert_equal(queue_thread->GetWorkQueue()->thread_id, queue_tid);

    queue_thread->Stop();
}

ZTEST(work_queue_thread, test_Initialize_reports_a_stack_allocation_failure) {
    WorkQueueThread queue_thread("wq_oversized", OVERSIZED_STACK_SIZE, PRIORITY);

    zassert_false(queue_thread.Initialize());
    zassert_is_null(queue_thread.GetStack());
    zassert_true(ThrowsRuntimeError([&] {
        (void)queue_thread.GetWorkQueue();
    }));
}

ZTEST(work_queue_thread, test_Stop_can_be_repeated) {
    auto queue_thread = MakeQueueThread("wq_stopped_twice");

    queue_thread->Stop();
    queue_thread->Stop();

    zassert_false(ThreadExists("wq_stopped_twice"));
}

ZTEST(work_queue_thread, test_CreateTask_runs_the_handler_with_owned_user_data) {
    auto queue_thread = MakeQueueThread("wq_owned");

    auto probe = std::make_unique<TaskProbe>();
    TaskProbe* probe_ptr = probe.get();

    auto task = queue_thread->CreateTask(ProbeHandler, std::move(probe));

    zassert_equal(task.GetUserdata(), probe_ptr);

    task.Schedule();

    zassert_true(probe_ptr->WaitForRun(SYNC_TIMEOUT_MS));
    zassert_equal(probe_ptr->Runs(), 1);

    queue_thread->Stop();

    zassert_false(task.IsScheduled());
}

ZTEST(work_queue_thread, test_CreateTask_runs_the_handler_with_borrowed_user_data) {
    auto queue_thread = MakeQueueThread("wq_borrowed");

    TaskProbe probe;
    auto task = queue_thread->CreateTask(ProbeHandler, &probe);

    zassert_equal(task.GetUserdata(), &probe);

    task.Schedule();

    zassert_true(probe.WaitForRun(SYNC_TIMEOUT_MS));
    zassert_equal(probe.Runs(), 1);

    queue_thread->Stop();
}

ZTEST(work_queue_thread, test_Schedule_defers_the_handler_by_the_requested_delay) {
    auto queue_thread = MakeQueueThread("wq_delayed");

    TaskProbe probe;
    auto task = queue_thread->CreateTask(ProbeHandler, &probe);

    const int64_t started_at = k_uptime_get();
    task.Schedule(K_MSEC(150));

    zassert_true(probe.WaitForRun(SYNC_TIMEOUT_MS));
    zassert_true(k_uptime_get() - started_at >= 140, "handler ran before the requested delay");

    queue_thread->Stop();
}

ZTEST(work_queue_thread, test_Reschedule_replaces_a_pending_delay) {
    auto queue_thread = MakeQueueThread("wq_rescheduled");

    TaskProbe probe;
    auto task = queue_thread->CreateTask(ProbeHandler, &probe);

    task.Schedule(K_SECONDS(30));
    task.Reschedule(K_MSEC(20));

    zassert_true(probe.WaitForRun(SYNC_TIMEOUT_MS));
    zassert_equal(probe.Runs(), 1);

    queue_thread->Stop();
}

ZTEST(work_queue_thread, test_Cancel_stops_a_delayed_handler_from_running) {
    auto queue_thread = MakeQueueThread("wq_cancelled");

    TaskProbe probe;
    auto task = queue_thread->CreateTask(ProbeHandler, &probe);

    task.Schedule(K_MSEC(300));
    task.Cancel();

    zassert_false(probe.WaitForRun(400));
    zassert_equal(probe.Runs(), 0);

    queue_thread->Stop();
}

ZTEST(work_queue_thread, test_a_handler_asking_to_reschedule_is_run_again) {
    constexpr int RESCHEDULES = 2;

    auto queue_thread = MakeQueueThread("wq_repeating");

    TaskProbe probe(RESCHEDULES);
    auto task = queue_thread->CreateTask(ProbeHandler, &probe);

    task.Schedule();

    for(int i = 0; i < RESCHEDULES + 1; ++i)
        zassert_true(probe.WaitForRun(SYNC_TIMEOUT_MS), "run %d never happened", i);

    zassert_false(probe.WaitForRun(IDLE_TIMEOUT_MS));
    zassert_equal(probe.Runs(), RESCHEDULES + 1);

    queue_thread->Stop();
}

ZTEST(work_queue_thread, test_tasks_of_one_queue_run_on_the_queue_thread) {
    auto queue_thread = MakeQueueThread("wq_affinity");

    k_tid_t observed = nullptr;
    k_sem done{};
    k_sem_init(&done, 0, K_SEM_MAX_LIMIT);

    queue_thread->Run([&] {
        observed = k_current_get();
        k_sem_give(&done);
    });

    zassert_equal(k_sem_take(&done, K_MSEC(SYNC_TIMEOUT_MS)), 0);
    zassert_equal(observed, queue_thread->GetWorkQueue()->thread_id);
    zassert_true(observed != k_current_get());

    queue_thread->Stop();
}

ZTEST(work_queue_thread, test_Run_executes_every_submitted_handler) {
    constexpr int RUN_COUNT = 8;

    auto queue_thread = MakeQueueThread("wq_runner");

    atomic_t completed = ATOMIC_INIT(0);
    k_sem done{};
    k_sem_init(&done, 0, K_SEM_MAX_LIMIT);

    for(int i = 0; i < RUN_COUNT; ++i) {
        queue_thread->Run([&] {
            atomic_inc(&completed);
            k_sem_give(&done);
        });
    }

    for(int i = 0; i < RUN_COUNT; ++i)
        zassert_equal(k_sem_take(&done, K_MSEC(SYNC_TIMEOUT_MS)), 0, "handler %d never ran", i);

    zassert_equal(atomic_get(&completed), RUN_COUNT);

    queue_thread->Stop();
}

ZTEST(work_queue_thread, test_Stop_drains_the_work_that_is_still_pending) {
    constexpr int RUN_COUNT = 5;

    auto queue_thread = MakeQueueThread("wq_drained");

    atomic_t completed = ATOMIC_INIT(0);

    for(int i = 0; i < RUN_COUNT; ++i)
        queue_thread->Run([&] {
            atomic_inc(&completed);
        });

    queue_thread->Stop();

    zassert_equal(atomic_get(&completed), RUN_COUNT);
}

ZTEST(work_queue_thread, test_the_destructor_drains_and_stops_the_queue_thread) {
    constexpr int RUN_COUNT = 5;

    atomic_t completed = ATOMIC_INIT(0);

    {
        auto queue_thread = MakeQueueThread("wq_destroyed");

        for(int i = 0; i < RUN_COUNT; ++i)
            queue_thread->Run([&] {
                atomic_inc(&completed);
            });
    }

    zassert_equal(atomic_get(&completed), RUN_COUNT);
    zassert_false(ThreadExists("wq_destroyed"), "the queue thread outlived its owner");
}

ZTEST(work_queue_thread, test_Stop_releases_the_runner_task_state) {
    auto queue_thread = MakeQueueThread("wq_released");

    const auto tracker = std::make_shared<int>(0);
    k_sem done{};
    k_sem_init(&done, 0, K_SEM_MAX_LIMIT);

    queue_thread->Run([tracker, &done] {
        k_sem_give(&done);
    });

    zassert_equal(k_sem_take(&done, K_MSEC(SYNC_TIMEOUT_MS)), 0);

    queue_thread->Stop();

    zassert_equal(tracker.use_count(), 1);
}

ZTEST(work_queue_thread, test_a_stopped_queue_rejects_new_work) {
    auto queue_thread = MakeQueueThread("wq_stopped");

    queue_thread->Stop();

    zassert_true(ThrowsRuntimeError([&] {
        (void)queue_thread->GetWorkQueue();
    }));
    zassert_true(ThrowsRuntimeError([&] {
        queue_thread->Run([] {});
    }));
    zassert_false(ThreadExists("wq_stopped"));
}

ZTEST(work_queue_thread, test_IsCurrentThread_is_false_before_the_queue_starts) {
    WorkQueueThread queue_thread("wq_current_unstarted", STACK_SIZE, PRIORITY);

    zassert_false(queue_thread.IsCurrentThread());
}

ZTEST(work_queue_thread, test_IsCurrentThread_tells_the_queue_thread_apart_from_its_callers) {
    auto queue_thread = MakeQueueThread("wq_current");
    auto other_thread = MakeQueueThread("wq_current_other");

    bool observed_own = false;
    bool observed_other = false;
    k_sem done{};
    k_sem_init(&done, 0, K_SEM_MAX_LIMIT);

    queue_thread->Run([&] {
        observed_own = queue_thread->IsCurrentThread();
        observed_other = other_thread->IsCurrentThread();
        k_sem_give(&done);
    });

    zassert_equal(k_sem_take(&done, K_MSEC(SYNC_TIMEOUT_MS)), 0);
    zassert_true(observed_own, "the queue thread did not recognise itself");
    zassert_false(observed_other, "a second queue was mistaken for the running one");
    zassert_false(queue_thread->IsCurrentThread(), "the calling thread was mistaken for the queue thread");

    other_thread->Stop();
    queue_thread->Stop();
}

ZTEST(work_queue_thread, test_IsCurrentThread_holds_inside_a_created_task) {
    auto queue_thread = MakeQueueThread("wq_current_task");

    struct Observation {
        WorkQueueThread* queue_thread;
        bool is_queue_thread;
        k_sem done;
    } observation{ queue_thread.get(), false, {} };

    k_sem_init(&observation.done, 0, K_SEM_MAX_LIMIT);

    auto task = queue_thread->CreateTask(
        +[](Observation* state) {
            state->is_queue_thread = state->queue_thread->IsCurrentThread();
            k_sem_give(&state->done);

            return WorkQueueTaskResult{ .reschedule = false };
        },
        &observation
    );

    task.Schedule();

    zassert_equal(k_sem_take(&observation.done, K_MSEC(SYNC_TIMEOUT_MS)), 0);
    zassert_true(observation.is_queue_thread);

    queue_thread->Stop();
}

ZTEST(work_queue_thread, test_IsCurrentThread_is_false_once_the_queue_stops) {
    auto queue_thread = MakeQueueThread("wq_current_stopped");

    queue_thread->Stop();

    zassert_false(queue_thread->IsCurrentThread());
}

ZTEST(work_queue_thread, test_IsScheduled_only_reports_work_that_still_has_to_run) {
    auto queue_thread = MakeQueueThread("wq_scheduled");

    TaskProbe probe;
    auto task = queue_thread->CreateTask(ProbeHandler, &probe);

    zassert_false(task.IsScheduled());

    task.Schedule(K_SECONDS(30));
    zassert_true(task.IsScheduled());

    task.Cancel();
    zassert_false(task.IsScheduled());

    task.Schedule();

    // The probe is signalled from inside the handler, so the item is running but not scheduled.
    zassert_true(probe.WaitForRun(SYNC_TIMEOUT_MS));
    zassert_false(task.IsScheduled());

    queue_thread->Stop();
}

ZTEST(work_queue_thread, test_queues_are_independent_of_each_other) {
    auto first_queue = MakeQueueThread("wq_first");
    auto second_queue = MakeQueueThread("wq_second");

    zassert_true(first_queue->GetWorkQueue() != second_queue->GetWorkQueue());
    zassert_true(first_queue->GetWorkQueue()->thread_id != second_queue->GetWorkQueue()->thread_id);

    TaskProbe first_probe;
    TaskProbe second_probe;

    auto first_task = first_queue->CreateTask(ProbeHandler, &first_probe);
    auto second_task = second_queue->CreateTask(ProbeHandler, &second_probe);

    first_task.Schedule();

    zassert_true(first_probe.WaitForRun(SYNC_TIMEOUT_MS));
    zassert_equal(second_probe.Runs(), 0);

    second_task.Schedule();

    zassert_true(second_probe.WaitForRun(SYNC_TIMEOUT_MS));
    zassert_equal(first_probe.Runs(), 1);

    first_queue->Stop();
    second_queue->Stop();
}
```
