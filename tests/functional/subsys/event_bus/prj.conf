## CMakeLists.txt
```
cmake_minimum_required(VERSION 3.20.0)

include(${CMAKE_CURRENT_SOURCE_DIR}/../../../rt_core_test.cmake)

find_package(Zephyr REQUIRED HINTS $ENV{ZEPHYR_BASE})
project(functional_subsys_event_bus)

file(GLOB_RECURSE TEST_SOURCES src/*.c src/*.cpp)

target_sources(app PRIVATE ${TEST_SOURCES})
```

## prj.conf
```kconfig
CONFIG_ZTEST=y

# Language and Compiler
CONFIG_CPP=y
CONFIG_PICOLIBC=y
CONFIG_STD_CPP2B=y
CONFIG_REQUIRES_FULL_LIBCPP=y
CONFIG_CPP_EXCEPTIONS=y
CONFIG_CPP_RTTI=y

# Memory
CONFIG_HEAP_MEM_POOL_SIZE=200000

# C++ exception unwinding needs considerably more stack than the ztest defaults.
CONFIG_MAIN_STACK_SIZE=8192
CONFIG_ZTEST_STACK_SIZE=8192

# Logging And Debugging
CONFIG_LOG=y
CONFIG_TEST_RANDOM_GENERATOR=y
CONFIG_THREAD_NAME=y
CONFIG_THREAD_MONITOR=y

# ThreadBase::InitializeStack() falls back to k_thread_stack_alloc().
CONFIG_THREAD_STACK_INFO=y
CONFIG_DYNAMIC_THREAD=y
CONFIG_DYNAMIC_THREAD_ALLOC=y

CONFIG_EERIE_LEAP_RT_CORE=y
CONFIG_EERIE_LEAP_EVENT_BUS=y
```

## src/allocation_free_publish.cpp
```c
// A numeric payload travels from PublishAsync() through the queue to the subscriber without a
// single heap allocation: the payload is inline, the queue is a ring sized once, and dispatch
// snapshots the subscribers into an inline buffer.
#include <cstddef>
#include <cstdint>
#include <cstdlib>
#include <new>
#include <string>
#include <variant>

#include <zephyr/ztest.h>

#include "subsys/event_bus/event_channel.h"
#include "subsys/event_bus/i_event_bus.h"

using eerie_leap::subsys::event_bus::AnySubscription;
using eerie_leap::subsys::event_bus::CreateScopedSubscription;
using eerie_leap::subsys::event_bus::Event;
using eerie_leap::subsys::event_bus::EventChannel;
using eerie_leap::subsys::event_bus::EventPayload;
using eerie_leap::subsys::event_bus::IEventBus;
using eerie_leap::subsys::event_bus::MAX_PAYLOAD_ENTRIES;

// Replaces the global allocation functions for this test binary so every allocation is counted.
namespace {

size_t g_allocations = 0;

// NOLINTBEGIN(cppcoreguidelines-no-malloc): the replacement allocation functions wrap malloc and free
void* CountedAllocate(size_t size) {
    g_allocations++;

    void* pointer = std::malloc(size == 0 ? 1 : size);
    if(pointer == nullptr)
        throw std::bad_alloc();

    return pointer;
}

} // namespace

void* operator new(size_t size) {
    return CountedAllocate(size);
}
void* operator new[](size_t size) {
    return CountedAllocate(size);
}
void* operator new(size_t size, const std::nothrow_t&) noexcept {
    g_allocations++;
    return std::malloc(size == 0 ? 1 : size);
}
void* operator new[](size_t size, const std::nothrow_t&) noexcept {
    g_allocations++;
    return std::malloc(size == 0 ? 1 : size);
}
void operator delete(void* pointer) noexcept {
    std::free(pointer);
}
void operator delete[](void* pointer) noexcept {
    std::free(pointer);
}
void operator delete(void* pointer, size_t) noexcept {
    std::free(pointer);
}
void operator delete[](void* pointer, size_t) noexcept {
    std::free(pointer);
}
// NOLINTEND(cppcoreguidelines-no-malloc)

namespace {

enum class ProbeEventType : uint32_t {
    DataUpdated = 0
};
enum class ProbePayloadType : uint32_t {
    SensorId = 0,
    Value = 1
};

using ProbeEvent = Event<ProbeEventType, ProbePayloadType>;

class ProbeChannel : public EventChannel<ProbeEventType, ProbePayloadType> {
public:
    explicit ProbeChannel(size_t capacity) :
        EventChannel("probe", ProbeEventType::DataUpdated, ProbePayloadType::Value, capacity) {}
};

class ManualBus : public IEventBus {
public:
    void Wake() override {}
};

} // namespace

ZTEST_SUITE(allocation_free_publish, NULL, NULL, NULL, NULL, NULL);

ZTEST(allocation_free_publish, test_publish_queue_and_dispatch_do_not_allocate) {
    ProbeChannel channel(8);
    ManualBus bus;
    channel.OnRegistered(&bus);

    uint32_t last_id = 0;
    float last_value = 0.0F;
    size_t delivered = 0;

    AnySubscription subscription = CreateScopedSubscription(
        channel, ProbeEventType::DataUpdated, [&](const ProbeEvent& event) {
            if(const auto* it = event.payload.find(ProbePayloadType::SensorId); it != event.payload.end())
                last_id = std::get<uint32_t>(it->second);
            if(const auto* it = event.payload.find(ProbePayloadType::Value); it != event.payload.end())
                last_value = std::get<float>(it->second);

            delivered++;
        }
    );

    // Warm up: nothing should allocate even on the first pass, but the comparison is what counts.
    channel.PublishAsync(
        { .source_id = 1,
            .type = ProbeEventType::DataUpdated,
            .payload = { { ProbePayloadType::SensorId, uint32_t{ 7 } }, { ProbePayloadType::Value, 1.0F } } }
    );
    zassert_true(channel.DrainOne());

    const size_t before = g_allocations;

    for(uint32_t i = 0; i < 100; i++) {
        channel.PublishAsync(
            { .source_id = 1,
                .type = ProbeEventType::DataUpdated,
                .payload = {
                    { ProbePayloadType::SensorId, 100 + i }, { ProbePayloadType::Value, static_cast<float>(i) } } }
        );
        zassert_true(channel.DrainOne());
    }

    zassert_equal(
        g_allocations - before, 0U, "%zu allocations across 100 publish/drain cycles", g_allocations - before
    );
    zassert_equal(delivered, 101U);
    zassert_equal(last_id, 199U);
    zassert_equal(last_value, 99.0F);
}

ZTEST(allocation_free_publish, test_a_full_ring_sheds_the_oldest_without_allocating) {
    ProbeChannel channel(4);
    ManualBus bus;
    channel.OnRegistered(&bus);

    std::vector<uint32_t> seen;
    seen.reserve(16);
    AnySubscription subscription = CreateScopedSubscription(
        channel, ProbeEventType::DataUpdated, [&](const ProbeEvent& event) {
            seen.push_back(std::get<uint32_t>(event.payload.at(ProbePayloadType::SensorId)));
        }
    );

    const size_t before = g_allocations;

    for(uint32_t i = 0; i < 6; i++) {
        channel.PublishAsync(
            { .source_id = i, .type = ProbeEventType::DataUpdated, .payload = { { ProbePayloadType::SensorId, i } } }
        );
    }

    while(channel.DrainOne()) {
    }

    zassert_equal(g_allocations - before, 0U);
    zassert_equal(seen.size(), 4U, "Four slots: two oldest were shed");
    zassert_equal(seen[0], 2U);
    zassert_equal(seen[3], 5U);
}

ZTEST(allocation_free_publish, test_inline_payload_keeps_map_semantics) {
    EventPayload<ProbePayloadType> payload;

    zassert_true(payload.empty());
    payload[ProbePayloadType::Value] = 1.5F;
    payload[ProbePayloadType::Value] = 2.5F;
    zassert_equal(payload.size(), 1U, "operator[] replaces");
    zassert_equal(std::get<float>(payload.at(ProbePayloadType::Value)), 2.5F);

    auto [it, inserted] = payload.emplace(ProbePayloadType::Value, 9);
    zassert_false(inserted, "emplace keeps an existing entry");
    zassert_true(std::holds_alternative<float>(it->second));

    zassert_true(payload.emplace(ProbePayloadType::SensorId, uint32_t{ 3 }).second);
    zassert_equal(payload.size(), 2U);
    zassert_true(payload.contains(ProbePayloadType::SensorId));
    zassert_equal(payload.erase(ProbePayloadType::Value), 1U);
    zassert_equal(payload.size(), 1U);
    zassert_false(payload.contains(ProbePayloadType::Value));
    zassert_equal(std::get<uint32_t>(payload.begin()->second), 3U, "The remaining entry moved up");

    zassert_equal(MAX_PAYLOAD_ENTRIES, 6U);
}
```

## src/binding_test_channels.h
```c
#pragma once

#include <cstddef>
#include <cstdint>
#include <span>
#include <string>
#include <utility>

#include <zephyr/ztest.h>

#include "subsys/event_bus/erased_payload_view.h"
#include "subsys/event_bus/event.h"
#include "subsys/event_bus/event_bus.h"
#include "subsys/event_bus/event_channel.h"
#include "subsys/event_bus/event_channel_id.h"
#include "subsys/event_bus/event_channel_registry.h"

// Shared by the registry, binding and dispatch guard suites, which all resolve through the one
// EventChannelRegistry of this binary: Sensors -> primary, Logging -> secondary. Navigation and
// Settings are never registered here; the null cases rely on that.
//
// Everything below has external linkage on purpose (a named namespace, inline functions), so the
// three translation units share one fixture. A copy per unit would find Sensors already held by
// another unit's channel, and its publishes would never reach a subscription made through the
// registry.
namespace event_binding_tests {

using eerie_leap::subsys::event_bus::AnySubscription;
using eerie_leap::subsys::event_bus::ErasedEventFilter;
using eerie_leap::subsys::event_bus::ErasedEventHandler;
using eerie_leap::subsys::event_bus::ErasedPayloadView;
using eerie_leap::subsys::event_bus::EventBus;
using eerie_leap::subsys::event_bus::EventChannel;
using eerie_leap::subsys::event_bus::EventChannelId;
using eerie_leap::subsys::event_bus::EventChannelRegistry;
using eerie_leap::subsys::event_bus::EventData;

enum class BindingEventType : uint32_t {
    Updated = 0,
    Other = 1
};

enum class BindingPayloadType : uint32_t {
    Id = 0,
    Value = 1,
    Flag = 2
};

inline constexpr int BINDING_BUS_STACK_SIZE = 8192;
inline constexpr uint32_t BINDING_TEST_SOURCE = 0xB1D0;

class BindingTestChannel : public EventChannel<BindingEventType, BindingPayloadType> {
public:
    explicit BindingTestChannel(std::string name) :
        EventChannel(std::move(name), BindingEventType::Other, BindingPayloadType::Flag) {}
};

// Records what SubscribeEventBinding() hands the channel, so a test can evaluate the filter itself,
// and can refuse the next subscription the way a failed allocation would.
class RecordingChannel : public BindingTestChannel {
public:
    bool refuse_next = false;
    bool last_had_filter = false;
    ErasedEventFilter last_filter;

    explicit RecordingChannel(std::string name) :
        BindingTestChannel(std::move(name)) {}

    AnySubscription
    SubscribeErased(uint32_t event_type, ErasedEventFilter filter, ErasedEventHandler handler) override {

        last_had_filter = static_cast<bool>(filter);
        last_filter = filter;

        if(std::exchange(refuse_next, false))
            return nullptr;

        return BindingTestChannel::SubscribeErased(event_type, std::move(filter), std::move(handler));
    }
};

class BindingTestEventBus : public EventBus {
public:
    BindingTestEventBus() :
        EventBus("binding_test_bus", BINDING_BUS_STACK_SIZE) {}
};

// Declaration order matters: the bus is destroyed first, so ~EventBus detaches channels that are
// still alive.
struct BindingTestChannels {
    RecordingChannel primary{ "binding_primary" };
    BindingTestChannel secondary{ "binding_secondary" };
    BindingTestEventBus bus;

    // The first failed registration; a second fixture would see -EEXIST here.
    int registration = 0;

    BindingTestChannels() {
        bus.RegisterChannel(primary);
        bus.RegisterChannel(secondary);

        auto& registry = EventChannelRegistry::GetInstance();

        registration = registry.Register(EventChannelId::Sensors, primary);
        if(registration == 0)
            registration = registry.Register(EventChannelId::Logging, secondary);
    }
};

inline BindingTestChannels& RegisterBindingTestChannels() {
    static BindingTestChannels channels;

    return channels;
}

// Suite setup: fails the suite when the fixture is not the one the registry resolves to.
inline void* SetUpBindingTestChannels() {
    auto& channels = RegisterBindingTestChannels();

    zassert_ok(channels.registration, "The binding test channels could not be registered.");
    zassert_equal(EventChannelRegistry::GetInstance().Find(EventChannelId::Sensors), &channels.primary);

    return &channels;
}

// Before each case, so a refusal a failed case left armed cannot refuse a later subscription.
inline void ResetBindingTestChannels(void*) {
    RegisterBindingTestChannels().primary.refuse_next = false;
}

// A payload a test builds by hand, to evaluate a recorded filter directly.
class FakeView : public ErasedPayloadView {
private:
    std::span<const std::pair<uint32_t, EventData>> entries_;

public:
    explicit FakeView(std::span<const std::pair<uint32_t, EventData>> entries) :
        entries_(entries) {}

    const EventData* Find(uint32_t key) const override {
        for(const auto& [entry_key, value] : entries_) {
            if(entry_key == key)
                return &value;
        }

        return nullptr;
    }
};

// Dispatches on the calling thread, so a test needs no waits.
inline void PublishSync(BindingTestChannel& channel, BindingEventType type, BindingTestChannel::PayloadMap payload) {

    channel.Publish({ .source_id = BINDING_TEST_SOURCE, .type = type, .payload = std::move(payload) });
}

} // namespace event_binding_tests
```

## src/dispatch_guard.cpp
```c
#include <atomic>
#include <cstdint>
#include <memory>
#include <utility>

#include <zephyr/kernel.h>
#include <zephyr/ztest.h>

#include "subsys/event_bus/dispatch_guard.h"
#include "subsys/event_bus/event_binding.h"
#include "subsys/event_bus/event_binding_subscription.h"
#include "subsys/event_bus/event_channel_id.h"

#include "binding_test_channels.h"

using eerie_leap::subsys::event_bus::AnySubscription;
using eerie_leap::subsys::event_bus::DispatchGuard;
using eerie_leap::subsys::event_bus::EventBinding;
using eerie_leap::subsys::event_bus::EventChannelId;
using eerie_leap::subsys::event_bus::EventData;
using eerie_leap::subsys::event_bus::SubscribeEventBinding;

using event_binding_tests::BindingEventType;
using event_binding_tests::BindingPayloadType;
using event_binding_tests::PublishSync;
using event_binding_tests::RegisterBindingTestChannels;
using event_binding_tests::ResetBindingTestChannels;
using event_binding_tests::SetUpBindingTestChannels;

namespace {

constexpr int HELPER_PRIORITY = 5;

K_THREAD_STACK_DEFINE(dispatch_helper_stack, 4096);
k_thread dispatch_helper;

// Owned jointly by the test and the helper thread, so a failed assertion, which aborts the test
// thread without unwinding, never leaves the helper writing to a dead stack frame.
struct DetachRace {
    int owner = 0;
    DispatchGuard guard{ &owner };
    k_sem entered{};
    std::atomic<bool> finished{ false };

    DetachRace() {
        k_sem_init(&entered, 0, 1);
    }
};

void DispatchSlowly(void* race_holder, void*, void*) {
    const std::unique_ptr<std::shared_ptr<DetachRace>> holder(static_cast<std::shared_ptr<DetachRace>*>(race_holder));
    auto& race = **holder;

    race.guard.Dispatch([&race] {
        k_sem_give(&race.entered);
        k_msleep(20);
        race.finished.store(true);
    });
}

// Shared by both handlers instead of captured by reference, so a failed assertion, which aborts the
// test thread without unwinding, leaves no subscription on the shared channel pointing into a dead
// stack frame.
struct RemovalRace {
    int owner_b = 0;
    int a_calls = 0;
    int b_handler_calls = 0;
    int b_body_calls = 0;
    AnySubscription subscription_b;
};

EventBinding ValueBinding() {
    return EventBinding{ .channel = EventChannelId::Sensors,
        .event_type = std::to_underlying(BindingEventType::Updated),
        .payload_key = std::to_underlying(BindingPayloadType::Value) };
}

} // namespace

ZTEST_SUITE(dispatch_guard, NULL, SetUpBindingTestChannels, ResetBindingTestChannels, NULL, NULL);

ZTEST(dispatch_guard, test_Dispatch_runs_the_body_while_attached) {
    int owner = 0;
    DispatchGuard guard(&owner);
    int runs = 0;

    guard.Dispatch([&runs] {
        ++runs;
    });

    zassert_equal(runs, 1);
}

ZTEST(dispatch_guard, test_Dispatch_is_a_no_op_after_Detach) {
    int owner = 0;
    DispatchGuard guard(&owner);
    int runs = 0;

    guard.Detach();
    guard.Dispatch([&runs] {
        ++runs;
    });

    zassert_equal(runs, 0);
}

ZTEST(dispatch_guard, test_Detach_can_be_repeated) {
    int owner = 0;
    DispatchGuard guard(&owner);
    int runs = 0;

    guard.Detach();
    guard.Detach();
    guard.Dispatch([&runs] {
        ++runs;
    });

    zassert_equal(runs, 0);
}

// The helper holds the guard's lock from before it signals until its body returns, so Detach()
// can only return after the body, whatever the scheduler does in between.
ZTEST(dispatch_guard, test_Detach_waits_for_an_in_flight_dispatch) {
    const auto race = std::make_shared<DetachRace>();

    k_thread_create(
        &dispatch_helper, dispatch_helper_stack, K_THREAD_STACK_SIZEOF(dispatch_helper_stack), DispatchSlowly,
        new std::shared_ptr<DetachRace>(race), nullptr, nullptr, HELPER_PRIORITY, 0, K_NO_WAIT
    );

    zassert_ok(k_sem_take(&race->entered, K_SECONDS(1)));

    race->guard.Detach();

    // Taken before the join and asserted after it, so a failure leaves no thread behind.
    const bool finished_at_detach = race->finished.load();

    zassert_ok(k_thread_join(&dispatch_helper, K_SECONDS(1)));
    zassert_true(finished_at_detach, "Detach() returned while a dispatch was still running.");

    int runs = 0;
    race->guard.Dispatch([&runs] {
        ++runs;
    });
    zassert_equal(runs, 0);
}

// The race the guard exists for: a dispatch already snapshotted still calls a handler whose owner
// has gone, and only the guard turns that call into a no-op.
ZTEST(dispatch_guard, test_a_guarded_handler_removed_during_dispatch_does_nothing) {
    auto& channels = RegisterBindingTestChannels();

    auto race = std::make_shared<RemovalRace>();
    const auto guard_b = std::make_shared<DispatchGuard>(&race->owner_b);

    const auto subscription_a = SubscribeEventBinding(ValueBinding(), [race, guard_b](const EventData&) {
        ++race->a_calls;

        // B's owner tears down the way a widget does: detach first, then drop the subscription.
        guard_b->Detach();
        race->subscription_b.reset();
    });
    zassert_not_null(subscription_a.get());

    race->subscription_b = SubscribeEventBinding(ValueBinding(), [race, guard = guard_b](const EventData&) {
        ++race->b_handler_calls;

        guard->Dispatch([&race] {
            ++race->b_body_calls;
        });
    });
    zassert_not_null(race->subscription_b.get());

    PublishSync(channels.primary, BindingEventType::Updated, { { BindingPayloadType::Value, 1.0F } });

    zassert_equal(race->a_calls, 1);
    zassert_equal(race->b_handler_calls, 1, "The snapshot no longer delivers to a subscriber removed during dispatch.");
    zassert_equal(race->b_body_calls, 0);
    zassert_is_null(race->subscription_b.get());

    PublishSync(channels.primary, BindingEventType::Updated, { { BindingPayloadType::Value, 2.0F } });

    zassert_equal(race->a_calls, 2);
    zassert_equal(race->b_handler_calls, 1);
    zassert_equal(race->b_body_calls, 0);
}
```

## src/event_binding_subscription.cpp
```c
#include <array>
#include <cstdint>
#include <memory>
#include <memory_resource>
#include <optional>
#include <string>
#include <utility>
#include <variant>

#include <zephyr/kernel.h>
#include <zephyr/ztest.h>

#include "utilities/string/string_helpers.h"

#include "subsys/event_bus/event_binding.h"
#include "subsys/event_bus/event_binding_subscription.h"
#include "subsys/event_bus/event_channel_id.h"

#include "binding_test_channels.h"

using eerie_leap::subsys::event_bus::AnySubscription;
using eerie_leap::subsys::event_bus::EventBinding;
using eerie_leap::subsys::event_bus::EventBindingHandler;
using eerie_leap::subsys::event_bus::EventChannelId;
using eerie_leap::subsys::event_bus::EventData;
using eerie_leap::subsys::event_bus::SubscribeEventBinding;
using eerie_leap::utilities::string::StringHelpers;
using eerie_leap::utilities::type::ConfigValue;

using event_binding_tests::BINDING_TEST_SOURCE;
using event_binding_tests::BindingEventType;
using event_binding_tests::BindingPayloadType;
using event_binding_tests::FakeView;
using event_binding_tests::PublishSync;
using event_binding_tests::RegisterBindingTestChannels;
using event_binding_tests::ResetBindingTestChannels;
using event_binding_tests::SetUpBindingTestChannels;

namespace {

constexpr int K_DISPATCH_TIMEOUT_MS = 1000;

std::string CurrentThreadName() {
    const char* name = k_thread_name_get(k_current_get());

    return name != nullptr ? std::string(name) : std::string();
}

// The handler shares the probe's state instead of pointing at the probe. Three suites share the
// channel, and a failed assertion aborts the test thread without unwinding, so a subscription it
// leaves behind must not reach into a dead stack frame.
class HandlerProbe {
private:
    struct State {
        int calls = 0;
        std::optional<EventData> last_value;
        std::string thread_name;
        k_sem delivered{};
    };

    std::shared_ptr<State> state_ = std::make_shared<State>();

public:
    HandlerProbe() {
        k_sem_init(&state_->delivered, 0, K_SEM_MAX_LIMIT);
    }

    EventBindingHandler Handler() const {
        return [state = state_](const EventData& value) {
            ++state->calls;
            state->last_value = value;
            state->thread_name = CurrentThreadName();

            k_sem_give(&state->delivered);
        };
    }

    int Calls() const {
        return state_->calls;
    }
    const std::optional<EventData>& LastValue() const {
        return state_->last_value;
    }
    const std::string& ThreadName() const {
        return state_->thread_name;
    }
    bool WaitForDelivery(k_timeout_t timeout) const {
        return k_sem_take(&state_->delivered, timeout) == 0;
    }
};

// Updated/Value on the channel registered as Sensors, unless a test says otherwise.
EventBinding ValueBinding() {
    return EventBinding{ .channel = EventChannelId::Sensors,
        .event_type = std::to_underlying(BindingEventType::Updated),
        .payload_key = std::to_underlying(BindingPayloadType::Value) };
}

EventBinding SelectedBinding(BindingPayloadType selector_key, ConfigValue selector_value) {
    auto binding = ValueBinding();
    binding.selector_key = std::to_underlying(selector_key);
    binding.selector_value = std::move(selector_value);

    return binding;
}

void PublishValue(BindingPayloadType selector_key, EventData selector, float value = 1.0F) {
    PublishSync(
        RegisterBindingTestChannels().primary, BindingEventType::Updated,
        { { selector_key, std::move(selector) }, { BindingPayloadType::Value, value } }
    );
}

} // namespace

ZTEST_SUITE(event_binding_subscription, NULL, SetUpBindingTestChannels, ResetBindingTestChannels, NULL, NULL);

ZTEST(event_binding_subscription, test_a_binding_to_None_does_not_subscribe) {
    const HandlerProbe probe;
    auto binding = ValueBinding();
    binding.channel = EventChannelId::None;

    zassert_is_null(SubscribeEventBinding(binding, probe.Handler()).get());
}

ZTEST(event_binding_subscription, test_a_binding_to_an_unregistered_channel_does_not_subscribe) {
    const HandlerProbe probe;
    auto binding = ValueBinding();

    binding.channel = EventChannelId::Navigation;
    zassert_is_null(SubscribeEventBinding(binding, probe.Handler()).get());

    binding.channel = static_cast<EventChannelId>(99);
    zassert_is_null(SubscribeEventBinding(binding, probe.Handler()).get());
}

// Unfiltered, it would take every sensor's value.
ZTEST(event_binding_subscription, test_a_selector_that_cannot_select_does_not_subscribe) {
    const HandlerProbe probe;
    const auto subscription = SubscribeEventBinding(SelectedBinding(BindingPayloadType::Id, 1.5), probe.Handler());

    zassert_is_null(subscription.get());

    PublishValue(BindingPayloadType::Id, uint32_t{ 1 });

    zassert_equal(probe.Calls(), 0);
}

ZTEST(event_binding_subscription, test_an_empty_handler_does_not_subscribe) {
    zassert_is_null(SubscribeEventBinding(ValueBinding(), EventBindingHandler{}).get());
}

ZTEST(event_binding_subscription, test_a_refused_subscription_is_null) {
    auto& channels = RegisterBindingTestChannels();
    const HandlerProbe probe;

    channels.primary.refuse_next = true;
    const auto subscription = SubscribeEventBinding(ValueBinding(), probe.Handler());

    zassert_is_null(subscription.get());
    zassert_false(channels.primary.refuse_next, "The null did not come from the channel's refusal.");

    PublishValue(BindingPayloadType::Id, uint32_t{ 1 });

    zassert_equal(probe.Calls(), 0);
}

ZTEST(event_binding_subscription, test_the_bound_payload_value_reaches_the_handler) {
    const HandlerProbe probe;
    const auto subscription = SubscribeEventBinding(ValueBinding(), probe.Handler());
    zassert_not_null(subscription.get());

    PublishValue(BindingPayloadType::Id, uint32_t{ 1 }, 42.5F);

    zassert_equal(probe.Calls(), 1);
    zassert_true(probe.LastValue().has_value());
    zassert_equal(std::get<float>(*probe.LastValue()), 42.5F);
}

ZTEST(event_binding_subscription, test_an_event_without_the_payload_key_does_not_reach_the_handler) {
    const HandlerProbe probe;
    const auto subscription = SubscribeEventBinding(ValueBinding(), probe.Handler());
    zassert_not_null(subscription.get());

    PublishSync(
        RegisterBindingTestChannels().primary, BindingEventType::Updated, { { BindingPayloadType::Id, uint32_t{ 1 } } }
    );

    zassert_equal(probe.Calls(), 0);
}

ZTEST(event_binding_subscription, test_the_binding_honours_the_event_type) {
    auto& channels = RegisterBindingTestChannels();
    const HandlerProbe probe;
    const auto subscription = SubscribeEventBinding(ValueBinding(), probe.Handler());
    zassert_not_null(subscription.get());

    PublishSync(channels.primary, BindingEventType::Other, { { BindingPayloadType::Value, 1.0F } });
    zassert_equal(probe.Calls(), 0);

    PublishSync(channels.primary, BindingEventType::Updated, { { BindingPayloadType::Value, 1.0F } });
    zassert_equal(probe.Calls(), 1);
}

ZTEST(event_binding_subscription, test_a_text_selector_matches_the_hashed_id) {
    const HandlerProbe probe;
    const auto subscription = SubscribeEventBinding(
        SelectedBinding(BindingPayloadType::Id, std::pmr::string("left")), probe.Handler()
    );
    zassert_not_null(subscription.get());

    PublishValue(BindingPayloadType::Id, StringHelpers::GetHash("right"));
    zassert_equal(probe.Calls(), 0);

    PublishValue(BindingPayloadType::Id, StringHelpers::GetHash("left"));
    zassert_equal(probe.Calls(), 1);
}

ZTEST(event_binding_subscription, test_an_integer_selector_matches_an_int_or_uint32_id) {
    const HandlerProbe probe;
    const auto subscription = SubscribeEventBinding(SelectedBinding(BindingPayloadType::Id, 7), probe.Handler());
    zassert_not_null(subscription.get());

    PublishValue(BindingPayloadType::Id, 7);
    PublishValue(BindingPayloadType::Id, uint32_t{ 7 });
    PublishValue(BindingPayloadType::Id, 8);
    PublishValue(BindingPayloadType::Id, uint32_t{ 8 });

    zassert_equal(probe.Calls(), 2);
}

ZTEST(event_binding_subscription, test_a_bool_selector_matches_a_bool_entry) {
    const HandlerProbe probe;
    const auto subscription = SubscribeEventBinding(SelectedBinding(BindingPayloadType::Flag, true), probe.Handler());
    zassert_not_null(subscription.get());

    PublishValue(BindingPayloadType::Flag, false);
    zassert_equal(probe.Calls(), 0);

    PublishValue(BindingPayloadType::Flag, true);
    zassert_equal(probe.Calls(), 1);
}

// What puts the selector under the subscriber lock: the channel receives it as its filter.
ZTEST(event_binding_subscription, test_the_selector_is_the_channel_filter) {
    const auto& channels = RegisterBindingTestChannels();
    const HandlerProbe probe;

    const auto selected = SubscribeEventBinding(
        SelectedBinding(BindingPayloadType::Id, std::pmr::string("left")), probe.Handler()
    );
    zassert_not_null(selected.get());
    zassert_true(channels.primary.last_had_filter);

    const std::array<std::pair<uint32_t, EventData>, 1> left{ std::pair{
        std::to_underlying(BindingPayloadType::Id), EventData{ StringHelpers::GetHash("left") } } };
    const std::array<std::pair<uint32_t, EventData>, 1> right{ std::pair{
        std::to_underlying(BindingPayloadType::Id), EventData{ StringHelpers::GetHash("right") } } };
    const std::array<std::pair<uint32_t, EventData>, 1> without_id{ std::pair{
        std::to_underlying(BindingPayloadType::Value), EventData{ 1.0F } } };

    zassert_true(channels.primary.last_filter(FakeView(left)));
    zassert_false(channels.primary.last_filter(FakeView(right)));
    zassert_false(channels.primary.last_filter(FakeView(without_id)));

    const auto unconditional = SubscribeEventBinding(ValueBinding(), probe.Handler());
    zassert_not_null(unconditional.get());
    zassert_false(channels.primary.last_had_filter);
}

ZTEST(event_binding_subscription, test_destroying_the_subscription_unsubscribes) {
    const HandlerProbe removed;
    const HandlerProbe observer;

    auto subscription = SubscribeEventBinding(ValueBinding(), removed.Handler());
    zassert_not_null(subscription.get());

    PublishValue(BindingPayloadType::Id, uint32_t{ 1 });
    zassert_equal(removed.Calls(), 1);

    subscription.reset();

    const auto observing = SubscribeEventBinding(ValueBinding(), observer.Handler());
    zassert_not_null(observing.get());

    PublishValue(BindingPayloadType::Id, uint32_t{ 1 });

    zassert_equal(removed.Calls(), 1);
    zassert_equal(observer.Calls(), 1);
}

ZTEST(event_binding_subscription, test_an_async_publish_reaches_the_handler_on_the_bus_thread) {
    auto& channels = RegisterBindingTestChannels();
    const HandlerProbe probe;
    const auto subscription = SubscribeEventBinding(ValueBinding(), probe.Handler());
    zassert_not_null(subscription.get());

    channels.primary.PublishAsync(
        { .source_id = BINDING_TEST_SOURCE,
            .type = BindingEventType::Updated,
            .payload = { { BindingPayloadType::Value, 3.0F } } }
    );

    zassert_true(probe.WaitForDelivery(K_MSEC(K_DISPATCH_TIMEOUT_MS)));
    zassert_equal(probe.Calls(), 1);
    zassert_equal(std::get<float>(*probe.LastValue()), 3.0F);
    zassert_equal(probe.ThreadName(), std::string("binding_test_bus"));
}

ZTEST(event_binding_subscription, test_ChannelsKnowTheirLastEventTypeAndPayloadKey) {
    const auto& channel = RegisterBindingTestChannels().primary;

    zassert_true(channel.HasEventType(std::to_underlying(BindingEventType::Updated)));
    zassert_true(channel.HasEventType(std::to_underlying(BindingEventType::Other)), "The last value counts");
    zassert_false(channel.HasEventType(std::to_underlying(BindingEventType::Other) + 1));
    zassert_false(channel.HasEventType(0xFFFFFFFF));

    zassert_true(channel.HasPayloadKey(std::to_underlying(BindingPayloadType::Id)));
    zassert_true(channel.HasPayloadKey(std::to_underlying(BindingPayloadType::Flag)), "The last value counts");
    zassert_false(channel.HasPayloadKey(std::to_underlying(BindingPayloadType::Flag) + 1));
    zassert_false(channel.HasPayloadKey(0xFFFFFFFF));
}
```

## src/event_channel_registry.cpp
```c
#include <cerrno>

#include <zephyr/ztest.h>

#include "subsys/event_bus/event_channel_id.h"
#include "subsys/event_bus/event_channel_registry.h"

#include "binding_test_channels.h"

using eerie_leap::subsys::event_bus::EventChannelId;
using eerie_leap::subsys::event_bus::EventChannelRegistry;

using event_binding_tests::RegisterBindingTestChannels;
using event_binding_tests::ResetBindingTestChannels;
using event_binding_tests::SetUpBindingTestChannels;

// The registry is one per program, so no case may leave a registration another relies on: refused
// registrations change nothing by contract, and the only accepted one repeats an existing one.
ZTEST_SUITE(event_channel_registry, NULL, SetUpBindingTestChannels, ResetBindingTestChannels, NULL, NULL);

ZTEST(event_channel_registry, test_a_registered_channel_resolves) {
    auto& channels = RegisterBindingTestChannels();
    const auto& registry = EventChannelRegistry::GetInstance();

    zassert_equal(registry.Find(EventChannelId::Sensors), &channels.primary);
    zassert_equal(registry.Find(EventChannelId::Logging), &channels.secondary);
}

// A binding stored before its channel existed, or for another unit's channel, must be inert.
ZTEST(event_channel_registry, test_None_and_unregistered_or_unknown_ids_resolve_to_null) {
    const auto& registry = EventChannelRegistry::GetInstance();

    zassert_is_null(registry.Find(EventChannelId::None));
    zassert_is_null(registry.Find(EventChannelId::Navigation));
    zassert_is_null(registry.Find(static_cast<EventChannelId>(7)));
    zassert_is_null(registry.Find(static_cast<EventChannelId>(99)));
}

ZTEST(event_channel_registry, test_registering_the_same_channel_again_succeeds) {
    auto& channels = RegisterBindingTestChannels();
    auto& registry = EventChannelRegistry::GetInstance();

    zassert_ok(registry.Register(EventChannelId::Sensors, channels.primary));
    zassert_equal(registry.Find(EventChannelId::Sensors), &channels.primary);
}

ZTEST(event_channel_registry, test_a_taken_id_refuses_another_channel) {
    auto& channels = RegisterBindingTestChannels();
    auto& registry = EventChannelRegistry::GetInstance();

    zassert_equal(registry.Register(EventChannelId::Sensors, channels.secondary), -EEXIST);
    zassert_equal(registry.Find(EventChannelId::Sensors), &channels.primary);
}

// Only ids IsValidEventChannelId() names can be registered, not merely ids that fit the table.
ZTEST(event_channel_registry, test_None_and_unknown_ids_are_refused) {
    auto& channels = RegisterBindingTestChannels();
    auto& registry = EventChannelRegistry::GetInstance();

    zassert_equal(registry.Register(EventChannelId::None, channels.primary), -EINVAL);
    zassert_equal(registry.Register(static_cast<EventChannelId>(5), channels.primary), -EINVAL);
    zassert_equal(registry.Register(static_cast<EventChannelId>(8), channels.primary), -EINVAL);
    zassert_equal(registry.Register(static_cast<EventChannelId>(99), channels.primary), -EINVAL);

    zassert_is_null(registry.Find(EventChannelId::None));
    zassert_is_null(registry.Find(static_cast<EventChannelId>(5)));
}
```
