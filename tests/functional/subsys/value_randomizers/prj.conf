## CMakeLists.txt
```
cmake_minimum_required(VERSION 3.20.0)

include(${CMAKE_CURRENT_SOURCE_DIR}/../../../rt_core_test.cmake)

find_package(Zephyr REQUIRED HINTS $ENV{ZEPHYR_BASE})
project(functional_subsys_value_randomizers)

file(GLOB_RECURSE TEST_SOURCES src/*.c src/*.cpp)

target_sources(app PRIVATE ${TEST_SOURCES})
```

## prj.conf
```kconfig
CONFIG_ZTEST=y

# Language and Compiler
CONFIG_CPP=y
CONFIG_PICOLIBC=y
CONFIG_STD_CPP23=y
CONFIG_REQUIRES_FULL_LIBCPP=y
CONFIG_CPP_EXCEPTIONS=y
CONFIG_CPP_RTTI=y

# Memory
CONFIG_HEAP_MEM_POOL_SIZE=100000

# C++ exception unwinding needs considerably more stack than the ztest defaults.
CONFIG_MAIN_STACK_SIZE=8192
CONFIG_ZTEST_STACK_SIZE=8192
# Handlers run on the system work queue and a throwing one unwinds there.
CONFIG_SYSTEM_WORKQUEUE_STACK_SIZE=4096

# Logging And Debugging
CONFIG_LOG=y
CONFIG_THREAD_NAME=y
CONFIG_SYS_HEAP_RUNTIME_STATS=y

# Random Number Generator
CONFIG_TEST_RANDOM_GENERATOR=y
CONFIG_TIMER_RANDOM_GENERATOR=y

# Hardware: the factories read the device tree only under these.
CONFIG_ADC=y
CONFIG_GPIO=y

CONFIG_EERIE_LEAP_RT_CORE=y
CONFIG_EERIE_LEAP_ADC=y
CONFIG_EERIE_LEAP_GPIO=y

# The options under test, with values the assertions rely on.
CONFIG_EERIE_LEAP_ADC_RANDOMIZER=y
CONFIG_EERIE_LEAP_ADC_RANDOMIZER_CHANNELS=3
CONFIG_EERIE_LEAP_GPIO_RANDOMIZER=y
CONFIG_EERIE_LEAP_GPIO_RANDOMIZER_CHANNELS=5
CONFIG_EERIE_LEAP_GPIO_RANDOMIZER_HOLD_MIN_MS=10
CONFIG_EERIE_LEAP_GPIO_RANDOMIZER_HOLD_MAX_MS=30
```

## src/adc_randomizer.cpp
```c
#include <cerrno>

#include <zephyr/kernel.h>
#include <zephyr/ztest.h>

#include "subsys/adc/adc_randomizer.h"

using namespace eerie_leap::subsys::adc;

namespace {

AdcRandomizerConfig Config(int channels = 4) {
    return { .channel_count = channels,
        .volts_max = 3.0F,
        .move_min_ms = 100,
        .move_max_ms = 400,
        .hold_max_ms = 200,
        .seed = 17 };
}

} // namespace

ZTEST_SUITE(adc_randomizer, NULL, NULL, NULL, NULL, NULL);

ZTEST(adc_randomizer, test_reports_channels_and_capabilities) {
    AdcRandomizer adc(Config(6));

    zassert_true(adc.Initialize());
    zassert_equal(adc.GetChannelCount(), 6);

    const auto capabilities = adc.GetCapabilities();
    zassert_true(capabilities.burst);
    zassert_true(capabilities.multi_channel);
    zassert_equal(capabilities.us_per_conversion, 0U);
}

ZTEST(adc_randomizer, test_sample_returns_volts_in_range_that_move_over_time) {
    AdcRandomizer adc(Config());
    adc.Initialize();

    const uint8_t channels[4] = { 0, 1, 2, 3 };
    AdcSample results[4];
    const AdcSampleRequest request{ .channels = channels, .results = results, .samples = 8 };

    float first[4];
    int changed = 0;

    for(int round = 0; round < 40; round++) {
        adc.Sample(request);

        for(int i = 0; i < 4; i++) {
            zassert_equal(results[i].error, AdcError::NONE);
            zassert_equal(results[i].errno_value, 0);
            zassert_true(results[i].volts >= 0.0F && results[i].volts <= 3.0F);

            if(round == 0)
                first[i] = results[i].volts;
            else if(results[i].volts != first[i])
                changed++;
        }

        k_sleep(K_MSEC(50));
    }

    zassert_true(changed > 20, "%d", changed);
}

ZTEST(adc_randomizer, test_channels_are_not_copies_of_each_other) {
    AdcRandomizer adc(Config());
    adc.Initialize();

    const uint8_t channels[3] = { 0, 1, 2 };
    AdcSample results[3];
    const AdcSampleRequest request{ .channels = channels, .results = results, .samples = 1 };

    int different = 0;
    for(int round = 0; round < 20; round++) {
        adc.Sample(request);
        different += (results[0].volts != results[1].volts && results[1].volts != results[2].volts) ? 1 : 0;
        k_sleep(K_MSEC(100));
    }

    zassert_true(different > 10);
}

ZTEST(adc_randomizer, test_same_seed_starts_the_same_way) {
    AdcRandomizer a(Config());
    AdcRandomizer b(Config());

    const uint8_t channels[1] = { 2 };
    AdcSample ra[1];
    AdcSample rb[1];

    // Both read at the same simulated time on native_sim; only the first read is compared, which
    // is the initial voltage of the channel and does not depend on the clock.
    a.Sample({ .channels = channels, .results = ra, .samples = 1 });
    b.Sample({ .channels = channels, .results = rb, .samples = 1 });

    zassert_equal(ra[0].volts, rb[0].volts);
}

ZTEST(adc_randomizer, test_out_of_range_and_descending_channels_are_marked) {
    AdcRandomizer adc(Config(3));
    adc.Initialize();

    const uint8_t channels[5] = { 0, 3, 1, 1, 2 };
    AdcSample results[5];
    adc.Sample({ .channels = channels, .results = results, .samples = 1 });

    zassert_equal(results[0].error, AdcError::NONE);
    zassert_equal(results[1].error, AdcError::CHANNEL_OUT_OF_RANGE);
    zassert_equal(results[1].errno_value, -EINVAL);
    zassert_equal(results[1].volts, 0.0F);
    // After the rejected 3, 1 is still above the last accepted channel 0.
    zassert_equal(results[2].error, AdcError::NONE);
    // 1 again is not ascending.
    zassert_equal(results[3].error, AdcError::CHANNEL_OUT_OF_RANGE);
    zassert_equal(results[4].error, AdcError::NONE);
}

ZTEST(adc_randomizer, test_stats_count_like_the_simulator) {
    AdcRandomizer adc(Config(2));
    adc.Initialize();

    const uint8_t channels[3] = { 0, 1, 2 };
    AdcSample results[3];
    adc.Sample({ .channels = channels, .results = results, .samples = 1 });
    adc.Sample({ .channels = channels, .results = results, .samples = 50 });

    const auto stats = adc.GetStats();
    zassert_equal(stats.requests, 2U);
    zassert_equal(stats.conversions, 4U);
    zassert_equal(stats.errors, 2U);
    zassert_equal(stats.driver_calls, 0U);
    zassert_equal(stats.timeouts, 0U);
}

ZTEST(adc_randomizer, test_a_short_results_span_limits_the_request) {
    AdcRandomizer adc(Config());
    adc.Initialize();

    const uint8_t channels[3] = { 0, 1, 2 };
    AdcSample results[2];
    adc.Sample({ .channels = channels, .results = results, .samples = 1 });

    zassert_equal(adc.GetStats().conversions, 2U);
}

ZTEST(adc_randomizer, test_zero_channels_rejects_every_request) {
    AdcRandomizer adc(Config(0));
    adc.Initialize();

    const uint8_t channels[1] = { 0 };
    AdcSample results[1];
    adc.Sample({ .channels = channels, .results = results, .samples = 1 });

    zassert_equal(results[0].error, AdcError::CHANNEL_OUT_OF_RANGE);
}
```

## src/composite_gpio.cpp
```c
#include <atomic>
#include <memory>
#include <vector>

#include <zephyr/kernel.h>
#include <zephyr/ztest.h>

#include "subsys/gpio/composite_gpio.h"
#include "subsys/gpio/gpio_randomizer.h"

using namespace eerie_leap::subsys::gpio;

namespace {

// Reports a fixed channel count and a fixed Initialize() result; registrations hand out ids from 1,
// as every device does, so ids of different devices collide.
class StubGpio : public IGpio {
public:
    StubGpio(int channels, int initialize_result) :
        channels_(channels),
        initialize_result_(initialize_result) {}

    int Initialize() override {
        initialize_calls++;

        return initialize_result_;
    }
    bool ReadChannel(int channel) override {
        return channel == 1;
    }
    int GetChannelCount() override {
        return channels_;
    }
    int RegisterChannelChangedHandler(int channel, GpioEdge, GpioChannelHandler handler) override {
        registered_channel = channel;
        registered_handler = std::move(handler);

        return next_id_++;
    }
    bool RemoveChannelChangedHandler(int channel, int handler_id) override {
        removed_channel = channel;
        removed_id = handler_id;

        return true;
    }

    int initialize_calls = 0;
    int registered_channel = -1;
    GpioChannelHandler registered_handler;
    int removed_channel = -1;
    int removed_id = -1;

private:
    int channels_;
    int initialize_result_;
    int next_id_ = 1;
};

GpioRandomizerConfig Config(int channels, uint32_t seed) {
    return { .channel_count = channels, .hold_min_ms = 10, .hold_max_ms = 30, .seed = seed };
}

} // namespace

ZTEST_SUITE(composite_gpio, NULL, NULL, NULL, NULL, NULL);

ZTEST(composite_gpio, test_channels_are_concatenated_in_device_order) {
    auto first = std::make_shared<StubGpio>(3, 0);
    auto second = std::make_shared<StubGpio>(2, 0);
    CompositeGpio gpio({ first, second });

    zassert_equal(gpio.GetChannelCount(), 5);
    // StubGpio reads true on its local channel 1: global 1 (first) and 4 (second).
    zassert_false(gpio.ReadChannel(0));
    zassert_true(gpio.ReadChannel(1));
    zassert_false(gpio.ReadChannel(3));
    zassert_true(gpio.ReadChannel(4));
    zassert_false(gpio.ReadChannel(5));
    zassert_false(gpio.ReadChannel(-1));
}

ZTEST(composite_gpio, test_initialize_stops_at_the_first_failure) {
    auto first = std::make_shared<StubGpio>(1, -7);
    auto second = std::make_shared<StubGpio>(1, 0);
    CompositeGpio gpio({ first, second });

    zassert_equal(gpio.Initialize(), -7);
    zassert_equal(first->initialize_calls, 1);
    zassert_equal(second->initialize_calls, 0);
}

ZTEST(composite_gpio, test_initialize_initializes_every_device) {
    auto first = std::make_shared<StubGpio>(1, 0);
    auto second = std::make_shared<StubGpio>(1, 0);
    CompositeGpio gpio({ first, second });

    zassert_equal(gpio.Initialize(), 0);
    zassert_equal(first->initialize_calls, 1);
    zassert_equal(second->initialize_calls, 1);
}

ZTEST(composite_gpio, test_registration_goes_to_the_owning_device_with_a_local_channel) {
    auto first = std::make_shared<StubGpio>(3, 0);
    auto second = std::make_shared<StubGpio>(2, 0);
    CompositeGpio gpio({ first, second });

    int reported_channel = -1;
    bool reported_state = false;
    const int id = gpio.RegisterChannelChangedHandler(4, GpioEdge::BOTH, [&](int channel, bool state) {
        reported_channel = channel;
        reported_state = state;
    });

    zassert_true(id > 0);
    zassert_equal(first->registered_channel, -1);
    zassert_equal(second->registered_channel, 1);

    // The device calls back with its local channel; the handler hears the global one.
    second->registered_handler(1, true);
    zassert_equal(reported_channel, 4);
    zassert_true(reported_state);
}

ZTEST(composite_gpio, test_ids_are_unique_across_devices_and_removal_maps_back) {
    auto first = std::make_shared<StubGpio>(3, 0);
    auto second = std::make_shared<StubGpio>(2, 0);
    CompositeGpio gpio({ first, second });

    // Both devices hand out their id 1.
    const int id_a = gpio.RegisterChannelChangedHandler(0, GpioEdge::BOTH, [](int, bool) {});
    const int id_b = gpio.RegisterChannelChangedHandler(3, GpioEdge::BOTH, [](int, bool) {});

    zassert_true(id_a > 0 && id_b > 0 && id_a != id_b);

    zassert_false(gpio.RemoveChannelChangedHandler(0, id_b), "wrong channel");
    zassert_false(gpio.RemoveChannelChangedHandler(3, 0));
    zassert_false(gpio.RemoveChannelChangedHandler(9, id_b));

    zassert_true(gpio.RemoveChannelChangedHandler(3, id_b));
    zassert_equal(second->removed_channel, 0);
    zassert_equal(second->removed_id, 1);
    zassert_equal(first->removed_channel, -1);

    zassert_false(gpio.RemoveChannelChangedHandler(3, id_b), "already removed");

    zassert_true(gpio.RemoveChannelChangedHandler(0, id_a));
    zassert_equal(first->removed_channel, 0);
}

ZTEST(composite_gpio, test_invalid_registrations_are_rejected) {
    auto first = std::make_shared<StubGpio>(2, 0);
    CompositeGpio gpio({ first });

    zassert_equal(gpio.RegisterChannelChangedHandler(2, GpioEdge::BOTH, [](int, bool) {}), IGpio::ERR_INVALID_ARGUMENT);
    zassert_equal(
        gpio.RegisterChannelChangedHandler(-1, GpioEdge::BOTH, [](int, bool) {}), IGpio::ERR_INVALID_ARGUMENT
    );
    zassert_equal(gpio.RegisterChannelChangedHandler(0, GpioEdge::BOTH, nullptr), IGpio::ERR_INVALID_ARGUMENT);
}

ZTEST(composite_gpio, test_a_device_error_is_passed_through_and_not_recorded) {
    auto randomizer = std::make_shared<GpioRandomizer>(Config(2, 1));
    CompositeGpio gpio({ randomizer });

    // The randomizer is not initialized yet.
    zassert_equal(gpio.RegisterChannelChangedHandler(0, GpioEdge::BOTH, [](int, bool) {}), IGpio::ERR_NOT_INITIALIZED);
    zassert_false(gpio.RemoveChannelChangedHandler(0, 1));
}

ZTEST(composite_gpio, test_edges_of_two_randomizers_reach_handlers_with_global_channels) {
    auto first = std::make_shared<GpioRandomizer>(Config(2, 11));
    auto second = std::make_shared<GpioRandomizer>(Config(3, 12));
    CompositeGpio gpio({ first, second });
    zassert_equal(gpio.Initialize(), 0);

    std::atomic<int> low_calls = 0;
    std::atomic<int> high_calls = 0;
    std::atomic<int> wrong = 0;

    const int low_id = gpio.RegisterChannelChangedHandler(1, GpioEdge::BOTH, [&](int channel, bool) {
        wrong += channel == 1 ? 0 : 1;
        low_calls++;
    });
    const int high_id = gpio.RegisterChannelChangedHandler(4, GpioEdge::BOTH, [&](int channel, bool) {
        wrong += channel == 4 ? 0 : 1;
        high_calls++;
    });
    zassert_true(low_id > 0 && high_id > 0 && low_id != high_id);

    k_sleep(K_MSEC(800));

    zassert_true(gpio.RemoveChannelChangedHandler(1, low_id));
    zassert_true(gpio.RemoveChannelChangedHandler(4, high_id));

    zassert_true(low_calls > 5 && high_calls > 5);
    zassert_equal(wrong.load(), 0);

    const int low_after = low_calls;
    const int high_after = high_calls;
    k_sleep(K_MSEC(300));
    zassert_equal(low_calls.load(), low_after);
    zassert_equal(high_calls.load(), high_after);
}

ZTEST(composite_gpio, test_a_handler_may_remove_itself_during_its_call) {
    auto first = std::make_shared<GpioRandomizer>(Config(2, 11));
    CompositeGpio gpio({ first });
    zassert_equal(gpio.Initialize(), 0);

    std::atomic<int> calls = 0;
    int id = 0;

    id = gpio.RegisterChannelChangedHandler(1, GpioEdge::BOTH, [&](int, bool) {
        calls++;
        gpio.RemoveChannelChangedHandler(1, id);
    });
    zassert_true(id > 0);

    k_sleep(K_MSEC(300));

    zassert_equal(calls.load(), 1);
}
```

## src/factories.cpp
```c
#include <memory>
#include <optional>
#include <vector>

#include <zephyr/ztest.h>

#include "subsys/adc/adc.h"
#include "subsys/adc/adc_factory.hpp"
#include "subsys/adc/adc_randomizer.h"
#include "subsys/adc/adc_simulator.h"
#include "subsys/gpio/composite_gpio.h"
#include "subsys/gpio/gpio.h"
#include "subsys/gpio/gpio_factory.hpp"
#include "subsys/gpio/gpio_randomizer.h"
#include "subsys/gpio/gpio_simulator.h"

using namespace eerie_leap::subsys::adc;
using namespace eerie_leap::subsys::gpio;
using eerie_leap::subsys::device_tree::AdcDTInfo;

// prj.conf: 3 random ADC channels, 5 random GPIO channels with 10-30 ms holds.
namespace {

constexpr int RANDOM_ADC_CHANNELS = 3;
constexpr int RANDOM_GPIO_CHANNELS = 5;

std::optional<std::vector<AdcDTInfo>> no_dt_adcs;
std::optional<std::vector<gpio_dt_spec>> no_dt_gpio;

// Only the channel list matters: the factory constructs devices, it does not initialize them.
AdcDTInfo FakeAdc(size_t channels) {
    AdcDTInfo info{};
    info.channel_configs.resize(channels);

    return info;
}

} // namespace

ZTEST_SUITE(value_randomizer_factories, NULL, NULL, NULL, NULL, NULL);

ZTEST(value_randomizer_factories, test_adc_without_hardware_gets_the_randomizer_instead_of_the_simulator) {
    AdcFactory factory([] -> std::optional<std::vector<AdcDTInfo>>& {
        return no_dt_adcs;
    });
    const auto manager = factory.Create();

    zassert_equal(manager->GetAdcCount(), 1);
    zassert_not_null(dynamic_cast<AdcRandomizer*>(manager->GetAdcs()[0].get()));
    zassert_is_null(dynamic_cast<AdcSimulator*>(manager->GetAdcs()[0].get()));
    zassert_equal(manager->GetChannelCount(), RANDOM_ADC_CHANNELS);
    zassert_true(manager->Initialize());
}

ZTEST(value_randomizer_factories, test_adc_without_a_provider_gets_the_randomizer) {
    AdcFactory factory(nullptr);
    const auto manager = factory.Create();

    zassert_equal(manager->GetAdcCount(), 1);
    zassert_not_null(dynamic_cast<AdcRandomizer*>(manager->GetAdcs()[0].get()));
}

ZTEST(value_randomizer_factories, test_adc_randomizer_channels_follow_the_hardware_channels) {
    std::optional<std::vector<AdcDTInfo>> hardware = std::vector<AdcDTInfo>{ FakeAdc(2), FakeAdc(3) };
    AdcFactory factory([&] -> std::optional<std::vector<AdcDTInfo>>& {
        return hardware;
    });
    const auto manager = factory.Create();

    zassert_equal(manager->GetAdcCount(), 3);
    zassert_not_null(dynamic_cast<Adc*>(manager->GetAdcs()[0].get()));
    zassert_not_null(dynamic_cast<Adc*>(manager->GetAdcs()[1].get()));
    zassert_not_null(dynamic_cast<AdcRandomizer*>(manager->GetAdcs()[2].get()));
    zassert_equal(manager->GetChannelCount(), 2 + 3 + RANDOM_ADC_CHANNELS);

    // Hardware keeps 0..4; global 5.. is the randomizer's local 0...
    zassert_equal(manager->Resolve(4).adc, manager->GetAdcs()[1].get());
    zassert_equal(manager->Resolve(4).local_channel, 2);
    zassert_equal(manager->Resolve(5).adc, manager->GetAdcs()[2].get());
    zassert_equal(manager->Resolve(5).local_channel, 0);
    zassert_equal(manager->Resolve(7).local_channel, 2);
}

ZTEST(value_randomizer_factories, test_adc_randomizer_voltages_use_the_default_pin_range) {
    AdcFactory factory(nullptr);
    const auto manager = factory.Create();
    manager->Initialize();

    const uint8_t channels[RANDOM_ADC_CHANNELS] = { 0, 1, 2 };
    AdcSample results[RANDOM_ADC_CHANNELS];

    for(int i = 0; i < 50; i++) {
        manager->GetAdcs()[0]->Sample({ .channels = channels, .results = results, .samples = 1 });

        for(const auto& result : results) {
            zassert_equal(result.error, AdcError::NONE);
            zassert_true(result.volts >= 0.0F && result.volts <= 3.3F);
        }

        k_sleep(K_MSEC(100));
    }
}

ZTEST(value_randomizer_factories, test_gpio_without_hardware_is_the_randomizer_alone) {
    GpioFactory factory([] -> std::optional<std::vector<gpio_dt_spec>>& {
        return no_dt_gpio;
    });
    const auto gpio = factory.Create();

    zassert_not_null(dynamic_cast<GpioRandomizer*>(gpio.get()));
    zassert_is_null(dynamic_cast<GpioSimulator*>(gpio.get()));
    zassert_equal(gpio->GetChannelCount(), RANDOM_GPIO_CHANNELS);
    zassert_equal(gpio->Initialize(), 0);
}

ZTEST(value_randomizer_factories, test_gpio_without_a_provider_is_the_randomizer_alone) {
    GpioFactory factory(nullptr);
    const auto gpio = factory.Create();

    zassert_not_null(dynamic_cast<GpioRandomizer*>(gpio.get()));
}

ZTEST(value_randomizer_factories, test_gpio_with_hardware_is_a_composite_that_keeps_the_hardware_numbers) {
    std::optional<std::vector<gpio_dt_spec>> hardware = std::vector<gpio_dt_spec>{ {}, {} };
    GpioFactory factory([&] -> std::optional<std::vector<gpio_dt_spec>>& {
        return hardware;
    });
    const auto gpio = factory.Create();

    zassert_not_null(dynamic_cast<CompositeGpio*>(gpio.get()));
    zassert_equal(gpio->GetChannelCount(), 2 + RANDOM_GPIO_CHANNELS);
}
```

## src/gpio_randomizer.cpp
```c
#include <atomic>
#include <cstdlib>
#include <memory>
#include <stdexcept>
#include <vector>

#include <zephyr/kernel.h>
#include <zephyr/ztest.h>

#include "subsys/gpio/gpio_randomizer.h"

using namespace eerie_leap::subsys::gpio;

namespace {

GpioRandomizerConfig Config(int channels = 3) {
    return { .channel_count = channels, .hold_min_ms = 10, .hold_max_ms = 30, .seed = 5 };
}

std::unique_ptr<GpioRandomizer> MakeInitialized(int channels = 3) {
    auto gpio = std::make_unique<GpioRandomizer>(Config(channels));
    zassert_equal(gpio->Initialize(), 0);

    return gpio;
}

} // namespace

ZTEST_SUITE(gpio_randomizer, NULL, NULL, NULL, NULL, NULL);

ZTEST(gpio_randomizer, test_reports_the_channel_count) {
    GpioRandomizer gpio(Config(7));

    zassert_equal(gpio.GetChannelCount(), 7);
}

ZTEST(gpio_randomizer, test_read_invalid_channel_is_false_and_valid_channel_flips) {
    auto gpio = MakeInitialized();

    zassert_false(gpio->ReadChannel(-1));
    zassert_false(gpio->ReadChannel(3));

    int highs = 0;
    for(int i = 0; i < 100; i++) {
        highs += gpio->ReadChannel(1) ? 1 : 0;
        k_sleep(K_MSEC(7));
    }

    zassert_true(highs > 10 && highs < 90, "%d", highs);
}

ZTEST(gpio_randomizer, test_registration_before_initialize_fails) {
    GpioRandomizer gpio(Config());

    zassert_equal(gpio.RegisterChannelChangedHandler(0, GpioEdge::BOTH, [](int, bool) {}), IGpio::ERR_NOT_INITIALIZED);
}

ZTEST(gpio_randomizer, test_invalid_registrations_are_rejected) {
    auto gpio = MakeInitialized();

    zassert_equal(
        gpio->RegisterChannelChangedHandler(-1, GpioEdge::BOTH, [](int, bool) {}), IGpio::ERR_INVALID_ARGUMENT
    );
    zassert_equal(
        gpio->RegisterChannelChangedHandler(3, GpioEdge::BOTH, [](int, bool) {}), IGpio::ERR_INVALID_ARGUMENT
    );
    zassert_equal(gpio->RegisterChannelChangedHandler(0, GpioEdge::BOTH, nullptr), IGpio::ERR_INVALID_ARGUMENT);
}

ZTEST(gpio_randomizer, test_a_both_handler_sees_alternating_levels_of_its_channel) {
    auto gpio = MakeInitialized();

    std::atomic<int> calls = 0;
    std::atomic<int> wrong_channel = 0;
    std::atomic<int> repeated = 0;
    std::atomic<int> last_state = -1;

    const int id = gpio->RegisterChannelChangedHandler(2, GpioEdge::BOTH, [&](int channel, bool state) {
        if(channel != 2)
            wrong_channel++;
        if(last_state.exchange(state ? 1 : 0) == (state ? 1 : 0))
            repeated++;
        calls++;
    });
    zassert_true(id > 0);

    k_sleep(K_MSEC(1000));
    zassert_true(gpio->RemoveChannelChangedHandler(2, id));

    zassert_true(calls > 20, "%d", calls.load());
    zassert_equal(wrong_channel.load(), 0);
    zassert_equal(repeated.load(), 0, "every call is an edge");
}

ZTEST(gpio_randomizer, test_edge_filters_select_the_direction) {
    auto gpio = MakeInitialized();

    std::atomic<int> active_calls = 0;
    std::atomic<int> active_low = 0;
    std::atomic<int> inactive_calls = 0;
    std::atomic<int> inactive_high = 0;

    const int a = gpio->RegisterChannelChangedHandler(0, GpioEdge::ACTIVE, [&](int, bool state) {
        active_calls++;
        active_low += state ? 0 : 1;
    });
    const int b = gpio->RegisterChannelChangedHandler(0, GpioEdge::INACTIVE, [&](int, bool state) {
        inactive_calls++;
        inactive_high += state ? 1 : 0;
    });
    zassert_true(a > 0 && b > 0 && a != b);

    k_sleep(K_MSEC(1000));

    zassert_true(active_calls > 5 && inactive_calls > 5);
    zassert_equal(active_low.load(), 0);
    zassert_equal(inactive_high.load(), 0);
    // Rising and falling edges alternate, so the counts differ by at most one.
    zassert_true(std::abs(active_calls.load() - inactive_calls.load()) <= 1);

    gpio->RemoveChannelChangedHandler(0, a);
    gpio->RemoveChannelChangedHandler(0, b);
}

ZTEST(gpio_randomizer, test_removal_stops_the_handler_and_keeps_the_others) {
    auto gpio = MakeInitialized();

    std::atomic<int> first = 0;
    std::atomic<int> second = 0;

    const int id1 = gpio->RegisterChannelChangedHandler(1, GpioEdge::BOTH, [&](int, bool) {
        first++;
    });
    const int id2 = gpio->RegisterChannelChangedHandler(1, GpioEdge::BOTH, [&](int, bool) {
        second++;
    });

    k_sleep(K_MSEC(400));
    zassert_true(first > 0);

    zassert_true(gpio->RemoveChannelChangedHandler(1, id1));
    zassert_false(gpio->RemoveChannelChangedHandler(1, id1), "already removed");
    zassert_false(gpio->RemoveChannelChangedHandler(0, id2), "another channel");
    zassert_false(gpio->RemoveChannelChangedHandler(1, 0));
    zassert_false(gpio->RemoveChannelChangedHandler(9, id2));

    const int first_after_removal = first;
    const int second_before = second;

    k_sleep(K_MSEC(400));

    zassert_equal(first.load(), first_after_removal);
    zassert_true(second > second_before);

    zassert_true(gpio->RemoveChannelChangedHandler(1, id2));

    const int second_after_removal = second;
    k_sleep(K_MSEC(300));

    zassert_equal(second.load(), second_after_removal);
}

ZTEST(gpio_randomizer, test_a_channel_without_handlers_raises_nothing_and_can_register_again) {
    auto gpio = MakeInitialized();

    std::atomic<int> calls = 0;
    int id = gpio->RegisterChannelChangedHandler(0, GpioEdge::BOTH, [&](int, bool) {
        calls++;
    });
    gpio->RemoveChannelChangedHandler(0, id);

    k_sleep(K_MSEC(300));
    zassert_equal(calls.load(), 0);

    id = gpio->RegisterChannelChangedHandler(0, GpioEdge::BOTH, [&](int, bool) {
        calls++;
    });
    zassert_true(id > 0);
    k_sleep(K_MSEC(500));

    zassert_true(calls > 3);
    gpio->RemoveChannelChangedHandler(0, id);
}

ZTEST(gpio_randomizer, test_a_throwing_handler_does_not_stop_the_dispatch) {
    auto gpio = MakeInitialized();

    std::atomic<int> thrown = 0;
    std::atomic<int> survivor = 0;

    const int ids[3] = {
        gpio->RegisterChannelChangedHandler(
            0, GpioEdge::BOTH,
            [&](int, bool) {
                thrown++;
                throw std::runtime_error("handler failure");
            }
        ),
        gpio->RegisterChannelChangedHandler(
            0, GpioEdge::BOTH,
            [&](int, bool) {
                survivor++;
            }
        ),
        gpio->RegisterChannelChangedHandler(
            0, GpioEdge::BOTH,
            [&](int, bool) {
                throw 42; // NOLINT(bugprone-std-exception-baseclass): exercises the catch-all
            }
        ),
    };

    k_sleep(K_MSEC(600));

    // Removal waits for a dispatch in progress, so the counters are settled.
    for(const int id : ids)
        zassert_true(gpio->RemoveChannelChangedHandler(0, id));

    zassert_true(thrown > 3);
    zassert_equal(thrown.load(), survivor.load(), "the handler after the throwing one still runs, every time");
}

ZTEST(gpio_randomizer, test_a_slow_handler_gets_the_newest_level_not_a_backlog) {
    auto gpio = MakeInitialized();

    std::atomic<int> calls = 0;
    std::atomic<int> repeated = 0;
    std::atomic<int> last_state = -1;

    const int id = gpio->RegisterChannelChangedHandler(0, GpioEdge::BOTH, [&](int, bool state) {
        if(last_state.exchange(state ? 1 : 0) == (state ? 1 : 0))
            repeated++;
        calls++;

        // Many flips (10-30 ms holds) pass while this blocks the work queue.
        k_sleep(K_MSEC(120));
    });

    k_sleep(K_MSEC(2000));
    gpio->RemoveChannelChangedHandler(0, id);

    // Without coalescing there would be about 100 flips to deliver; at most one run per 120 ms.
    zassert_true(calls > 3 && calls <= 2000 / 120 + 2, "%d", calls.load());
    zassert_equal(repeated.load(), 0);
}

ZTEST(gpio_randomizer, test_destruction_with_active_handlers_is_safe) {
    std::atomic<int> calls = 0;

    {
        auto gpio = MakeInitialized();

        gpio->RegisterChannelChangedHandler(0, GpioEdge::BOTH, [&](int, bool) {
            calls++;
        });
        gpio->RegisterChannelChangedHandler(2, GpioEdge::BOTH, [&](int, bool) {
            calls++;
        });

        k_sleep(K_MSEC(200));
    }

    const int at_destruction = calls;
    k_sleep(K_MSEC(300));

    zassert_equal(calls.load(), at_destruction, "no work survives the object");
}

ZTEST(gpio_randomizer, test_a_handler_may_remove_itself_during_its_call) {
    auto gpio = MakeInitialized();

    std::atomic<int> calls = 0;
    int id = 0;

    id = gpio->RegisterChannelChangedHandler(0, GpioEdge::BOTH, [&](int, bool) {
        calls++;
        gpio->RemoveChannelChangedHandler(0, id);
    });
    zassert_true(id > 0);

    k_sleep(K_MSEC(300));

    zassert_equal(calls.load(), 1, "removed on its first call, so never again");
}

ZTEST(gpio_randomizer, test_a_handler_may_register_another_during_its_call) {
    auto gpio = MakeInitialized();

    std::atomic<int> late_calls = 0;
    std::atomic<int> registered = 0;

    const int id = gpio->RegisterChannelChangedHandler(1, GpioEdge::BOTH, [&](int, bool) {
        if(registered++ == 0) {
            gpio->RegisterChannelChangedHandler(1, GpioEdge::BOTH, [&](int, bool) {
                late_calls++;
            });
        }
    });
    zassert_true(id > 0);

    k_sleep(K_MSEC(400));

    zassert_equal(registered.load() > 1, true);
    zassert_true(late_calls > 0, "%d", late_calls.load());
}

ZTEST(gpio_randomizer, test_destruction_leaves_no_handler_call_behind) {
    std::atomic<int> calls = 0;

    {
        auto gpio = MakeInitialized();

        for(int channel = 0; channel < 3; channel++) {
            gpio->RegisterChannelChangedHandler(channel, GpioEdge::BOTH, [&](int, bool) {
                calls++;
                k_busy_wait(2000);
            });
        }

        k_sleep(K_MSEC(100));
    }

    const int at_destruction = calls;
    k_sleep(K_MSEC(300));

    zassert_equal(calls.load(), at_destruction);
}
```
