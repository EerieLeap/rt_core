## CMakeLists.txt
```
cmake_minimum_required(VERSION 3.20.0)

include(${CMAKE_CURRENT_SOURCE_DIR}/../../../rt_core_test.cmake)

find_package(Zephyr REQUIRED HINTS $ENV{ZEPHYR_BASE})
project(functional_subsys_smp_can)

file(GLOB_RECURSE TEST_SOURCES src/*.c src/*.cpp)

target_sources(app PRIVATE ${TEST_SOURCES})
```

## prj.conf
```kconfig
CONFIG_ZTEST=y

# Language and Compiler
CONFIG_CPP=y
CONFIG_PICOLIBC=y
CONFIG_STD_CPP23=y
CONFIG_REQUIRES_FULL_LIBCPP=y
CONFIG_CPP_EXCEPTIONS=y
CONFIG_CPP_RTTI=y

# Memory
CONFIG_HEAP_MEM_POOL_SIZE=200000

# C++ exception unwinding needs considerably more stack than the ztest defaults.
CONFIG_MAIN_STACK_SIZE=8192
CONFIG_ZTEST_STACK_SIZE=8192

# Logging And Debugging
CONFIG_LOG=y
CONFIG_TEST_RANDOM_GENERATOR=y
CONFIG_THREAD_NAME=y

# ThreadBase::InitializeStack() falls back to k_thread_stack_alloc().
CONFIG_THREAD_STACK_INFO=y
CONFIG_DYNAMIC_THREAD=y
CONFIG_DYNAMIC_THREAD_ALLOC=y

# CANBus
CONFIG_CAN=y
CONFIG_CAN_FD_MODE=y
CONFIG_CAN_LOOPBACK=y

# The 512 byte default overflows on the 64-bit QEMU targets.
CONFIG_CAN_LOOPBACK_TX_THREAD_STACK_SIZE=2048

CONFIG_EERIE_LEAP_RT_CORE=y
CONFIG_EERIE_LEAP_THREADING=y
CONFIG_EERIE_LEAP_CANBUS=y
CONFIG_EERIE_LEAP_SMP_CAN=y

# The tests assume two reassembly slots.
CONFIG_EERIE_LEAP_SMP_CAN_RX_SLOTS=2
```

## src/smp_can_test_support.h
```c
#pragma once

#include <algorithm>
#include <array>
#include <cstdint>
#include <memory>
#include <optional>
#include <span>
#include <string>
#include <string_view>
#include <utility>
#include <vector>

#include <zephyr/device.h>
#include <zephyr/devicetree.h>
#include <zephyr/drivers/can.h>
#include <zephyr/kernel.h>
#include <zephyr/ztest.h>

#include "subsys/canbus/canbus.h"
#include "subsys/canbus/canbus_proxy.hpp"
#include "subsys/smp/can/smp_can_framer.h"
#include "subsys/smp/can/smp_can_id_layout.h"
#include "subsys/smp/can/smp_can_reassembler.h"
#include "subsys/smp/can/smp_can_transport.h"
#include "subsys/smp/smp_header.h"
#include "subsys/smp/smp_packet.h"
#include "subsys/threading/work_queue_thread.h"

namespace smp_can_test {

using namespace eerie_leap::subsys::canbus;
using namespace eerie_leap::subsys::smp;
using namespace eerie_leap::subsys::smp::can;
using eerie_leap::subsys::threading::WorkQueueThread;

using Bytes = std::vector<uint8_t>;

inline constexpr uint8_t OWN_ADDRESS = 0x10;
// The harness answers for four peers, 0x20-0x23.
inline constexpr uint8_t FIRST_PEER = 0x20;
inline constexpr size_t PEER_COUNT = 4;
inline constexpr uint32_t BITRATE = 500000;
inline constexpr uint8_t BUS_SHARE_PERCENT = 25;
inline constexpr int RESPONSE_TIMEOUT_MS = 1000;

inline const device* LoopbackDevice() {
    return DEVICE_DT_GET(DT_NODELABEL(can_loopback0));
}

// A failing assertion skips the harness teardown, so the controller is stopped separately.
inline void ResetLoopbackDevice() {
    can_stop(LoopbackDevice());
}

inline Bytes
MakePacket(SmpOperation operation, uint16_t group, uint8_t command_id, uint8_t sequence, const Bytes& body) {
    const SmpHeader header{
        .operation = operation,
        .version = 1,
        .length = static_cast<uint16_t>(body.size()),
        .group = group,
        .sequence = sequence,
        .command_id = command_id,
    };

    Bytes packet(SmpHeader::SIZE);
    header.Encode(std::span<uint8_t, SmpHeader::SIZE>(packet.data(), SmpHeader::SIZE));
    packet.insert(packet.end(), body.begin(), body.end());

    return packet;
}

inline Bytes CborText(std::string_view text) {
    Bytes bytes;
    if(text.size() < 24) {
        bytes.push_back(static_cast<uint8_t>(0x60 | text.size()));
    } else {
        bytes.push_back(0x78);
        bytes.push_back(static_cast<uint8_t>(text.size()));
    }
    bytes.insert(bytes.end(), text.begin(), text.end());

    return bytes;
}

// os group (0), echo (0): {"d": text}
inline Bytes MakeEchoRequest(std::string_view text, uint8_t sequence) {
    Bytes body = { 0xA1, 0x61, 'd' };
    auto value = CborText(text);
    body.insert(body.end(), value.begin(), value.end());

    return MakePacket(SmpOperation::WRITE, 0, 0, sequence, body);
}

inline bool Contains(const Bytes& data, const Bytes& part) {
    return !std::ranges::search(data, part).empty();
}

inline bool IsEchoResponse(const std::optional<Bytes>& packet, std::string_view text, uint8_t sequence) {
    if(!packet.has_value())
        return false;

    auto header = SmpHeader::Parse(*packet);
    if(!header.has_value()
        || header->operation != SmpOperation::WRITE_RESPONSE
        || header->group != 0
        || header->command_id != 0
        || header->sequence != sequence) {

        return false;
    }

    Bytes expected = { 0x61, 'r' };
    auto value = CborText(text);
    expected.insert(expected.end(), value.begin(), value.end());

    return Contains(*packet, expected);
}

inline std::vector<Bytes> MakeFrames(std::span<const uint8_t> packet, SmpCanFrameFormat format = {}) {
    std::vector<Bytes> frames;
    SmpCanFramer framer(packet, format);

    while(!framer.IsDone()) {
        std::array<uint8_t, SmpCanFrameFormat::MAX_FRAME_SIZE> frame{};
        const size_t size = framer.Encode(frame);
        frames.emplace_back(frame.begin(), frame.begin() + size);
        framer.Advance();
    }

    return frames;
}

inline SmpPacket ToSmpPacket(const Bytes& bytes) {
    SmpPacket packet = AllocateSmpPacket();
    zassert_not_null(packet.get(), "SMP pool exhausted");
    net_buf_add_mem(packet.get(), bytes.data(), bytes.size());

    return packet;
}

inline std::string LongText(size_t size) {
    std::string text(size, ' ');
    for(size_t i = 0; i < size; i++)
        text[i] = static_cast<char>('a' + i % 26);

    return text;
}

class RecordingSink : public ISmpResponseSink {
private:
    k_sem received_{};
    k_mutex lock_{};
    std::vector<std::pair<uint8_t, Bytes>> responses_;

public:
    RecordingSink() {
        k_sem_init(&received_, 0, K_SEM_MAX_LIMIT);
        k_mutex_init(&lock_);
    }

    void OnResponse(uint8_t source, SmpPacket packet) override {
        k_mutex_lock(&lock_, K_FOREVER);
        responses_.emplace_back(source, Bytes(packet->data, packet->data + packet->len));
        k_mutex_unlock(&lock_);

        k_sem_give(&received_);
    }

    std::optional<std::pair<uint8_t, Bytes>> Wait(int timeout_ms = RESPONSE_TIMEOUT_MS) {
        if(k_sem_take(&received_, K_MSEC(timeout_ms)) != 0)
            return std::nullopt;

        k_mutex_lock(&lock_, K_FOREVER);
        auto response = responses_.front();
        responses_.erase(responses_.begin());
        k_mutex_unlock(&lock_);

        return response;
    }
};

// Stands in for the other units: reassembles what the transport sends to 0x20-0x23.
class Peers {
private:
    struct Peer {
        std::array<uint8_t, CONFIG_MCUMGR_TRANSPORT_NETBUF_SIZE> buffer{};
        SmpCanReassembler reassembler;
        std::vector<Bytes> packets;
        k_sem received{};
    };

    std::array<Peer, PEER_COUNT> peers_;
    k_mutex lock_{};
    uint32_t frame_count_ = 0;
    uint32_t can_fd_frame_count_ = 0;
    uint32_t foreign_source_count_ = 0;
    uint8_t last_source_ = 0;
    int64_t last_frame_ms_ = 0;

public:
    Peers() {
        k_mutex_init(&lock_);
        for(auto& peer : peers_) {
            peer.reassembler.Attach(peer.buffer);
            k_sem_init(&peer.received, 0, K_SEM_MAX_LIMIT);
        }
    }

    void OnFrame(const CanFrame& frame) {
        const uint8_t target = SmpCanIdLayout::GetTarget(frame.id);
        Peer& peer = peers_.at(target - FIRST_PEER);

        k_mutex_lock(&lock_, K_FOREVER);

        frame_count_++;
        if(frame.is_can_fd)
            can_fd_frame_count_++;
        last_frame_ms_ = k_uptime_get();
        last_source_ = SmpCanIdLayout::GetSource(frame.id);
        if(last_source_ != OWN_ADDRESS)
            foreign_source_count_++;

        if(SmpCanReassembler::IsStartFrame(frame.data))
            peer.reassembler.Attach(peer.buffer, SmpCanFrameFormat(frame.is_can_fd));

        const bool is_complete = peer.reassembler.Accept(frame.data, last_frame_ms_)
            == SmpCanReassembler::Result::COMPLETE;
        if(is_complete)
            peer.packets.emplace_back(peer.buffer.begin(), peer.buffer.begin() + peer.reassembler.GetLength());

        k_mutex_unlock(&lock_);

        if(is_complete)
            k_sem_give(&peer.received);
    }

    std::optional<Bytes> WaitPacket(uint8_t address, int timeout_ms = RESPONSE_TIMEOUT_MS) {
        Peer& peer = peers_.at(address - FIRST_PEER);
        if(k_sem_take(&peer.received, K_MSEC(timeout_ms)) != 0)
            return std::nullopt;

        k_mutex_lock(&lock_, K_FOREVER);
        Bytes packet = std::move(peer.packets.front());
        peer.packets.erase(peer.packets.begin());
        k_mutex_unlock(&lock_);

        return packet;
    }

    uint32_t GetFrameCount() {
        k_mutex_lock(&lock_, K_FOREVER);
        const uint32_t count = frame_count_;
        k_mutex_unlock(&lock_);

        return count;
    }

    uint32_t GetCanFdFrameCount() {
        k_mutex_lock(&lock_, K_FOREVER);
        const uint32_t count = can_fd_frame_count_;
        k_mutex_unlock(&lock_);

        return count;
    }

    uint32_t GetForeignSourceCount() {
        k_mutex_lock(&lock_, K_FOREVER);
        const uint32_t count = foreign_source_count_;
        k_mutex_unlock(&lock_);

        return count;
    }

    int64_t GetLastFrameMs() {
        k_mutex_lock(&lock_, K_FOREVER);
        const int64_t last_frame_ms = last_frame_ms_;
        k_mutex_unlock(&lock_);

        return last_frame_ms;
    }

    uint8_t GetLastSource() {
        k_mutex_lock(&lock_, K_FOREVER);
        const uint8_t last_source = last_source_;
        k_mutex_unlock(&lock_);

        return last_source;
    }
};

class Harness {
private:
    static constexpr uint32_t PEER_FILTER_MASK = SmpCanIdLayout::TARGET_FILTER_MASK & ~(0x03U << 8);

    int peer_handler_id_ = -1;

public:
    SmpCanIdLayout layout;
    SmpCanFrameFormat format;
    std::shared_ptr<CanbusProxy> canbus;
    std::shared_ptr<WorkQueueThread> work_queue;
    std::unique_ptr<SmpCanTransport> transport;
    Peers peers;

    explicit Harness(CanbusType type = CanbusType::CLASSICAL_CAN, uint32_t data_bitrate = 0) :
        format(type == CanbusType::CANFD) {

        auto running_canbus = std::make_unique<Canbus>(
            CanbusConfig(LoopbackDevice(), type, BITRATE, data_bitrate, CAN_MODE_LOOPBACK)
        );
        zassert_true(running_canbus->Initialize(), "Canbus::Initialize() failed");
        zassert_true(running_canbus->Start(), "Canbus::Start() failed");
        canbus = std::make_shared<CanbusProxy>(std::move(running_canbus));

        work_queue = std::make_shared<WorkQueueThread>("smp_can_test_wq", 4096, 5);
        zassert_true(work_queue->Initialize());

        transport = std::make_unique<SmpCanTransport>(work_queue);
        zassert_true(transport->Initialize());
        transport->Configure(canbus, layout.GetBase(), BUS_SHARE_PERCENT);
        zassert_true(transport->Bind(OWN_ADDRESS));

        peer_handler_id_ = (*canbus)->RegisterFrameReceivedHandler(
            CanFilter(layout.GetTargetFilterId(FIRST_PEER), PEER_FILTER_MASK, true), [this](const CanFrame& frame) {
                peers.OnFrame(frame);
            }
        );
        zassert_true(peer_handler_id_ > 0, "Peer filter rejected: %d", peer_handler_id_);
    }

    Harness(const Harness&) = delete;
    Harness& operator=(const Harness&) = delete;
    Harness(Harness&&) = delete;
    Harness& operator=(Harness&&) = delete;

    ~Harness() {
        // Get() instead of operator->, which throws when the proxy holds no instance.
        if(Canbus* live_bus = canbus->Get(); live_bus != nullptr)
            live_bus->RemoveFrameReceivedHandler(peer_handler_id_);
        transport.reset();
        work_queue.reset();
        canbus.reset();
    }

    void SendFrame(uint8_t source, uint8_t target, const Bytes& frame) {
        const int result = (*canbus)->SendFrame(CanId::Extended(layout.MakeId(target, source)), frame, K_MSEC(100));
        zassert_equal(result, 0, "SendFrame failed: %d", result);
    }

    void SendPacket(uint8_t source, const Bytes& packet, uint8_t target = OWN_ADDRESS) {
        for(const auto& frame : MakeFrames(packet, format))
            SendFrame(source, target, frame);
    }
};

} // namespace smp_can_test
```

## src/smp_can_transport.cpp
```c
#include <algorithm>
#include <memory>
#include <string>
#include <vector>

#include <zephyr/kernel.h>
#include <zephyr/ztest.h>

#include "smp_can_test_support.h"

using namespace smp_can_test;

struct smp_can_transport_fixture {
    Harness* harness;
};

static void* SmpCanTransportSetup() {
    static smp_can_transport_fixture fixture{};

    return &fixture;
}

static void SmpCanTransportBefore(void* data) {
    static_cast<smp_can_transport_fixture*>(data)->harness = new Harness();
}

static void SmpCanTransportAfter(void* data) {
    auto* fixture = static_cast<smp_can_transport_fixture*>(data);
    delete fixture->harness;
    fixture->harness = nullptr;

    ResetLoopbackDevice();
}

ZTEST_SUITE(smp_can_transport, NULL, SmpCanTransportSetup, SmpCanTransportBefore, SmpCanTransportAfter, NULL);

ZTEST_F(smp_can_transport, test_echo_round_trip) {
    Harness& harness = *fixture->harness;

    harness.SendPacket(FIRST_PEER, MakeEchoRequest("hello", 1));

    zassert_true(IsEchoResponse(harness.peers.WaitPacket(FIRST_PEER), "hello", 1));
    zassert_equal(harness.peers.GetForeignSourceCount(), 0, "Responses must carry the bound address as source");
}

ZTEST_F(smp_can_transport, test_long_echo_spans_many_frames) {
    Harness& harness = *fixture->harness;
    const std::string text = LongText(200);
    const Bytes request = MakeEchoRequest(text, 2);

    zassert_true(SmpCanFramer::GetFrameCount(request.size()) > 30);

    harness.SendPacket(FIRST_PEER, request);

    zassert_true(IsEchoResponse(harness.peers.WaitPacket(FIRST_PEER), text, 2));
}

ZTEST_F(smp_can_transport, test_lost_frame_drops_the_request) {
    Harness& harness = *fixture->harness;
    const std::string text = LongText(40);
    auto frames = MakeFrames(MakeEchoRequest(text, 3));
    frames.erase(frames.begin() + 2);

    for(const auto& frame : frames)
        harness.SendFrame(FIRST_PEER, OWN_ADDRESS, frame);

    zassert_false(harness.peers.WaitPacket(FIRST_PEER, 300).has_value());
    zassert_true(harness.transport->GetRxDroppedCount() >= 1);

    harness.SendPacket(FIRST_PEER, MakeEchoRequest(text, 4));

    zassert_true(IsEchoResponse(harness.peers.WaitPacket(FIRST_PEER), text, 4), "The retried request must succeed");
}

ZTEST_F(smp_can_transport, test_interleaved_sources_are_reassembled_separately) {
    Harness& harness = *fixture->harness;
    const uint8_t first = FIRST_PEER;
    const uint8_t second = FIRST_PEER + 1;
    const std::string first_text = LongText(50);
    const std::string second_text = LongText(30);

    auto first_frames = MakeFrames(MakeEchoRequest(first_text, 5));
    auto second_frames = MakeFrames(MakeEchoRequest(second_text, 6));

    for(size_t i = 0; i < std::max(first_frames.size(), second_frames.size()); i++) {
        if(i < first_frames.size())
            harness.SendFrame(first, OWN_ADDRESS, first_frames[i]);
        if(i < second_frames.size())
            harness.SendFrame(second, OWN_ADDRESS, second_frames[i]);
    }

    zassert_true(IsEchoResponse(harness.peers.WaitPacket(first), first_text, 5));
    zassert_true(IsEchoResponse(harness.peers.WaitPacket(second), second_text, 6));
}

ZTEST_F(smp_can_transport, test_source_without_a_free_slot_is_dropped) {
    Harness& harness = *fixture->harness;
    const uint8_t third = FIRST_PEER + 2;
    const std::string text = LongText(30);

    auto first_frames = MakeFrames(MakeEchoRequest(text, 7));
    auto second_frames = MakeFrames(MakeEchoRequest(text, 8));

    harness.SendFrame(FIRST_PEER, OWN_ADDRESS, first_frames[0]);
    harness.SendFrame(FIRST_PEER + 1, OWN_ADDRESS, second_frames[0]);

    const uint32_t dropped_before = harness.transport->GetRxDroppedCount();
    harness.SendPacket(third, MakeEchoRequest(text, 9));

    // Shorter than the slot timeout, so the first two packets stay in progress.
    k_msleep(20);
    zassert_true(harness.transport->GetRxDroppedCount() > dropped_before, "Both slots are busy");

    for(size_t i = 1; i < first_frames.size(); i++) {
        harness.SendFrame(FIRST_PEER, OWN_ADDRESS, first_frames[i]);
        harness.SendFrame(FIRST_PEER + 1, OWN_ADDRESS, second_frames[i]);
    }

    zassert_true(IsEchoResponse(harness.peers.WaitPacket(FIRST_PEER), text, 7));
    zassert_true(IsEchoResponse(harness.peers.WaitPacket(FIRST_PEER + 1), text, 8));
    zassert_false(harness.peers.WaitPacket(third, 0).has_value(), "The dropped request got no response");

    harness.SendPacket(third, MakeEchoRequest(text, 10));

    zassert_true(IsEchoResponse(harness.peers.WaitPacket(third), text, 10), "Slots are free again");
}

ZTEST_F(smp_can_transport, test_stale_slot_is_reclaimed_after_the_timeout) {
    Harness& harness = *fixture->harness;
    const std::string text = LongText(30);

    harness.SendFrame(FIRST_PEER, OWN_ADDRESS, MakeFrames(MakeEchoRequest(text, 11))[0]);
    harness.SendFrame(FIRST_PEER + 1, OWN_ADDRESS, MakeFrames(MakeEchoRequest(text, 12))[0]);

    k_msleep(CONFIG_EERIE_LEAP_SMP_CAN_RX_TIMEOUT_MS + 50);

    harness.SendPacket(FIRST_PEER + 2, MakeEchoRequest(text, 13));

    zassert_true(IsEchoResponse(harness.peers.WaitPacket(FIRST_PEER + 2), text, 13));
}

ZTEST_F(smp_can_transport, test_forwarded_request_and_its_response) {
    Harness& harness = *fixture->harness;
    const auto sink = std::make_shared<RecordingSink>();
    harness.transport->SetResponseSink(sink);

    const Bytes request = MakeEchoRequest("forwarded", 14);
    zassert_true(harness.transport->Forward(FIRST_PEER + 3, ToSmpPacket(request)));

    auto received = harness.peers.WaitPacket(FIRST_PEER + 3);
    zassert_true(received.has_value());
    zassert_true(*received == request, "The target receives the packet unchanged");

    const Bytes response = MakePacket(SmpOperation::WRITE_RESPONSE, 0, 0, 14, { 0xA1, 0x61, 'r', 0x61, 'x' });
    harness.SendPacket(FIRST_PEER + 3, response);

    auto delivered = sink->Wait();
    zassert_true(delivered.has_value());
    zassert_equal(delivered->first, FIRST_PEER + 3);
    zassert_true(delivered->second == response);
}

ZTEST_F(smp_can_transport, test_response_without_a_sink_is_dropped) {
    Harness& harness = *fixture->harness;
    const uint32_t dropped_before = harness.transport->GetRxDroppedCount();

    harness.SendPacket(FIRST_PEER, MakePacket(SmpOperation::READ_RESPONSE, 0, 0, 1, { 0xA0 }));
    k_msleep(50);

    zassert_equal(harness.transport->GetRxDroppedCount(), dropped_before + 1);
}

ZTEST_F(smp_can_transport, test_paced_rate_stays_within_the_share) {
    Harness& harness = *fixture->harness;
    const Bytes body(1000, 0x5A);
    const Bytes packet = MakePacket(SmpOperation::WRITE, 64, 0, 15, body);
    const size_t frame_count = SmpCanFramer::GetFrameCount(packet.size());

    const uint32_t frames_per_second =
        SmpCanPacer(harness.format.GetFrameTimeNs(BITRATE), BUS_SHARE_PERCENT, 1).GetFramesPerSecond();
    const int64_t minimum_ms = static_cast<int64_t>(frame_count - CONFIG_EERIE_LEAP_SMP_CAN_TX_BURST_FRAMES) * 1000
        / frames_per_second;

    const int64_t start_ms = k_uptime_get();
    zassert_true(harness.transport->Forward(FIRST_PEER, ToSmpPacket(packet)));

    auto received = harness.peers.WaitPacket(FIRST_PEER, 5000);
    zassert_true(received.has_value());
    zassert_true(*received == packet);
    zassert_equal(harness.peers.GetFrameCount(), frame_count);

    // One tick of slack for the uptime granularity.
    const int64_t elapsed_ms = harness.peers.GetLastFrameMs() - start_ms;
    const int64_t tick_ms = 1000 / CONFIG_SYS_CLOCK_TICKS_PER_SEC;
    zassert_true(
        elapsed_ms + tick_ms >= minimum_ms, "%zu frames took %lld ms, the share allows no less than %lld ms",
        frame_count, static_cast<long long>(elapsed_ms), static_cast<long long>(minimum_ms)
    );
}

ZTEST_F(smp_can_transport, test_unbound_transport_ignores_requests) {
    Harness& harness = *fixture->harness;

    harness.transport->Unbind();
    zassert_equal(harness.transport->GetAddress(), 0);

    harness.SendPacket(FIRST_PEER, MakeEchoRequest("unbound", 16));
    zassert_false(harness.peers.WaitPacket(FIRST_PEER, 300).has_value());
    zassert_false(harness.transport->Forward(FIRST_PEER, ToSmpPacket(MakeEchoRequest("x", 1))));
}

ZTEST_F(smp_can_transport, test_rebind_moves_to_the_new_address) {
    Harness& harness = *fixture->harness;
    constexpr uint8_t NEW_ADDRESS = OWN_ADDRESS + 1;

    zassert_true(harness.transport->Bind(NEW_ADDRESS));
    zassert_equal(harness.transport->GetAddress(), NEW_ADDRESS);

    harness.SendPacket(FIRST_PEER, MakeEchoRequest("old", 17), OWN_ADDRESS);
    zassert_false(harness.peers.WaitPacket(FIRST_PEER, 300).has_value(), "The old address is released");

    harness.SendPacket(FIRST_PEER, MakeEchoRequest("new", 18), NEW_ADDRESS);
    const auto response = harness.peers.WaitPacket(FIRST_PEER);
    zassert_true(IsEchoResponse(response, "new", 18));
    zassert_equal(harness.peers.GetLastSource(), NEW_ADDRESS, "The response comes from the new address");
}

ZTEST_F(smp_can_transport, test_invalid_addresses_are_rejected) {
    Harness& harness = *fixture->harness;

    zassert_false(harness.transport->Bind(0x00));
    zassert_false(harness.transport->Bind(0xFF));
    zassert_equal(harness.transport->GetAddress(), OWN_ADDRESS, "A rejected bind keeps the current address");

    zassert_false(harness.transport->Forward(0x00, ToSmpPacket(MakeEchoRequest("x", 1))));
    zassert_false(harness.transport->Forward(0xFF, ToSmpPacket(MakeEchoRequest("x", 1))));
    zassert_false(harness.transport->Forward(OWN_ADDRESS, ToSmpPacket(MakeEchoRequest("x", 1))));
}
```

## src/smp_can_transport_fd.cpp
```c
#include <memory>
#include <string>

#include <zephyr/kernel.h>
#include <zephyr/ztest.h>

#include "smp_can_test_support.h"

using namespace smp_can_test;

namespace {

constexpr uint32_t DATA_BITRATE = 2000000;
constexpr SmpCanFrameFormat CAN_FD(true);

} // namespace

struct smp_can_transport_fd_fixture {
    Harness* harness;
};

static void* SmpCanTransportFdSetup() {
    static smp_can_transport_fd_fixture fixture{};

    return &fixture;
}

static void SmpCanTransportFdBefore(void* data) {
    static_cast<smp_can_transport_fd_fixture*>(data)->harness = new Harness(CanbusType::CANFD, DATA_BITRATE);
}

static void SmpCanTransportFdAfter(void* data) {
    auto* fixture = static_cast<smp_can_transport_fd_fixture*>(data);
    delete fixture->harness;
    fixture->harness = nullptr;

    ResetLoopbackDevice();
}

ZTEST_SUITE(smp_can_transport_fd, NULL, SmpCanTransportFdSetup, SmpCanTransportFdBefore, SmpCanTransportFdAfter, NULL);

ZTEST_F(smp_can_transport_fd, test_echo_round_trip_uses_can_fd_frames) {
    Harness& harness = *fixture->harness;

    harness.SendPacket(FIRST_PEER, MakeEchoRequest("hello", 1));

    zassert_true(IsEchoResponse(harness.peers.WaitPacket(FIRST_PEER), "hello", 1));
    zassert_true(harness.peers.GetFrameCount() > 0);
    zassert_equal(
        harness.peers.GetCanFdFrameCount(), harness.peers.GetFrameCount(), "A CAN FD channel sends CAN FD frames"
    );
}

ZTEST_F(smp_can_transport_fd, test_long_echo_uses_64_byte_frames) {
    Harness& harness = *fixture->harness;
    const std::string text = LongText(200);
    const Bytes request = MakeEchoRequest(text, 2);

    zassert_equal(SmpCanFramer::GetFrameCount(request.size(), CAN_FD), 4);

    harness.SendPacket(FIRST_PEER, request);

    auto response = harness.peers.WaitPacket(FIRST_PEER);
    zassert_true(IsEchoResponse(response, text, 2));
    zassert_equal(harness.peers.GetFrameCount(), SmpCanFramer::GetFrameCount(response->size(), CAN_FD));
}

ZTEST_F(smp_can_transport_fd, test_interleaved_sources_are_reassembled_separately) {
    Harness& harness = *fixture->harness;
    const std::string first_text = LongText(150);
    const std::string second_text = LongText(90);

    auto first_frames = MakeFrames(MakeEchoRequest(first_text, 3), CAN_FD);
    auto second_frames = MakeFrames(MakeEchoRequest(second_text, 4), CAN_FD);

    for(size_t i = 0; i < std::max(first_frames.size(), second_frames.size()); i++) {
        if(i < first_frames.size())
            harness.SendFrame(FIRST_PEER, OWN_ADDRESS, first_frames[i]);
        if(i < second_frames.size())
            harness.SendFrame(FIRST_PEER + 1, OWN_ADDRESS, second_frames[i]);
    }

    zassert_true(IsEchoResponse(harness.peers.WaitPacket(FIRST_PEER), first_text, 3));
    zassert_true(IsEchoResponse(harness.peers.WaitPacket(FIRST_PEER + 1), second_text, 4));
}

ZTEST_F(smp_can_transport_fd, test_forwarded_packet_fills_the_buffer_in_16_frames) {
    Harness& harness = *fixture->harness;
    const Bytes packet = MakePacket(SmpOperation::WRITE, 64, 0, 5, Bytes(1000, 0x5A));

    zassert_true(harness.transport->Forward(FIRST_PEER, ToSmpPacket(packet)));

    auto received = harness.peers.WaitPacket(FIRST_PEER);
    zassert_true(received.has_value());
    zassert_true(*received == packet);
    zassert_equal(harness.peers.GetFrameCount(), 16);
}

ZTEST_F(smp_can_transport_fd, test_response_to_a_forwarded_request_reaches_the_sink) {
    Harness& harness = *fixture->harness;
    const auto sink = std::make_shared<RecordingSink>();
    harness.transport->SetResponseSink(sink);

    const Bytes response = MakePacket(SmpOperation::WRITE_RESPONSE, 0, 0, 6, Bytes(100, 0xA5));
    harness.SendPacket(FIRST_PEER + 3, response);

    auto delivered = sink->Wait();
    zassert_true(delivered.has_value());
    zassert_equal(delivered->first, FIRST_PEER + 3);
    zassert_true(delivered->second == response, "The CAN FD padding is not part of the packet");
}
```
