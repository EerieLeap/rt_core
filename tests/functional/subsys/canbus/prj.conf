## CMakeLists.txt
```
cmake_minimum_required(VERSION 3.20.0)

include(${CMAKE_CURRENT_SOURCE_DIR}/../../../rt_core_test.cmake)

find_package(Zephyr REQUIRED HINTS $ENV{ZEPHYR_BASE})
project(functional_subsys_canbus)

file(GLOB_RECURSE TEST_SOURCES src/*.c src/*.cpp)

target_sources(app PRIVATE ${TEST_SOURCES})
```

## prj.conf
```kconfig
CONFIG_ZTEST=y

# Language and Compiler
CONFIG_CPP=y
CONFIG_PICOLIBC=y
CONFIG_STD_CPP23=y
CONFIG_REQUIRES_FULL_LIBCPP=y
CONFIG_CPP_EXCEPTIONS=y
CONFIG_CPP_RTTI=y

# Memory
CONFIG_HEAP_MEM_POOL_SIZE=200000

# C++ exception unwinding needs considerably more stack than the ztest defaults.
CONFIG_MAIN_STACK_SIZE=8192
CONFIG_ZTEST_STACK_SIZE=8192

# Logging And Debugging
CONFIG_LOG=y
CONFIG_TEST_RANDOM_GENERATOR=y
CONFIG_THREAD_NAME=y
CONFIG_THREAD_MONITOR=y

# ThreadBase::InitializeStack() falls back to k_thread_stack_alloc().
CONFIG_THREAD_STACK_INFO=y
CONFIG_DYNAMIC_THREAD=y
CONFIG_DYNAMIC_THREAD_ALLOC=y

# CANBus
CONFIG_CAN=y
CONFIG_CAN_FD_MODE=y
CONFIG_CAN_LOOPBACK=y
# Room for the suites' handlers plus the tap's two accept-all filters; canbus_tap.cpp fills it to test the swap.
CONFIG_CAN_LOOPBACK_MAX_FILTERS=32

# The tap suite follows remote frames; Canbus never dispatches them to handlers.
CONFIG_CAN_ACCEPT_RTR=y

# The 512 byte default overflows on the 64-bit QEMU targets.
CONFIG_CAN_LOOPBACK_TX_THREAD_STACK_SIZE=2048

CONFIG_EERIE_LEAP_RT_CORE=y
CONFIG_EERIE_LEAP_THREADING=y
CONFIG_EERIE_LEAP_CANBUS=y

# Few enough slots for the tap suite to exhaust them with a burst.
CONFIG_EERIE_LEAP_CAN_MONITOR_TX_SLOTS=4
```

## app.overlay
```dts
/ {
	can_loopback0: can_loopback0 {
		status = "okay";
		compatible = "zephyr,can-loopback";
	};
};
```

## src/canbus.cpp
```c
#include <array>
#include <cstdint>
#include <memory>
#include <vector>

#include <zephyr/ztest.h>

#include "canbus_test_support.h"

using namespace canbus_test;

using eerie_leap::subsys::canbus::CanId;
using eerie_leap::subsys::threading::ServiceState;

ZTEST_SUITE(canbus, NULL, NULL, ResetLoopbackDevice, NULL, NULL);

ZTEST(canbus, test_lifecycle_transitions) {
    Canbus canbus(MakeConfig());

    zassert_equal(canbus.GetState(), ServiceState::STOPPED);
    zassert_true(canbus.Initialize());
    zassert_equal(canbus.GetState(), ServiceState::STOPPED);

    zassert_true(canbus.Start());
    zassert_equal(canbus.GetState(), ServiceState::RUNNING);
    zassert_true(canbus.Start(), "Start() must be idempotent");

    zassert_true(canbus.Stop());
    zassert_equal(canbus.GetState(), ServiceState::STOPPED);
    zassert_true(canbus.Stop(), "Stop() must be idempotent");
}

ZTEST(canbus, test_start_requires_initialize) {
    Canbus canbus(MakeConfig());

    zassert_false(canbus.Start(), "Start() must fail before Initialize()");
    zassert_equal(canbus.GetState(), ServiceState::STOPPED);
}

ZTEST(canbus, test_unsupported_bitrate_is_rejected) {
    Canbus canbus(MakeConfig(CanbusType::CLASSICAL_CAN, 500000));

    zassert_false(canbus.Configure(MakeConfig(CanbusType::CLASSICAL_CAN, 123456)));
}

ZTEST(canbus, test_configure_rolls_back_on_failure) {
    Canbus canbus(MakeConfig(CanbusType::CLASSICAL_CAN, 500000));
    zassert_true(canbus.Initialize());

    zassert_false(canbus.Configure(MakeConfig(CanbusType::CLASSICAL_CAN, 7)));
    zassert_equal(canbus.GetDetectedBitrate(), 500000, "Failed Configure() must not clobber the live config");
}

ZTEST(canbus, test_register_handler_returns_positive_id) {
    auto canbus = MakeRunningCanbus();
    FrameCollector collector;

    const int first = canbus->RegisterFrameReceivedHandler(CanId::Standard(0x100), [&](const CanFrame& f) {
        collector.Collect(f);
    });
    const int second = canbus->RegisterFrameReceivedHandler(CanId::Standard(0x100), [&](const CanFrame& f) {
        collector.Collect(f);
    });

    zassert_true(first > 0, "Handler ids must be strictly positive");
    zassert_true(second > 0);
    zassert_not_equal(first, second, "Handler ids must be unique");

    zassert_true(canbus->RemoveFrameReceivedHandler(first));
    zassert_true(canbus->RemoveFrameReceivedHandler(second));
}

ZTEST(canbus, test_register_handler_before_initialize_fails) {
    Canbus canbus(MakeConfig());

    const int result = canbus.RegisterFrameReceivedHandler(CanId::Standard(0x100), [](const CanFrame&) {});

    zassert_equal(result, Canbus::ERR_NOT_INITIALIZED);
}

ZTEST(canbus, test_register_empty_handler_fails) {
    auto canbus = MakeRunningCanbus();

    const int result = canbus->RegisterFrameReceivedHandler(CanId::Standard(0x100), nullptr);

    zassert_equal(result, Canbus::ERR_INVALID_ARGUMENT);
}

ZTEST(canbus, test_handler_limit_is_enforced) {
    auto canbus = MakeRunningCanbus();

    std::vector<int> ids;
    for(int i = 0; i < 8; i++) {
        const int id = canbus->RegisterFrameReceivedHandler(CanId::Standard(0x200), [](const CanFrame&) {});
        zassert_true(id > 0, "Handler %d should have been accepted", i);
        ids.push_back(id);
    }

    zassert_equal(
        canbus->RegisterFrameReceivedHandler(CanId::Standard(0x200), [](const CanFrame&) {}),
        Canbus::ERR_TOO_MANY_HANDLERS
    );

    for(const int id : ids)
        zassert_true(canbus->RemoveFrameReceivedHandler(id));
}

ZTEST(canbus, test_remove_handler_contract) {
    auto canbus = MakeRunningCanbus();

    const int id = canbus->RegisterFrameReceivedHandler(CanId::Standard(0x300), [](const CanFrame&) {});
    zassert_true(id > 0);

    zassert_false(canbus->RemoveFrameReceivedHandler(id + 100), "Unknown handler id must fail");
    zassert_true(canbus->RemoveFrameReceivedHandler(id));
    zassert_false(canbus->RemoveFrameReceivedHandler(id), "Double removal must fail");
}

ZTEST(canbus, test_remove_handler_before_initialize_fails) {
    Canbus canbus(MakeConfig());

    zassert_false(canbus.RemoveFrameReceivedHandler(1));
}

ZTEST(canbus, test_send_and_receive_round_trip) {
    auto canbus = MakeRunningCanbus();
    FrameCollector collector;

    const int id = canbus->RegisterFrameReceivedHandler(CanId::Standard(0x321), [&](const CanFrame& f) {
        collector.Collect(f);
    });
    zassert_true(id > 0);

    std::array<uint8_t, 8> payload = { 1, 2, 3, 4, 5, 6, 7, 8 };
    zassert_ok(canbus->SendFrame(CanId::Standard(0x321), payload));

    zassert_true(collector.Wait(), "Frame was not delivered");
    zassert_equal(collector.Count(), 1);

    CanFrame received = collector.At(0);
    zassert_equal(received.id, 0x321);
    zassert_false(received.is_extended);
    zassert_equal(received.data.size(), 8);
    for(size_t i = 0; i < payload.size(); i++)
        zassert_equal(received.data[i], payload[i]);
}

ZTEST(canbus, test_extended_id_round_trip) {
    auto canbus = MakeRunningCanbus();
    FrameCollector collector;

    const CanId extended_id = CanId::Extended(0x18FF1234);

    const int id = canbus->RegisterFrameReceivedHandler(extended_id, [&](const CanFrame& f) {
        collector.Collect(f);
    });
    zassert_true(id > 0, "Extended ids must be accepted");

    std::array<uint8_t, 4> payload = { 0xDE, 0xAD, 0xBE, 0xEF };
    zassert_ok(canbus->SendFrame(extended_id, payload));

    zassert_true(collector.Wait(), "Extended frame was not delivered");

    CanFrame received = collector.At(0);
    zassert_equal(received.id, extended_id.id);
    zassert_true(received.is_extended);
    zassert_equal(received.data.size(), 4);
    zassert_equal(received.data[0], 0xDE);
}

ZTEST(canbus, test_extended_id_filter_does_not_alias_lower_bits) {
    auto canbus = MakeRunningCanbus();
    FrameCollector collector;

    // 0x18FF1234 and 0x1CFF1234 share their low 11 bits.
    const int id = canbus->RegisterFrameReceivedHandler(CanId::Extended(0x18FF1234), [&](const CanFrame& f) {
        collector.Collect(f);
    });
    zassert_true(id > 0);

    std::array<uint8_t, 1> payload = { 0x01 };
    zassert_ok(canbus->SendFrame(CanId::Extended(0x1CFF1234), payload));

    zassert_false(collector.Wait(200), "A different extended id must not match the filter");
}

ZTEST(canbus, test_oversized_payload_is_rejected) {
    auto canbus = MakeRunningCanbus(CanbusType::CLASSICAL_CAN);

    std::vector<uint8_t> payload(64, 0xAA);

    zassert_equal(
        canbus->SendFrame(CanId::Standard(0x100), payload), -EINVAL,
        "Classical CAN must reject payloads longer than 8 bytes"
    );
}

ZTEST(canbus, test_huge_payload_is_rejected) {
    auto canbus = MakeRunningCanbus(CanbusType::CANFD);

    std::vector<uint8_t> payload(512, 0xAA);

    zassert_equal(
        canbus->SendFrame(CanId::Standard(0x100), payload), -EINVAL, "Payloads beyond the CAN FD limit must be rejected"
    );
}

ZTEST(canbus, test_send_before_start_is_rejected) {
    Canbus canbus(MakeConfig());
    zassert_true(canbus.Initialize());

    std::array<uint8_t, 1> payload = { 0x01 };

    zassert_equal(
        canbus.SendFrame(CanId::Standard(0x100), payload), -ENETDOWN, "SendFrame() must fail while not RUNNING"
    );
}

ZTEST(canbus, test_canfd_payload_round_trip) {
    auto canbus = MakeRunningCanbus(CanbusType::CANFD, 500000);
    FrameCollector collector;

    const int id = canbus->RegisterFrameReceivedHandler(CanId::Standard(0x123), [&](const CanFrame& f) {
        collector.Collect(f);
    });
    zassert_true(id > 0);

    std::vector<uint8_t> payload(32, 0x77);
    zassert_ok(canbus->SendFrame(CanId::Standard(0x123), payload));

    zassert_true(collector.Wait(), "CAN FD frame was not delivered");

    CanFrame received = collector.At(0);
    zassert_true(received.is_can_fd);
    zassert_equal(received.data.size(), 32);
    zassert_equal(received.data[31], 0x77);
}

ZTEST(canbus, test_all_handlers_for_an_id_are_invoked) {
    auto canbus = MakeRunningCanbus();
    FrameCollector first;
    FrameCollector second;

    zassert_true(canbus->RegisterFrameReceivedHandler(CanId::Standard(0x400), [&](const CanFrame& f) {
        first.Collect(f);
    }) > 0);
    zassert_true(canbus->RegisterFrameReceivedHandler(CanId::Standard(0x400), [&](const CanFrame& f) {
        second.Collect(f);
    }) > 0);

    std::array<uint8_t, 2> payload = { 0x10, 0x20 };
    zassert_ok(canbus->SendFrame(CanId::Standard(0x400), payload));

    zassert_true(first.Wait(), "First handler was not invoked");
    zassert_true(second.Wait(), "Second handler was not invoked");
}

ZTEST(canbus, test_removed_handler_stops_receiving) {
    auto canbus = MakeRunningCanbus();
    FrameCollector collector;

    const int id = canbus->RegisterFrameReceivedHandler(CanId::Standard(0x500), [&](const CanFrame& f) {
        collector.Collect(f);
    });
    zassert_true(id > 0);
    zassert_true(canbus->RemoveFrameReceivedHandler(id));

    std::array<uint8_t, 1> payload = { 0x01 };
    zassert_ok(canbus->SendFrame(CanId::Standard(0x500), payload));

    zassert_false(collector.Wait(200), "A removed handler must not be invoked");
}

ZTEST(canbus, test_handler_may_unregister_itself_during_dispatch) {
    auto canbus = MakeRunningCanbus();
    FrameCollector collector;

    int id = 0;
    id = canbus->RegisterFrameReceivedHandler(CanId::Standard(0x600), [&](const CanFrame& frame) {
        collector.Collect(frame);
        canbus->RemoveFrameReceivedHandler(id);
    });
    zassert_true(id > 0);

    std::array<uint8_t, 1> payload = { 0x01 };
    zassert_ok(canbus->SendFrame(CanId::Standard(0x600), payload));
    zassert_true(collector.Wait());

    zassert_ok(canbus->SendFrame(CanId::Standard(0x600), payload));
    zassert_false(collector.Wait(200), "Handler should have removed itself");
}

ZTEST(canbus, test_unfiltered_ids_are_not_delivered) {
    auto canbus = MakeRunningCanbus();
    FrameCollector collector;

    zassert_true(canbus->RegisterFrameReceivedHandler(CanId::Standard(0x700), [&](const CanFrame& f) {
        collector.Collect(f);
    }) > 0);

    std::array<uint8_t, 1> payload = { 0x01 };
    zassert_ok(canbus->SendFrame(CanId::Standard(0x701), payload));

    zassert_false(collector.Wait(200), "Only filtered ids may be delivered");
}

ZTEST(canbus, test_stop_clears_handlers_and_rx_state) {
    auto canbus = MakeRunningCanbus();
    FrameCollector collector;

    const int id = canbus->RegisterFrameReceivedHandler(CanId::Standard(0x108), [&](const CanFrame& f) {
        collector.Collect(f);
    });
    zassert_true(id > 0);

    zassert_true(canbus->Stop());

    zassert_false(canbus->IsBitrateDetected());
    zassert_equal(
        canbus->RegisterFrameReceivedHandler(CanId::Standard(0x108), [](const CanFrame&) {}),
        Canbus::ERR_NOT_INITIALIZED, "Stop() must leave the bus uninitialized"
    );
}

ZTEST(canbus, test_reconfigure_after_stop) {
    Canbus canbus(MakeConfig(CanbusType::CLASSICAL_CAN, 500000));

    zassert_true(canbus.Initialize());
    zassert_true(canbus.Start());
    zassert_true(canbus.Stop());

    zassert_true(canbus.Configure(MakeConfig(CanbusType::CLASSICAL_CAN, 250000)));
    zassert_true(canbus.Start());
    zassert_equal(canbus.GetDetectedBitrate(), 250000);

    FrameCollector collector;
    zassert_true(canbus.RegisterFrameReceivedHandler(CanId::Standard(0x109), [&](const CanFrame& f) {
        collector.Collect(f);
    }) > 0);

    std::array<uint8_t, 1> payload = { 0x42 };
    zassert_ok(canbus.SendFrame(CanId::Standard(0x109), payload));
    zassert_true(collector.Wait(), "Bus must work again after a reconfigure");

    zassert_true(canbus.Stop());
}

ZTEST(canbus, test_rx_drop_counter_starts_at_zero) {
    auto canbus = MakeRunningCanbus();

    zassert_equal(canbus->GetRxDroppedCount(), 0);
}

ZTEST(canbus, test_auto_detect_defers_filters_but_returns_valid_handler_id) {
    // Bitrate 0 selects auto detection; the loopback bus is silent so it never
    // completes, which is exactly the window where handler ids used to be lost.
    auto canbus = std::make_unique<Canbus>(MakeConfig(CanbusType::CLASSICAL_CAN, 0));

    zassert_true(canbus->Initialize());
    zassert_true(canbus->Start());
    zassert_false(canbus->IsBitrateDetected());

    const int id = canbus->RegisterFrameReceivedHandler(CanId::Standard(0x10A), [](const CanFrame&) {});
    zassert_true(id > 0, "A deferred handler must still return a usable id, got %d", id);
    zassert_true(canbus->RemoveFrameReceivedHandler(id), "The id returned during auto-detect must be removable");

    zassert_true(canbus->Stop());
}

ZTEST(canbus, test_destruction_while_running_is_safe) {
    FrameCollector collector;

    {
        auto canbus = MakeRunningCanbus();
        zassert_true(canbus->RegisterFrameReceivedHandler(CanId::Standard(0x10B), [&](const CanFrame& f) {
            collector.Collect(f);
        }) > 0);

        std::array<uint8_t, 1> payload = { 0x01 };
        zassert_ok(canbus->SendFrame(CanId::Standard(0x10B), payload));
        zassert_true(collector.Wait());
    }

    // The filter must be gone with the object; a fresh instance on the same
    // device proves the driver is not still holding the destroyed callback.
    auto replacement = MakeRunningCanbus();
    FrameCollector replacement_collector;

    zassert_true(replacement->RegisterFrameReceivedHandler(CanId::Standard(0x10B), [&](const CanFrame& f) {
        replacement_collector.Collect(f);
    }) > 0);

    std::array<uint8_t, 1> payload = { 0x02 };
    zassert_ok(replacement->SendFrame(CanId::Standard(0x10B), payload));

    zassert_true(replacement_collector.Wait());
    zassert_equal(collector.Count(), 1, "The destroyed instance must not receive anything");
}
```

## src/canbus_filters.cpp
```c
#include <array>
#include <cstdint>

#include <zephyr/ztest.h>

#include "canbus_test_support.h"

using namespace canbus_test;

using eerie_leap::subsys::canbus::CanFilter;
using eerie_leap::subsys::canbus::CanId;

ZTEST_SUITE(canbus_filters, NULL, NULL, ResetLoopbackDevice, NULL, NULL);

namespace {

// Accepts every extended id addressed to `target` in bits 8..15.
constexpr uint32_t TARGET_MASK = 0x1FFFFF00;

CanFilter TargetFilter(uint8_t target) {
    return CanFilter::Masked(CanId::Extended(0x1FF00000 | (static_cast<uint32_t>(target) << 8)), TARGET_MASK);
}

constexpr std::array<uint8_t, 1> PAYLOAD = { 0x01 };

} // namespace

ZTEST(canbus_filters, test_standard_and_extended_ids_with_same_number_are_distinct) {
    auto canbus = MakeRunningCanbus();
    FrameCollector standard;
    FrameCollector extended;

    zassert_true(canbus->RegisterFrameReceivedHandler(CanId::Standard(0x123), [&](const CanFrame& f) {
        standard.Collect(f);
    }) > 0);
    zassert_true(canbus->RegisterFrameReceivedHandler(CanId::Extended(0x123), [&](const CanFrame& f) {
        extended.Collect(f);
    }) > 0);

    zassert_ok(canbus->SendFrame(CanId::Standard(0x123), PAYLOAD));
    zassert_true(standard.Wait(), "Standard frame was not delivered");
    zassert_false(extended.Wait(200), "A standard frame must not reach the extended handler");
    zassert_false(standard.At(0).is_extended);

    zassert_ok(canbus->SendFrame(CanId::Extended(0x123), PAYLOAD));
    zassert_true(extended.Wait(), "Extended frame was not delivered");
    zassert_false(standard.Wait(200), "An extended frame must not reach the standard handler");
    zassert_true(extended.At(0).is_extended);
}

ZTEST(canbus_filters, test_mask_filter_accepts_matching_ids_only) {
    auto canbus = MakeRunningCanbus();
    FrameCollector collector;

    const int id = canbus->RegisterFrameReceivedHandler(TargetFilter(0x07), [&](const CanFrame& f) {
        collector.Collect(f);
    });
    zassert_true(id > 0);

    zassert_ok(canbus->SendFrame(CanId::Extended(0x1FF00705), PAYLOAD));
    zassert_ok(canbus->SendFrame(CanId::Extended(0x1FF00742), PAYLOAD));
    zassert_true(collector.Wait());
    zassert_true(collector.Wait());
    zassert_equal(collector.At(0).id, 0x1FF00705);
    zassert_equal(collector.At(1).id, 0x1FF00742);

    zassert_ok(canbus->SendFrame(CanId::Extended(0x1FF00805), PAYLOAD));
    zassert_false(collector.Wait(200), "Another target must not match");

    zassert_ok(canbus->SendFrame(CanId::Standard(0x705), PAYLOAD));
    zassert_false(collector.Wait(200), "A standard frame must not match an extended mask");

    zassert_true(canbus->RemoveFrameReceivedHandler(id));
}

ZTEST(canbus_filters, test_overlapping_filters_are_rejected) {
    auto canbus = MakeRunningCanbus();

    const int mask_id = canbus->RegisterFrameReceivedHandler(TargetFilter(0x07), [](const CanFrame&) {});
    zassert_true(mask_id > 0);

    zassert_equal(
        canbus->RegisterFrameReceivedHandler(CanId::Extended(0x1FF00701), [](const CanFrame&) {}),
        Canbus::ERR_FILTER_OVERLAP, "An exact id inside a registered mask must be rejected"
    );
    zassert_equal(
        canbus->RegisterFrameReceivedHandler(
            CanFilter::Masked(CanId::Extended(0x1FF00000), 0x1FF00000), [](const CanFrame&) {}
        ),
        Canbus::ERR_FILTER_OVERLAP, "A wider mask covering a registered mask must be rejected"
    );

    const int standard_id = canbus->RegisterFrameReceivedHandler(CanId::Standard(0x701), [](const CanFrame&) {});
    zassert_true(standard_id > 0, "Standard ids never overlap extended filters");

    const int disjoint_id = canbus->RegisterFrameReceivedHandler(TargetFilter(0x08), [](const CanFrame&) {});
    zassert_true(disjoint_id > 0, "A disjoint mask must be accepted");

    zassert_true(canbus->RemoveFrameReceivedHandler(mask_id));
    zassert_true(canbus->RemoveFrameReceivedHandler(standard_id));
    zassert_true(canbus->RemoveFrameReceivedHandler(disjoint_id));
}

ZTEST(canbus_filters, test_mask_covering_a_registered_id_is_rejected) {
    auto canbus = MakeRunningCanbus();

    const int exact_id = canbus->RegisterFrameReceivedHandler(CanId::Extended(0x1FF00705), [](const CanFrame&) {});
    zassert_true(exact_id > 0);

    zassert_equal(
        canbus->RegisterFrameReceivedHandler(TargetFilter(0x07), [](const CanFrame&) {}), Canbus::ERR_FILTER_OVERLAP
    );

    zassert_true(canbus->RemoveFrameReceivedHandler(exact_id));
    const int mask_id = canbus->RegisterFrameReceivedHandler(TargetFilter(0x07), [](const CanFrame&) {});
    zassert_true(mask_id > 0, "The mask must be accepted once the covered id is gone");

    zassert_true(canbus->RemoveFrameReceivedHandler(mask_id));
}

ZTEST(canbus_filters, test_identical_mask_filters_share_a_registration) {
    auto canbus = MakeRunningCanbus();
    FrameCollector first;
    FrameCollector second;

    // Bits outside the mask are irrelevant, so this is the same filter.
    const CanFilter same_filter = CanFilter::Masked(CanId::Extended(0x1FF007AB), TARGET_MASK);

    const int first_id = canbus->RegisterFrameReceivedHandler(TargetFilter(0x07), [&](const CanFrame& f) {
        first.Collect(f);
    });
    const int second_id = canbus->RegisterFrameReceivedHandler(same_filter, [&](const CanFrame& f) {
        second.Collect(f);
    });
    zassert_true(first_id > 0);
    zassert_true(second_id > 0);

    zassert_ok(canbus->SendFrame(CanId::Extended(0x1FF00701), PAYLOAD));
    zassert_true(first.Wait());
    zassert_true(second.Wait());

    zassert_true(canbus->RemoveFrameReceivedHandler(first_id));

    zassert_ok(canbus->SendFrame(CanId::Extended(0x1FF00702), PAYLOAD));
    zassert_true(second.Wait(), "The remaining handler must keep receiving");
    zassert_false(first.Wait(200), "A removed handler must not be invoked");

    zassert_true(canbus->RemoveFrameReceivedHandler(second_id));

    FrameCollector third;
    const int third_id = canbus->RegisterFrameReceivedHandler(TargetFilter(0x07), [&](const CanFrame& f) {
        third.Collect(f);
    });
    zassert_true(third_id > 0, "The filter must be registrable again after the last handler is gone");

    zassert_ok(canbus->SendFrame(CanId::Extended(0x1FF00703), PAYLOAD));
    zassert_true(third.Wait());

    zassert_true(canbus->RemoveFrameReceivedHandler(third_id));
}

ZTEST(canbus_filters, test_mask_filter_limit_is_enforced) {
    auto canbus = MakeRunningCanbus();

    std::array<int, Canbus::MAX_MASK_FILTERS> ids{};
    for(size_t i = 0; i < ids.size(); i++) {
        ids[i] = canbus->RegisterFrameReceivedHandler(TargetFilter(static_cast<uint8_t>(i + 1)), [](const CanFrame&) {
        });
        zassert_true(ids[i] > 0, "Mask filter %zu should have been accepted", i);
    }

    const CanFilter extra = TargetFilter(static_cast<uint8_t>(Canbus::MAX_MASK_FILTERS + 1));
    zassert_equal(canbus->RegisterFrameReceivedHandler(extra, [](const CanFrame&) {}), Canbus::ERR_TOO_MANY_FILTERS);

    zassert_true(canbus->RemoveFrameReceivedHandler(ids[0]));
    const int extra_id = canbus->RegisterFrameReceivedHandler(extra, [](const CanFrame&) {});
    zassert_true(extra_id > 0, "A freed mask slot must be reusable");

    zassert_true(canbus->RemoveFrameReceivedHandler(extra_id));
    for(size_t i = 1; i < ids.size(); i++)
        zassert_true(canbus->RemoveFrameReceivedHandler(ids[i]));
}

ZTEST(canbus_filters, test_invalid_ids_and_filters_are_rejected) {
    auto canbus = MakeRunningCanbus();

    zassert_equal(
        canbus->RegisterFrameReceivedHandler(CanId::Standard(0x800), [](const CanFrame&) {}),
        Canbus::ERR_INVALID_ARGUMENT
    );
    zassert_equal(
        canbus->RegisterFrameReceivedHandler(CanId::Extended(0x20000000), [](const CanFrame&) {}),
        Canbus::ERR_INVALID_ARGUMENT
    );
    zassert_equal(
        canbus->RegisterFrameReceivedHandler(CanFilter::Masked(CanId::Standard(0x100), 0xFFF), [](const CanFrame&) {}),
        Canbus::ERR_INVALID_ARGUMENT, "A mask wider than the id format must be rejected"
    );

    zassert_equal(canbus->SendFrame(CanId::Standard(0x800), PAYLOAD), -EINVAL);
    zassert_equal(canbus->SendFrame(CanId::Extended(0x20000000), PAYLOAD), -EINVAL);
}

ZTEST(canbus_filters, test_mask_filter_is_deferred_during_auto_detect) {
    // Bitrate 0 selects auto detection, which never completes on the silent loopback bus.
    auto canbus = std::make_unique<Canbus>(MakeConfig(CanbusType::CLASSICAL_CAN, 0));

    zassert_true(canbus->Initialize());
    zassert_true(canbus->Start());
    zassert_false(canbus->IsBitrateDetected());

    const int id = canbus->RegisterFrameReceivedHandler(TargetFilter(0x07), [](const CanFrame&) {});
    zassert_true(id > 0, "A deferred mask handler must still return a usable id, got %d", id);
    zassert_true(canbus->RemoveFrameReceivedHandler(id));

    zassert_true(canbus->Stop());
}
```

## src/canbus_send.cpp
```c
#include <array>
#include <climits>
#include <cstdint>

#include <zephyr/kernel.h>
#include <zephyr/ztest.h>

#include "canbus_test_support.h"

using namespace canbus_test;

using eerie_leap::subsys::canbus::CanId;

namespace {

constexpr std::array<uint8_t, 1> PAYLOAD = { 0x01 };
constexpr CanId FILL_ID = CanId::Standard(0x7F2);

// Parks the loopback TX thread in a TX-complete callback, which runs outside the
// driver's filter lock, so queued frames stay queued until Release().
k_sem tx_release;

void BlockingTxCallback(const device*, int, void* user_data) {
    k_sem_take(static_cast<k_sem*>(user_data), K_SECONDS(10));
}

bool BlockTxThread() {
    k_sem_reset(&tx_release);

    const can_frame frame = { .id = 0x7F0, .dlc = 0, .flags = 0 };
    if(can_send(LoopbackDevice(), &frame, K_NO_WAIT, BlockingTxCallback, &tx_release) != 0)
        return false;

    // Let the TX thread take the frame and park in the callback.
    k_sleep(K_MSEC(20));

    return true;
}

void ReleaseTxThread() {
    k_sem_give(&tx_release);
}

int FillTxQueue(Canbus& canbus) {
    int result = 0;
    for(int i = 0; i < 256 && result == 0; i++)
        result = canbus.SendFrame(FILL_ID, PAYLOAD, K_NO_WAIT);

    return result;
}

void* SetupSuite() {
    k_sem_init(&tx_release, 0, 1);

    return nullptr;
}

void AfterTest(void* fixture) {
    ReleaseTxThread();
    ResetLoopbackDevice(fixture);
}

K_THREAD_STACK_DEFINE(sender_stack, 4096);
k_thread sender_thread;
atomic_t sender_result;

constexpr atomic_val_t SENDER_PENDING = INT_MIN;

void SendWithLongTimeout(void* canbus, void*, void*) {
    atomic_set(&sender_result, static_cast<Canbus*>(canbus)->SendFrame(FILL_ID, PAYLOAD, K_SECONDS(5)));
}

} // namespace

ZTEST_SUITE(canbus_send, NULL, SetupSuite, NULL, AfterTest, NULL);

ZTEST(canbus_send, test_full_tx_queue_returns_eagain) {
    auto canbus = MakeRunningCanbus();

    zassert_true(BlockTxThread());
    zassert_equal(FillTxQueue(*canbus), -EAGAIN, "A full TX queue must report -EAGAIN without blocking");

    ReleaseTxThread();
}

ZTEST(canbus_send, test_blocked_send_does_not_hold_the_bus_lock) {
    auto canbus = MakeRunningCanbus();

    zassert_true(BlockTxThread());
    zassert_equal(FillTxQueue(*canbus), -EAGAIN);

    atomic_set(&sender_result, SENDER_PENDING);
    k_thread_create(
        &sender_thread, sender_stack, K_THREAD_STACK_SIZEOF(sender_stack), SendWithLongTimeout, canbus.get(), nullptr,
        nullptr, K_PRIO_PREEMPT(5), 0, K_NO_WAIT
    );

    // Let the sender enter can_send() and wait for a TX slot.
    k_sleep(K_MSEC(20));

    const int64_t start = k_uptime_get();
    const int id = canbus->RegisterFrameReceivedHandler(CanId::Standard(0x7F3), [](const CanFrame&) {});
    const int64_t elapsed = k_uptime_get() - start;

    zassert_true(id > 0);
    zassert_equal(atomic_get(&sender_result), SENDER_PENDING, "The sender must still be waiting for a TX slot");
    zassert_true(elapsed < 100, "Registration waited %lld ms behind a blocked sender", elapsed);

    ReleaseTxThread();

    zassert_ok(k_thread_join(&sender_thread, K_SECONDS(2)));
    zassert_ok(atomic_get(&sender_result), "The blocked send must complete once the queue drains");

    zassert_true(canbus->RemoveFrameReceivedHandler(id));
}

ZTEST(canbus_send, test_send_before_initialize_reports_network_down) {
    Canbus canbus(MakeConfig());

    zassert_equal(canbus.SendFrame(CanId::Standard(0x100), PAYLOAD), -ENETDOWN);
}

ZTEST(canbus_send, test_explicit_timeout_send_succeeds) {
    auto canbus = MakeRunningCanbus();
    FrameCollector collector;

    zassert_true(canbus->RegisterFrameReceivedHandler(CanId::Standard(0x7F4), [&](const CanFrame& f) {
        collector.Collect(f);
    }) > 0);

    zassert_ok(canbus->SendFrame(CanId::Standard(0x7F4), PAYLOAD, K_NO_WAIT));
    zassert_true(collector.Wait());
}
```

## src/canbus_send_frame.cpp
```c
#include <algorithm>
#include <array>
#include <cstddef>
#include <cstdint>
#include <memory>
#include <span>
#include <vector>

#include <zephyr/kernel.h>
#include <zephyr/ztest.h>

#include "canbus_test_support.h"

using namespace canbus_test;

using eerie_leap::subsys::canbus::CanId;
using eerie_leap::subsys::canbus::ICanFrameTap;

namespace {

/// The payload bytes a DLC carries, spelled out so the tests don't lean on can_dlc_to_bytes.
constexpr std::array<size_t, 16> FD_LENGTHS = { 0, 1, 2, 3, 4, 5, 6, 7, 8, 12, 16, 20, 24, 32, 48, 64 };

constexpr uint32_t STD_ID = 0x123;
constexpr uint32_t EXT_ID = 0x18FF0042;

std::vector<uint8_t> MakePayload(size_t size, uint8_t seed = 1) {
    std::vector<uint8_t> payload(size);
    for(size_t i = 0; i < size; ++i)
        payload[i] = static_cast<uint8_t>(seed + (i * 7));

    return payload;
}

bool IsFdLength(size_t size) {
    return std::ranges::any_of(FD_LENGTHS, [size](size_t length) {
        return length == size;
    });
}

CanFrame MakeFrame(uint32_t id, bool ide, std::span<const uint8_t> payload = {}) {
    CanFrame frame;
    frame.id = id;
    frame.is_extended = ide;
    frame.data.Assign(payload);

    return frame;
}

CanFrame MakeFdFrame(uint32_t id, bool ide, bool brs, std::span<const uint8_t> payload) {
    CanFrame frame = MakeFrame(id, ide, payload);
    frame.is_can_fd = true;
    frame.is_bitrate_switch = brs;

    return frame;
}

CanFrame MakeRemoteFrame(uint32_t id, bool ide, uint8_t dlc) {
    CanFrame frame = MakeFrame(id, ide);
    frame.is_remote_request = true;
    frame.dlc = dlc;

    return frame;
}

uint8_t FlagsOf(bool ide, bool fdf, bool brs, bool rtr) {
    uint8_t flags = 0;
    if(ide)
        flags |= CAN_FRAME_IDE;
    if(fdf)
        flags |= CAN_FRAME_FDF;
    if(brs)
        flags |= CAN_FRAME_BRS;
    if(rtr)
        flags |= CAN_FRAME_RTR;

    return flags;
}

// Takes what the controller delivers straight from the driver, so the flags are the wire's and no
// Canbus handler (which never sees a remote frame and rebuilds the frame) is in between. A failing
// assertion unwinds past destructors, so the suite's after-hook calls Stop().
class RawReceiver {
private:
    k_mutex lock_{};
    k_sem semaphore_{};
    std::vector<can_frame> frames_;
    std::array<int, 2> filter_ids_ = { -1, -1 };

    static void OnFrame(const device*, can_frame* frame, void* user_data) {
        auto* self = static_cast<RawReceiver*>(user_data);

        k_mutex_lock(&self->lock_, K_FOREVER);
        self->frames_.push_back(*frame);
        k_mutex_unlock(&self->lock_);

        k_sem_give(&self->semaphore_);
    }

public:
    // Not a constructor: the kernel objects are set up by the suite, not by static initialization.
    void Init() {
        k_mutex_init(&lock_);
        k_sem_init(&semaphore_, 0, K_SEM_MAX_LIMIT);
    }

    void Start() {
        Stop();

        const can_filter standard = { .id = 0, .mask = 0, .flags = 0 };
        const can_filter extended = { .id = 0, .mask = 0, .flags = CAN_FILTER_IDE };

        filter_ids_[0] = can_add_rx_filter(LoopbackDevice(), OnFrame, this, &standard);
        filter_ids_[1] = can_add_rx_filter(LoopbackDevice(), OnFrame, this, &extended);
        zassert_true(filter_ids_[0] >= 0 && filter_ids_[1] >= 0, "The loopback has no filters left");
    }

    void Stop() {
        for(int& id : filter_ids_) {
            if(id >= 0)
                can_remove_rx_filter(LoopbackDevice(), id);

            id = -1;
        }

        k_mutex_lock(&lock_, K_FOREVER);
        frames_.clear();
        k_mutex_unlock(&lock_);

        k_sem_reset(&semaphore_);
    }

    bool Wait(int timeout_ms = 500) {
        return k_sem_take(&semaphore_, K_MSEC(timeout_ms)) == 0;
    }

    size_t Count() {
        k_mutex_lock(&lock_, K_FOREVER);
        const size_t count = frames_.size();
        k_mutex_unlock(&lock_);

        return count;
    }

    can_frame At(size_t index) {
        k_mutex_lock(&lock_, K_FOREVER);
        const can_frame frame = frames_.at(index);
        k_mutex_unlock(&lock_);

        return frame;
    }

    // The frame that arrives for a send that must succeed.
    can_frame SendAndReceive(const Canbus& canbus, const CanFrame& frame) {
        const size_t before = Count();

        zassert_ok(canbus.SendFrame(frame, K_MSEC(100)), "Frame 0x%x was refused", frame.id);
        zassert_true(Wait(), "Frame 0x%x did not arrive", frame.id);
        zassert_equal(Count(), before + 1);

        return At(before);
    }

    // A send that must be refused with -EINVAL, and put nothing on the bus.
    void ExpectRefused(const Canbus& canbus, const CanFrame& frame, const char* what) {
        const size_t before = Count();

        zassert_equal(canbus.SendFrame(frame, K_MSEC(100)), -EINVAL, "%s was not refused", what);
        k_sleep(K_MSEC(20));
        zassert_equal(Count(), before, "%s reached the bus", what);
    }
};

RawReceiver receiver;

void* SetupSuite() {
    receiver.Init();

    return nullptr;
}

void AfterTest(void* fixture) {
    receiver.Stop();
    ResetLoopbackDevice(fixture);
}

void ExpectFrame(
    const can_frame& raw,
    uint32_t id,
    uint8_t flags,
    uint8_t dlc,
    std::span<const uint8_t> payload,
    const char* what
) {
    zassert_equal(raw.id, id, "%s: ID 0x%x", what, raw.id);
    zassert_equal(raw.flags, flags, "%s: flags 0x%02x, expected 0x%02x", what, raw.flags, flags);
    zassert_equal(raw.dlc, dlc, "%s: DLC %u, expected %u", what, raw.dlc, dlc);

    for(size_t i = 0; i < payload.size(); ++i)
        zassert_equal(raw.data[i], payload[i], "%s: byte %zu", what, i);
}

// Sees the unit's own frames and the loopback's copies of them.
class EchoTap : public ICanFrameTap {
private:
    k_mutex lock_{};
    std::vector<CanFrame> echoes_;

public:
    EchoTap() {
        k_mutex_init(&lock_);
    }

    void OnFrame(const CanFrame& frame, uint64_t, bool is_transmit, int tx_error) override {
        if(!is_transmit || tx_error != 0)
            return;

        k_mutex_lock(&lock_, K_FOREVER);
        echoes_.push_back(frame);
        k_mutex_unlock(&lock_);
    }

    void OnState(can_state, can_bus_err_cnt, uint64_t) override {}
    void OnFilterSwap(bool, uint64_t) override {}

    std::vector<CanFrame> Echoes() {
        k_mutex_lock(&lock_, K_FOREVER);
        std::vector<CanFrame> copy = echoes_;
        k_mutex_unlock(&lock_);

        return copy;
    }
};

bool WaitForEchoes(EchoTap& tap, size_t count) {
    for(int waited = 0; waited <= 2000; waited += 5) {
        if(tap.Echoes().size() >= count)
            return true;

        k_sleep(K_MSEC(5));
    }

    return false;
}

} // namespace

ZTEST_SUITE(canbus_send_frame, NULL, SetupSuite, NULL, AfterTest, NULL);

ZTEST(canbus_send_frame, test_classical_frames_arrive_with_their_flags_dlc_and_payload) {
    auto canbus = MakeRunningCanbus();
    receiver.Start();

    for(const bool ide : { false, true }) {
        const uint32_t id = ide ? EXT_ID : STD_ID;

        for(size_t size = 0; size <= 8; ++size) {
            const auto payload = MakePayload(size, static_cast<uint8_t>(size + 1));
            const can_frame raw = receiver.SendAndReceive(*canbus, MakeFrame(id, ide, payload));

            ExpectFrame(raw, id, FlagsOf(ide, false, false, false), static_cast<uint8_t>(size), payload, "classical");
        }
    }
}

ZTEST(canbus_send_frame, test_remote_frames_arrive_with_their_dlc_and_no_payload) {
    auto canbus = MakeRunningCanbus();
    receiver.Start();

    for(const bool ide : { false, true }) {
        const uint32_t id = ide ? EXT_ID : STD_ID;

        for(uint8_t dlc = 0; dlc <= 8; ++dlc) {
            const can_frame raw = receiver.SendAndReceive(*canbus, MakeRemoteFrame(id, ide, dlc));

            ExpectFrame(raw, id, FlagsOf(ide, false, false, true), dlc, {}, "remote");
        }
    }
}

ZTEST(canbus_send_frame, test_fd_frames_arrive_with_and_without_brs_in_every_length) {
    auto canbus = MakeRunningCanbus(CanbusType::CANFD);
    receiver.Start();

    for(const bool ide : { false, true }) {
        const uint32_t id = ide ? EXT_ID : STD_ID;

        for(const bool brs : { false, true }) {
            for(size_t dlc = 0; dlc < FD_LENGTHS.size(); ++dlc) {
                const auto payload = MakePayload(FD_LENGTHS[dlc], static_cast<uint8_t>(dlc + 1));
                const can_frame raw = receiver.SendAndReceive(*canbus, MakeFdFrame(id, ide, brs, payload));

                ExpectFrame(raw, id, FlagsOf(ide, true, brs, false), static_cast<uint8_t>(dlc), payload, "FD");
            }
        }
    }
}

ZTEST(canbus_send_frame, test_an_fd_channel_also_sends_classical_and_remote_frames) {
    auto canbus = MakeRunningCanbus(CanbusType::CANFD);
    receiver.Start();

    const auto payload = MakePayload(8);

    ExpectFrame(
        receiver.SendAndReceive(*canbus, MakeFrame(STD_ID, false, payload)), STD_ID, 0, 8, payload,
        "classical on an FD channel"
    );
    ExpectFrame(
        receiver.SendAndReceive(*canbus, MakeFrame(EXT_ID, true, payload)), EXT_ID, CAN_FRAME_IDE, 8, payload,
        "classical, 29-bit, on an FD channel"
    );
    ExpectFrame(
        receiver.SendAndReceive(*canbus, MakeRemoteFrame(STD_ID, false, 3)), STD_ID, CAN_FRAME_RTR, 3, {},
        "remote on an FD channel"
    );
}

ZTEST(canbus_send_frame, test_the_error_state_indicator_is_never_sent) {
    auto canbus = MakeRunningCanbus(CanbusType::CANFD);
    receiver.Start();

    const auto payload = MakePayload(12);
    CanFrame fd_frame = MakeFdFrame(STD_ID, false, true, payload);
    fd_frame.is_error_state_indicator = true;
    fd_frame.is_transmit = true;

    ExpectFrame(
        receiver.SendAndReceive(*canbus, fd_frame), STD_ID, FlagsOf(false, true, true, false), 9, payload,
        "FD frame with ESI set"
    );
}

ZTEST(canbus_send_frame, test_a_frame_the_channel_cannot_carry_is_refused) {
    auto canbus = MakeRunningCanbus();
    receiver.Start();

    receiver.ExpectRefused(*canbus, MakeFdFrame(STD_ID, false, false, MakePayload(8)), "FD frame, classical channel");
    receiver.ExpectRefused(
        *canbus, MakeFdFrame(STD_ID, false, true, MakePayload(8)), "FD+BRS frame, classical channel"
    );
    receiver.ExpectRefused(*canbus, MakeFdFrame(STD_ID, false, false, {}), "empty FD frame, classical channel");
}

ZTEST(canbus_send_frame, test_malformed_flag_combinations_are_refused) {
    for(const CanbusType type : { CanbusType::CLASSICAL_CAN, CanbusType::CANFD }) {
        auto canbus = MakeRunningCanbus(type);
        receiver.Start();

        CanFrame brs_without_fdf = MakeFrame(STD_ID, false, MakePayload(4));
        brs_without_fdf.is_bitrate_switch = true;
        receiver.ExpectRefused(*canbus, brs_without_fdf, "BRS without FDF");

        CanFrame remote_brs = MakeRemoteFrame(STD_ID, false, 2);
        remote_brs.is_bitrate_switch = true;
        receiver.ExpectRefused(*canbus, remote_brs, "BRS on a remote frame");

        CanFrame remote_with_payload = MakeRemoteFrame(STD_ID, false, 2);
        remote_with_payload.data.Assign(MakePayload(2));
        receiver.ExpectRefused(*canbus, remote_with_payload, "remote frame with a payload");

        receiver.ExpectRefused(*canbus, MakeRemoteFrame(STD_ID, false, 9), "remote frame with DLC 9");
        receiver.ExpectRefused(*canbus, MakeRemoteFrame(STD_ID, false, 15), "remote frame with DLC 15");

        // CAN FD has no remote frames.
        CanFrame fd_remote = MakeRemoteFrame(STD_ID, false, 2);
        fd_remote.is_can_fd = true;
        receiver.ExpectRefused(*canbus, fd_remote, "remote FD frame");

        receiver.Stop();
        canbus.reset();
    }
}

ZTEST(canbus_send_frame, test_more_than_eight_bytes_without_fdf_are_refused) {
    for(const CanbusType type : { CanbusType::CLASSICAL_CAN, CanbusType::CANFD }) {
        auto canbus = MakeRunningCanbus(type);
        receiver.Start();

        for(const size_t size : { 9U, 12U, 64U })
            receiver.ExpectRefused(
                *canbus, MakeFrame(STD_ID, false, MakePayload(size)), "classical frame over 8 bytes"
            );

        receiver.Stop();
        canbus.reset();
    }
}

ZTEST(canbus_send_frame, test_an_fd_length_no_dlc_gives_is_refused) {
    auto canbus = MakeRunningCanbus(CanbusType::CANFD);
    receiver.Start();

    for(size_t size = 0; size <= 64; ++size) {
        if(IsFdLength(size))
            continue;

        receiver.ExpectRefused(*canbus, MakeFdFrame(STD_ID, false, true, MakePayload(size)), "FD length with no DLC");
    }

    // The neighbours on either side of a refused length still go.
    const auto payload = MakePayload(12);
    ExpectFrame(
        receiver.SendAndReceive(*canbus, MakeFdFrame(STD_ID, false, true, payload)), STD_ID,
        FlagsOf(false, true, true, false), 9, payload, "FD frame of 12 bytes"
    );
}

ZTEST(canbus_send_frame, test_an_identifier_that_does_not_fit_its_format_is_refused) {
    auto canbus = MakeRunningCanbus();
    receiver.Start();

    receiver.ExpectRefused(*canbus, MakeFrame(0x800, false, MakePayload(1)), "11-bit ID 0x800");
    receiver.ExpectRefused(*canbus, MakeFrame(0x20000000, true, MakePayload(1)), "29-bit ID 0x20000000");
    receiver.ExpectRefused(*canbus, MakeRemoteFrame(0x800, false, 1), "remote with 11-bit ID 0x800");

    // The widest of each format goes.
    ExpectFrame(
        receiver.SendAndReceive(*canbus, MakeFrame(0x7FF, false, MakePayload(1))), 0x7FF, 0, 1, MakePayload(1),
        "11-bit ID 0x7FF"
    );
    ExpectFrame(
        receiver.SendAndReceive(*canbus, MakeFrame(0x1FFFFFFF, true, MakePayload(1))), 0x1FFFFFFF, CAN_FRAME_IDE, 1,
        MakePayload(1), "29-bit ID 0x1FFFFFFF"
    );
}

ZTEST(canbus_send_frame, test_a_bus_that_does_not_run_answers_enetdown_before_anything_else) {
    Canbus canbus(MakeConfig());

    zassert_equal(canbus.SendFrame(MakeFrame(STD_ID, false, MakePayload(1))), -ENETDOWN);
    zassert_equal(
        canbus.SendFrame(MakeFdFrame(0x800, false, true, MakePayload(9))), -ENETDOWN,
        "A bus that is down says so before it judges the frame"
    );

    zassert_true(canbus.Initialize());
    zassert_equal(canbus.SendFrame(MakeFrame(STD_ID, false, MakePayload(1))), -ENETDOWN, "Initialized, not started");

    zassert_true(canbus.Start());
    zassert_ok(canbus.SendFrame(MakeFrame(STD_ID, false, MakePayload(1))));

    zassert_true(canbus.Stop());
    zassert_equal(canbus.SendFrame(MakeFrame(STD_ID, false, MakePayload(1))), -ENETDOWN);
}

ZTEST(canbus_send_frame, test_the_older_overload_sends_classical_frames_on_a_classical_channel) {
    auto canbus = MakeRunningCanbus();
    receiver.Start();

    const auto payload = MakePayload(5);

    zassert_ok(canbus->SendFrame(CanId::Standard(STD_ID), payload));
    zassert_true(receiver.Wait());
    ExpectFrame(receiver.At(0), STD_ID, 0, 5, payload, "older overload, 11-bit");

    zassert_ok(canbus->SendFrame(CanId::Extended(EXT_ID), payload));
    zassert_true(receiver.Wait());
    ExpectFrame(receiver.At(1), EXT_ID, CAN_FRAME_IDE, 5, payload, "older overload, 29-bit");

    const auto too_long = MakePayload(9);
    zassert_equal(canbus->SendFrame(CanId::Standard(STD_ID), too_long), -EINVAL);
    zassert_equal(canbus->SendFrame(CanId::Standard(0x800), payload), -EINVAL);
    k_sleep(K_MSEC(20));
    zassert_equal(receiver.Count(), 2);
}

ZTEST(canbus_send_frame, test_the_older_overload_makes_every_frame_on_an_fd_channel_an_fd_frame_with_brs) {
    auto canbus = MakeRunningCanbus(CanbusType::CANFD);
    receiver.Start();

    const auto four = MakePayload(4);
    zassert_ok(canbus->SendFrame(CanId::Standard(STD_ID), four));
    zassert_true(receiver.Wait());
    ExpectFrame(receiver.At(0), STD_ID, FlagsOf(false, true, true, false), 4, four, "older overload, FD, 4 bytes");

    zassert_ok(canbus->SendFrame(CanId::Extended(EXT_ID), four));
    zassert_true(receiver.Wait());
    ExpectFrame(receiver.At(1), EXT_ID, FlagsOf(true, true, true, false), 4, four, "older overload, FD, 29-bit");

    // 9 bytes have no DLC: the older overload rounds up to 12 and pads with zeros.
    const auto nine = MakePayload(9);
    zassert_ok(canbus->SendFrame(CanId::Standard(STD_ID), nine));
    zassert_true(receiver.Wait());

    std::vector<uint8_t> padded = nine;
    padded.resize(12, 0);
    ExpectFrame(receiver.At(2), STD_ID, FlagsOf(false, true, true, false), 9, padded, "older overload, FD, padded");

    const auto full = MakePayload(64);
    zassert_ok(canbus->SendFrame(CanId::Standard(STD_ID), full));
    zassert_true(receiver.Wait());
    ExpectFrame(receiver.At(3), STD_ID, FlagsOf(false, true, true, false), 15, full, "older overload, FD, 64 bytes");

    // Past 64 bytes it refuses instead of cutting the payload.
    const auto too_long = MakePayload(65);
    zassert_equal(canbus->SendFrame(CanId::Standard(STD_ID), too_long), -EINVAL);
    k_sleep(K_MSEC(20));
    zassert_equal(receiver.Count(), 4);
}

ZTEST(canbus_send_frame, test_a_tap_hears_the_frames_of_the_new_overload_as_transmitted_ones) {
    auto canbus = MakeRunningCanbus(CanbusType::CANFD);
    EchoTap tap;

    zassert_true(canbus->SetTap(&tap));

    const auto eight = MakePayload(8);
    const auto sixteen = MakePayload(16);

    zassert_ok(canbus->SendFrame(MakeFrame(STD_ID, false, eight)));
    zassert_ok(canbus->SendFrame(MakeRemoteFrame(EXT_ID, true, 5)));
    zassert_ok(canbus->SendFrame(MakeFdFrame(STD_ID, false, false, sixteen)));
    zassert_ok(canbus->SendFrame(MakeFdFrame(EXT_ID, true, true, sixteen)));
    zassert_true(WaitForEchoes(tap, 4));

    const std::vector<CanFrame> echoes = tap.Echoes();
    zassert_equal(echoes.size(), 4);

    // Classical, on an FD channel.
    zassert_equal(echoes[0].id, STD_ID);
    zassert_false(echoes[0].is_extended);
    zassert_false(echoes[0].is_can_fd);
    zassert_false(echoes[0].is_bitrate_switch);
    zassert_false(echoes[0].is_remote_request);
    zassert_equal(echoes[0].dlc, 8);
    zassert_equal(echoes[0].data.size(), 8);
    zassert_equal(echoes[0].data[7], eight[7]);

    // Remote.
    zassert_equal(echoes[1].id, EXT_ID);
    zassert_true(echoes[1].is_extended);
    zassert_true(echoes[1].is_remote_request);
    zassert_false(echoes[1].is_can_fd);
    zassert_equal(echoes[1].dlc, 5);
    zassert_true(echoes[1].data.empty());

    // FD without BRS.
    zassert_true(echoes[2].is_can_fd);
    zassert_false(echoes[2].is_bitrate_switch);
    zassert_equal(echoes[2].dlc, 10);
    zassert_equal(echoes[2].data.size(), 16);
    zassert_equal(echoes[2].data[15], sixteen[15]);

    // FD with BRS, 29-bit.
    zassert_true(echoes[3].is_extended);
    zassert_true(echoes[3].is_can_fd);
    zassert_true(echoes[3].is_bitrate_switch);
    zassert_equal(echoes[3].dlc, 10);
    zassert_equal(echoes[3].data[0], sixteen[0]);

    zassert_equal(canbus->GetTxEchoLostCount(), 0);

    // A frame refused for its flags takes no slot and leaves no echo.
    zassert_equal(canbus->SendFrame(MakeFdFrame(STD_ID, false, false, MakePayload(9))), -EINVAL);
    k_sleep(K_MSEC(50));
    zassert_equal(tap.Echoes().size(), 4);
    zassert_equal(canbus->GetTxEchoLostCount(), 0);

    zassert_true(canbus->SetTap(nullptr));
}
```

## src/canbus_test_support.h
```c
#pragma once

#include <cstdint>
#include <memory>
#include <vector>

#include <zephyr/device.h>
#include <zephyr/devicetree.h>
#include <zephyr/drivers/can.h>
#include <zephyr/kernel.h>
#include <zephyr/ztest.h>

#include "subsys/canbus/canbus.h"

namespace canbus_test {

using eerie_leap::subsys::canbus::Canbus;
using eerie_leap::subsys::canbus::CanbusConfig;
using eerie_leap::subsys::canbus::CanbusType;
using eerie_leap::subsys::canbus::CanFrame;

inline const device* LoopbackDevice() {
    return DEVICE_DT_GET(DT_NODELABEL(can_loopback0));
}

// A failing assertion unwinds past the destructors, so the shared loopback
// controller has to be forced back to a stopped state for the next test.
inline void ResetLoopbackDevice(void*) {
    can_stop(LoopbackDevice());
}

// The loopback controller only echoes frames back when it is in loopback mode.
inline CanbusConfig
MakeConfig(CanbusType type = CanbusType::CLASSICAL_CAN, uint32_t bitrate = 500000, uint32_t data_bitrate = 0) {

    return { LoopbackDevice(), type, bitrate, data_bitrate, CAN_MODE_LOOPBACK };
}

inline std::unique_ptr<Canbus>
MakeRunningCanbus(CanbusType type = CanbusType::CLASSICAL_CAN, uint32_t bitrate = 500000) {

    auto canbus = std::make_unique<Canbus>(MakeConfig(type, bitrate));

    zassert_true(canbus->Initialize(), "Canbus::Initialize() failed");
    zassert_true(canbus->Start(), "Canbus::Start() failed");

    return canbus;
}

// Collects frames delivered to a handler and lets a test block until one arrives.
class FrameCollector {
private:
    k_sem semaphore_{};
    k_mutex lock_{};
    std::vector<CanFrame> frames_;

public:
    FrameCollector() {
        k_sem_init(&semaphore_, 0, K_SEM_MAX_LIMIT);
        k_mutex_init(&lock_);
    }

    void Collect(const CanFrame& frame) {
        k_mutex_lock(&lock_, K_FOREVER);
        frames_.push_back(frame);
        k_mutex_unlock(&lock_);

        k_sem_give(&semaphore_);
    }

    [[nodiscard]] bool Wait(int timeout_ms = 500) {
        return k_sem_take(&semaphore_, K_MSEC(timeout_ms)) == 0;
    }

    [[nodiscard]] size_t Count() {
        k_mutex_lock(&lock_, K_FOREVER);
        const size_t count = frames_.size();
        k_mutex_unlock(&lock_);

        return count;
    }

    [[nodiscard]] CanFrame At(size_t index) {
        k_mutex_lock(&lock_, K_FOREVER);
        CanFrame frame = frames_.at(index);
        k_mutex_unlock(&lock_);

        return frame;
    }
};

} // namespace canbus_test
```
