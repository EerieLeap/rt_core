## CMakeLists.txt
```
cmake_minimum_required(VERSION 3.20.0)

set(RT_CORE_TEST_SIM_FLASH ON)
include(${CMAKE_CURRENT_SOURCE_DIR}/../../../rt_core_test.cmake)

find_package(Zephyr REQUIRED HINTS $ENV{ZEPHYR_BASE})
project(functional_subsys_fs)

file(GLOB_RECURSE TEST_SOURCES src/*.c src/*.cpp)

target_sources(app PRIVATE ${TEST_SOURCES})
```

## prj.conf
```kconfig
CONFIG_ZTEST=y

# Language and Compiler
CONFIG_CPP=y
CONFIG_PICOLIBC=y
CONFIG_STD_CPP23=y
CONFIG_REQUIRES_FULL_LIBCPP=y
CONFIG_CPP_EXCEPTIONS=y
CONFIG_CPP_RTTI=y

# Logging And Debugging
CONFIG_THREAD_ANALYZER=y
CONFIG_THREAD_NAME=y
CONFIG_SYS_HEAP_RUNTIME_STATS=y
CONFIG_TIMING_FUNCTIONS=y

# Memory
CONFIG_HEAP_MEM_POOL_SIZE=100000

# C++ exception unwinding needs considerably more stack than the ztest defaults.
CONFIG_MAIN_STACK_SIZE=8192
CONFIG_ZTEST_STACK_SIZE=8192

# Logging And Debugging
CONFIG_LOG=y

# FS Config
CONFIG_FLASH=y
CONFIG_FLASH_MAP=y
CONFIG_FILE_SYSTEM=y
CONFIG_FILE_SYSTEM_LITTLEFS=y
CONFIG_FILE_SYSTEM_MKFS=y

# SdmmcService queries the disk it was given; emulated targets register none.
CONFIG_DISK_ACCESS=y

# SdmmcService monitor thread. ThreadBase::InitializeStack() falls back to k_thread_stack_alloc().
CONFIG_THREAD_STACK_INFO=y
CONFIG_DYNAMIC_THREAD=y
CONFIG_DYNAMIC_THREAD_ALLOC=y
CONFIG_EERIE_LEAP_FS_SD_THREAD_STACK_SIZE=4096
CONFIG_EERIE_LEAP_SD_CHECK_INTERVAL_MS=50

CONFIG_EERIE_LEAP_RT_CORE=y
CONFIG_EERIE_LEAP_DEVICE_TREE=y
CONFIG_EERIE_LEAP_FS=y
CONFIG_EERIE_LEAP_THREADING=y
```

## src/fs_service_stream_buf.cpp
```c
#include <array>
#include <ios>
#include <istream>
#include <ostream>
#include <stdexcept>
#include <string>
#include <system_error>

#include <zephyr/ztest.h>

#include "subsys/fs/services/fs_service_stream_buf.h"

#include "fs_test_support.h"

using eerie_leap::subsys::fs::services::FsServiceStreamBuf;

using fs_test::GetFsService;
using fs_test::MakeText;
using fs_test::ReadText;
using fs_test::ResetFs;
using fs_test::WriteText;

using OpenMode = FsServiceStreamBuf::OpenMode;

ZTEST_SUITE(fs_service_stream_buf, NULL, NULL, ResetFs, ResetFs, NULL);

// Any other exception type propagates so an unexpected failure is not mistaken for the expected one.
template<typename Exception>
static bool Throws(auto&& action) {
    try {
        action();
    } catch(const Exception&) {
        return true;
    }

    return false;
}

ZTEST(fs_service_stream_buf, test_constructor_rejects_null_service) {
    zassert_true(Throws<std::invalid_argument>([] {
        FsServiceStreamBuf stream_buf(nullptr, "test_null_service.txt", OpenMode::Write);
    }));
}

ZTEST(fs_service_stream_buf, test_constructor_fails_for_missing_file) {
    zassert_true(Throws<std::system_error>([] {
        FsServiceStreamBuf stream_buf(GetFsService(), "test_missing_file.txt", OpenMode::Read);
    }));
}

ZTEST(fs_service_stream_buf, test_constructor_rejects_paths_longer_than_the_buffer) {
    zassert_true(Throws<std::invalid_argument>([] {
        FsServiceStreamBuf stream_buf(GetFsService(), std::string(300, 'a'), OpenMode::Write);
    }));
}

ZTEST(fs_service_stream_buf, test_constructor_rejects_traversal) {
    zassert_true(Throws<std::system_error>([] {
        FsServiceStreamBuf stream_buf(GetFsService(), "../test_traversal.txt", OpenMode::Write);
    }));
}

// The parent cannot be created when a file already occupies part of its path.
ZTEST(fs_service_stream_buf, test_constructor_reports_unusable_parent_directory) {
    zassert_true(WriteText("test_parent_is_a_file", "abc"));

    zassert_true(Throws<std::system_error>([] {
        FsServiceStreamBuf stream_buf(GetFsService(), "test_parent_is_a_file/sub/log.txt", OpenMode::Write);
    }));
}

ZTEST(fs_service_stream_buf, test_close_is_idempotent) {
    FsServiceStreamBuf stream_buf(GetFsService(), "test_close.txt", OpenMode::Write);

    zassert_true(stream_buf.is_open());
    zassert_true(stream_buf.close());
    zassert_false(stream_buf.is_open());
    zassert_true(stream_buf.close());
}

ZTEST(fs_service_stream_buf, test_write_creates_missing_parent_directories) {
    auto* fs_service = GetFsService();

    {
        FsServiceStreamBuf stream_buf(fs_service, "test_logs/2026/run.txt", OpenMode::Write);
        std::ostream stream(&stream_buf);

        stream << "entry";
    }

    zassert_true(fs_service->Exists("test_logs/2026"));
    zassert_str_equal(ReadText("test_logs/2026/run.txt").c_str(), "entry");
}

ZTEST(fs_service_stream_buf, test_destructor_closes_the_file) {
    auto* fs_service = GetFsService();
    const std::string file_path = "test_destructor.txt";

    {
        FsServiceStreamBuf stream_buf(fs_service, file_path, OpenMode::Write);
        std::ostream stream(&stream_buf);

        stream << "written";
    }

    zassert_equal(fs_service->GetFileSize(file_path).value(), 7);
    zassert_str_equal(ReadText(file_path).c_str(), "written");
}

ZTEST(fs_service_stream_buf, test_write_mode_truncates_existing_file) {
    auto* fs_service = GetFsService();
    const std::string file_path = "test_truncate.txt";

    zassert_true(WriteText(file_path, "0123456789"));

    {
        FsServiceStreamBuf stream_buf(fs_service, file_path, OpenMode::Write);
        std::ostream stream(&stream_buf);

        stream << "abc";
    }

    zassert_equal(fs_service->GetFileSize(file_path).value(), 3);
    zassert_str_equal(ReadText(file_path).c_str(), "abc");
}

ZTEST(fs_service_stream_buf, test_append_mode_keeps_existing_content) {
    auto* fs_service = GetFsService();
    const std::string file_path = "test_append.txt";

    zassert_true(WriteText(file_path, "abc"));

    {
        FsServiceStreamBuf stream_buf(fs_service, file_path, OpenMode::Append);
        std::ostream stream(&stream_buf);

        stream << "def";
    }

    zassert_str_equal(ReadText(file_path).c_str(), "abcdef");
}

ZTEST(fs_service_stream_buf, test_overflow_writes_single_character) {
    auto* fs_service = GetFsService();
    const std::string file_path = "test_overflow.txt";

    FsServiceStreamBuf stream_buf(fs_service, file_path, OpenMode::Write);

    zassert_equal(stream_buf.sputc('x'), 'x');
    zassert_true(stream_buf.close());

    zassert_str_equal(ReadText(file_path).c_str(), "x");
}

ZTEST(fs_service_stream_buf, test_sync_flushes_written_data) {
    auto* fs_service = GetFsService();
    const std::string file_path = "test_sync.txt";

    FsServiceStreamBuf stream_buf(fs_service, file_path, OpenMode::Write);
    std::ostream stream(&stream_buf);

    stream << "abc";

    zassert_equal(stream_buf.pubsync(), 0);
    zassert_equal(fs_service->GetFileSize(file_path).value(), 3);
}

ZTEST(fs_service_stream_buf, test_read_returns_whole_file) {
    auto* fs_service = GetFsService();
    const std::string file_path = "test_read.bin";

    // Larger than the internal read buffer so a single request cannot be served from it.
    const auto content = MakeText(10000);
    zassert_true(WriteText(file_path, content));

    FsServiceStreamBuf stream_buf(fs_service, file_path, OpenMode::Read);
    std::istream stream(&stream_buf);

    std::string read_back(content.size(), '\0');
    stream.read(read_back.data(), static_cast<std::streamsize>(read_back.size()));

    zassert_equal(static_cast<size_t>(stream.gcount()), content.size());
    zassert_true(read_back == content);
}

ZTEST(fs_service_stream_buf, test_underflow_refills_the_read_buffer) {
    auto* fs_service = GetFsService();
    const std::string file_path = "test_underflow.bin";

    const auto content = MakeText(9000);
    zassert_true(WriteText(file_path, content));

    FsServiceStreamBuf stream_buf(fs_service, file_path, OpenMode::Read);
    std::istream stream(&stream_buf);

    std::string read_back;
    read_back.reserve(content.size());

    char character = 0;
    while(stream.get(character))
        read_back.push_back(character);

    zassert_true(stream.eof());
    zassert_true(read_back == content);
}

// Mirrors how the MDF writer patches the header once the payload length is known.
ZTEST(fs_service_stream_buf, test_seek_rewrites_beginning_of_file) {
    auto* fs_service = GetFsService();
    const std::string file_path = "test_seek_rewrite.txt";

    {
        FsServiceStreamBuf stream_buf(fs_service, file_path, OpenMode::Write);
        std::ostream stream(&stream_buf);

        stream << "0000567";
        stream.seekp(0);
        stream << "1234";

        zassert_true(stream.good());
    }

    zassert_str_equal(ReadText(file_path).c_str(), "1234567");
}

ZTEST(fs_service_stream_buf, test_seek_from_end_reports_file_size) {
    auto* fs_service = GetFsService();
    const std::string file_path = "test_seek_end.txt";

    zassert_true(WriteText(file_path, "0123456789"));

    FsServiceStreamBuf stream_buf(fs_service, file_path, OpenMode::Read);

    const auto end_position = stream_buf.pubseekoff(0, std::ios_base::end, std::ios_base::in);
    zassert_equal(static_cast<std::streamoff>(end_position), 10);

    const auto tail_position = stream_buf.pubseekoff(-4, std::ios_base::end, std::ios_base::in);
    zassert_equal(static_cast<std::streamoff>(tail_position), 6);

    std::array<char, 4> tail = {};
    zassert_equal(stream_buf.sgetn(tail.data(), tail.size()), 4);
    zassert_mem_equal(tail.data(), "6789", tail.size());
}

ZTEST(fs_service_stream_buf, test_seek_to_position_restarts_reading) {
    auto* fs_service = GetFsService();
    const std::string file_path = "test_seek_pos.txt";

    zassert_true(WriteText(file_path, "0123456789"));

    FsServiceStreamBuf stream_buf(fs_service, file_path, OpenMode::Read);

    zassert_equal(stream_buf.sbumpc(), '0');

    const auto position = stream_buf.pubseekpos(4, std::ios_base::in);
    zassert_equal(static_cast<std::streamoff>(position), 4);
    zassert_equal(stream_buf.sbumpc(), '4');
}

// The buffer filled by underflow() must not be skipped by the bulk read path.
ZTEST(fs_service_stream_buf, test_buffered_and_bulk_reads_stay_in_sync) {
    auto* fs_service = GetFsService();
    const std::string file_path = "test_mixed_reads.bin";

    auto content = MakeText(6000);
    zassert_true(WriteText(file_path, content));

    FsServiceStreamBuf stream_buf(fs_service, file_path, OpenMode::Read);
    std::istream stream(&stream_buf);

    char first = 0;
    zassert_true(static_cast<bool>(stream.get(first)));
    zassert_equal(first, content[0]);

    std::string read_back(content.size() - 1, '\0');
    stream.read(read_back.data(), static_cast<std::streamsize>(read_back.size()));

    zassert_equal(static_cast<size_t>(stream.gcount()), read_back.size());
    zassert_true(read_back == content.substr(1));
}

// The reported position has to account for the bytes still sitting in the read buffer.
// std::istream::seekg is not linkable on every supported platform, hence the streambuf API.
ZTEST(fs_service_stream_buf, test_seek_from_current_accounts_for_the_read_buffer) {
    auto* fs_service = GetFsService();
    const std::string file_path = "test_seek_cur.bin";

    auto content = MakeText(6000);
    zassert_true(WriteText(file_path, content));

    FsServiceStreamBuf stream_buf(fs_service, file_path, OpenMode::Read);

    zassert_equal(static_cast<std::streamoff>(stream_buf.pubseekoff(0, std::ios_base::cur, std::ios_base::in)), 0);

    // Reading a single character makes underflow() pull in a whole buffer.
    for(int i = 0; i < 10; ++i)
        stream_buf.sbumpc();

    zassert_equal(static_cast<std::streamoff>(stream_buf.pubseekoff(0, std::ios_base::cur, std::ios_base::in)), 10);
    zassert_equal(static_cast<std::streamoff>(stream_buf.pubseekoff(5, std::ios_base::cur, std::ios_base::in)), 15);
    zassert_equal(stream_buf.sbumpc(), content[15]);
}

ZTEST(fs_service_stream_buf, test_operations_fail_after_close) {
    auto* fs_service = GetFsService();

    FsServiceStreamBuf stream_buf(fs_service, "test_closed.txt", OpenMode::Write);
    zassert_true(stream_buf.close(), "closing an untouched stream must succeed");

    zassert_equal(stream_buf.sputn("abc", 3), 0, "a closed stream must refuse sputn");
    zassert_equal(
        stream_buf.sputc('x'), std::streambuf::traits_type::eof(),
        "a closed stream must refuse sputc, not store it in a put area nobody flushes"
    );
    zassert_equal(stream_buf.GetBytesWritten(), 0, "refused bytes must not be counted");
    zassert_equal(stream_buf.pubsync(), -1, "a closed stream cannot sync");
    zassert_equal(static_cast<std::streamoff>(stream_buf.pubseekoff(0, std::ios_base::beg, std::ios_base::out)), -1);
}

// The tests below exercise the put area, so they assume the default (non-zero) buffer size.
static constexpr size_t WRITE_BUFFER_SIZE = CONFIG_EERIE_LEAP_FS_STREAM_WRITE_BUFFER_SIZE;

ZTEST(fs_service_stream_buf, test_buffered_writes_reach_the_file_on_sync) {
    if(WRITE_BUFFER_SIZE == 0)
        ztest_test_skip();

    auto* fs_service = GetFsService();
    const std::string file_path = "test_buffered_sync.bin";

    auto content = MakeText(100);

    FsServiceStreamBuf stream_buf(fs_service, file_path, OpenMode::Write);

    zassert_equal(stream_buf.sputn(content.data(), 100), 100, "a write that fits the buffer is accepted whole");
    zassert_equal(stream_buf.GetBytesWritten(), 100, "buffered bytes count as written");
    zassert_equal(stream_buf.GetWriteCallCount(), 0, "a write that fits the buffer must not reach the file system");
    zassert_equal(fs_service->GetFileSize(file_path).value(), 0, "nothing is in the file before the sync");

    zassert_equal(stream_buf.pubsync(), 0, "a sync with room on the volume must succeed");
    zassert_equal(stream_buf.GetWriteCallCount(), 1, "the sync flushes the put area in one write");
    zassert_equal(fs_service->GetFileSize(file_path).value(), 100, "the sync must put the buffered bytes in the file");

    zassert_true(stream_buf.close(), "close must report the flush and the close");
    zassert_equal(stream_buf.GetWriteCallCount(), 1, "an empty put area must not be written at close");
    zassert_true(ReadText(file_path) == content);
}

ZTEST(fs_service_stream_buf, test_close_flushes_the_put_area) {
    if(WRITE_BUFFER_SIZE == 0)
        ztest_test_skip();

    auto* fs_service = GetFsService();
    const std::string file_path = "test_close_flush.txt";

    FsServiceStreamBuf stream_buf(fs_service, file_path, OpenMode::Write);

    zassert_equal(stream_buf.sputn("buffered", 8), 8, "a write that fits the buffer is accepted whole");
    zassert_equal(stream_buf.GetWriteCallCount(), 0, "a write that fits the buffer must not reach the file system");

    zassert_true(stream_buf.close(), "close must report the flush and the close");
    zassert_equal(stream_buf.GetWriteCallCount(), 1, "close flushes the put area in one write");
    zassert_str_equal(ReadText(file_path).c_str(), "buffered");
}

ZTEST(fs_service_stream_buf, test_write_larger_than_the_buffer_is_written_directly) {
    if(WRITE_BUFFER_SIZE == 0)
        ztest_test_skip();

    auto* fs_service = GetFsService();
    const std::string file_path = "test_direct_write.bin";

    auto head = MakeText(10);
    auto body = MakeText(WRITE_BUFFER_SIZE + 1);

    FsServiceStreamBuf stream_buf(fs_service, file_path, OpenMode::Write);

    zassert_equal(stream_buf.sputn(head.data(), static_cast<std::streamsize>(head.size())), 10);
    zassert_equal(stream_buf.GetWriteCallCount(), 0, "the head fits the buffer");

    zassert_equal(
        static_cast<size_t>(stream_buf.sputn(body.data(), static_cast<std::streamsize>(body.size()))), body.size()
    );
    zassert_equal(
        stream_buf.GetWriteCallCount(), 2,
        "a write of at least the buffer size flushes the pending head, then goes to the file directly"
    );
    zassert_equal(stream_buf.GetBytesWritten(), head.size() + body.size(), "both writes count as written");

    zassert_true(stream_buf.close(), "close must report the flush and the close");
    zassert_equal(stream_buf.GetWriteCallCount(), 2, "nothing was left to flush at close");
    zassert_true(ReadText(file_path) == head + body, "the head must precede the body in the file");
}

ZTEST(fs_service_stream_buf, test_seek_flushes_before_moving) {
    if(WRITE_BUFFER_SIZE == 0)
        ztest_test_skip();

    auto* fs_service = GetFsService();
    const std::string file_path = "test_seek_flush.bin";

    auto content = MakeText(1000);
    const std::string patch = "ABCDEFGH";

    FsServiceStreamBuf stream_buf(fs_service, file_path, OpenMode::Write);

    zassert_equal(
        stream_buf.sputn(content.data(), static_cast<std::streamsize>(content.size())), 1000,
        "a write that fits the buffer is accepted whole"
    );
    zassert_equal(stream_buf.GetWriteCallCount(), 0, "a write that fits the buffer must not reach the file system");

    zassert_equal(static_cast<std::streamoff>(stream_buf.pubseekpos(0, std::ios_base::out)), 0);
    zassert_equal(stream_buf.GetWriteCallCount(), 1, "the pending bytes must be written before the position moves");

    zassert_equal(stream_buf.sputn(patch.data(), 8), 8, "the patch fits the buffer");
    zassert_true(stream_buf.close(), "close must report the flush and the close");
    zassert_equal(stream_buf.GetWriteCallCount(), 2, "close flushes the patch in one write");

    auto expected = content;
    expected.replace(0, patch.size(), patch);

    const auto read_back = ReadText(file_path);
    zassert_equal(read_back.size(), expected.size(), "the rewrite must not change the file size");
    zassert_true(read_back == expected, "the patch must land at the seeked position, after the earlier bytes");
}

// The buffer size is a Kconfig symbol, so it cannot be varied at run time: this test asserts the
// behaviour the build configured. The functional.subsys.fs.unbuffered scenario builds the suite
// with a 0 buffer, so both branches run under twister.
ZTEST(fs_service_stream_buf, test_unbuffered_when_the_buffer_size_is_zero) {
    auto* fs_service = GetFsService();
    const std::string file_path = "test_unbuffered.txt";

    FsServiceStreamBuf stream_buf(fs_service, file_path, OpenMode::Write);

    zassert_equal(stream_buf.sputn("abc", 3), 3, "sputn must accept the bytes whether buffered or not");
    zassert_equal(stream_buf.sputc('d'), 'd', "sputc must accept the byte whether buffered or not");
    zassert_equal(stream_buf.GetBytesWritten(), 4, "every accepted byte counts as written");

    if(WRITE_BUFFER_SIZE == 0)
        zassert_equal(stream_buf.GetWriteCallCount(), 2, "without a buffer every write goes straight to the file");
    else
        zassert_equal(stream_buf.GetWriteCallCount(), 0, "with a buffer nothing reaches the file before a flush");

    zassert_true(stream_buf.close(), "close must report the flush and the close");
    zassert_str_equal(ReadText(file_path).c_str(), "abcd");
}

// Fills the volume with a separate file until a write fails, then checks that a buffered stream
// reports the write it cannot complete instead of crashing or pretending.
ZTEST(fs_service_stream_buf, test_short_write_on_a_full_volume_is_reported) {
    if(WRITE_BUFFER_SIZE == 0)
        ztest_test_skip();

    auto* fs_service = GetFsService();
    const std::string file_path = "test_full_volume.bin";
    const std::string filler_path = "test_full_volume_filler.bin";

    // Opened before the fill so the open itself cannot fail for lack of space.
    FsServiceStreamBuf stream_buf(fs_service, file_path, OpenMode::Write);

    auto chunk = MakeText(4096);
    int appends = 0;
    while(appends < 4096 && WriteText(filler_path, chunk, true))
        appends++;
    zassert_true(appends > 0 && appends < 4096, "the volume did not fill up");

    // Fits the buffer, so the failure can only surface when the stream tries to flush.
    zassert_equal(stream_buf.sputn(chunk.data(), 100), 100, "a write that fits the buffer is accepted");
    bool reported = stream_buf.pubsync() != 0;

    // The filler's failed append may have left a block or two behind; direct writes through the
    // stream take them, and the one that does not fit has to come back short.
    int direct_writes = 0;
    while(!reported && direct_writes < 512) {
        const auto written = stream_buf.sputn(chunk.data(), static_cast<std::streamsize>(chunk.size()));
        reported = static_cast<size_t>(written) < chunk.size();
        direct_writes++;
    }
    zassert_true(reported, "a write on a full volume must be reported by a failed sync or a short write");

    zassert_equal(stream_buf.sputn("x", 1), 0, "once a write failed every later write must be refused");
    zassert_equal(
        stream_buf.sputc('x'), std::streambuf::traits_type::eof(), "once a write failed sputc must be refused as well"
    );
    zassert_equal(stream_buf.pubsync(), -1, "a sync of a latched stream must not report success");

    zassert_true(stream_buf.close(), "the file still closes once the failed bytes were dropped");
    zassert_false(stream_buf.is_open());

    if(!fs_service->DeleteFile(filler_path))
        zassert_true(fs_service->Format(), "the filler could neither be deleted nor formatted away");
}
```

## src/fs_test_support.h
```c
#pragma once

#include <string>
#include <string_view>
#include <vector>

#include "subsys/device_tree/dt_fs.h"
#include "subsys/fs/services/fs_service.h"

namespace fs_test {

using eerie_leap::subsys::device_tree::DtFs;
using eerie_leap::subsys::fs::services::FsService;

/*
 * Shared instance for the suites that only need a mounted volume; the service itself never owns
 * the devicetree mount entry, so tests are free to create their own instances as well.
 */
inline FsService* GetFsService() {
    static FsService* fs_service = nullptr;

    if(fs_service == nullptr) {
        DtFs::InitInternalFs();
        fs_service = new FsService(DtFs::GetInternalFsMp());
        fs_service->Initialize();
    }

    return fs_service;
}

inline void ResetFs(void* = nullptr) {
    GetFsService()->DeleteRecursive();
}

inline bool WriteText(std::string_view relative_path, std::string_view content, bool append = false) {
    return GetFsService()->WriteFile(relative_path, content.data(), content.size(), append);
}

inline std::string ReadText(std::string_view relative_path) {
    auto* fs_service = GetFsService();

    std::vector<char> buffer(fs_service->GetFileSize(relative_path).value_or(0) + 1);
    size_t read_size = 0;

    if(!fs_service->ReadFile(relative_path, buffer.data(), buffer.size(), read_size))
        return {};

    return { buffer.data(), read_size };
}

inline std::string MakeText(size_t size) {
    std::string content(size, '\0');

    for(size_t i = 0; i < size; ++i)
        content[i] = static_cast<char>('a' + (i % 26));

    return content;
}

} // namespace fs_test
```

## src/sdmmc_service.cpp
```c
#include <string>

#include <zephyr/kernel.h>
#include <zephyr/sys/atomic.h>
#include <zephyr/ztest.h>

#include "subsys/device_tree/dt_fs.h"
#include "subsys/fs/services/sdmmc_service.h"

#include "fs_test_support.h"

using eerie_leap::subsys::device_tree::DtFs;
using eerie_leap::subsys::fs::services::SdmmcService;

using fs_test::ReadText;

// Emulated targets have no SD host: the service runs against the internal volume and the disk
// ioctls it issues on this name fail harmlessly.
static constexpr const char* DISK_NAME = "no-sd-card";

static atomic_t card_present = ATOMIC_INIT(1);

// The service mounts the volume but does not own the devicetree mount entry, so instances are
// free to come and go; a single shared one keeps the monitor tests simple.
static SdmmcService* GetSdmmcService() {
    static SdmmcService* sdmmc_service = nullptr;

    if(sdmmc_service == nullptr) {
        DtFs::InitInternalFs();
        sdmmc_service = new SdmmcService(DtFs::GetInternalFsMp(), DISK_NAME);
    }

    return sdmmc_service;
}

static bool WaitForAvailability(SdmmcService* sdmmc_service, bool expected) {
    for(int i = 0; i < 100; ++i) {
        if(sdmmc_service->IsAvailable() == expected)
            return true;

        k_msleep(20);
    }

    return false;
}

static void SetUpSdmmc(void*) {
    atomic_set(&card_present, 1);
    GetSdmmcService()->RegisterIsSdCardPresentHandler(nullptr);
    fs_test::ResetFs();
}

static void TearDownSdmmc(void*) {
    GetSdmmcService()->SdMonitorStop();
}

ZTEST_SUITE(sdmmc_service, NULL, NULL, SetUpSdmmc, TearDownSdmmc, NULL);

ZTEST(sdmmc_service, test_Initialize) {
    auto* sdmmc_service = GetSdmmcService();

    zassert_true(sdmmc_service->Initialize());
    zassert_true(sdmmc_service->IsAvailable());

    zassert_true(sdmmc_service->WriteFile("test_sdmmc_initialize.txt", "abc", 3));
    zassert_str_equal(ReadText("test_sdmmc_initialize.txt").c_str(), "abc");
}

ZTEST(sdmmc_service, test_SdMonitorStop_without_start) {
    zassert_equal(GetSdmmcService()->SdMonitorStop(), 0);
}

ZTEST(sdmmc_service, test_SdMonitor_keeps_state_without_handler) {
    auto* sdmmc_service = GetSdmmcService();

    zassert_true(sdmmc_service->Initialize());
    zassert_equal(sdmmc_service->SdMonitorStart(), 0);

    k_msleep(150);

    zassert_true(sdmmc_service->IsAvailable());
    zassert_equal(sdmmc_service->SdMonitorStop(), 0);
}

ZTEST(sdmmc_service, test_SdMonitor_tracks_card_removal_and_insertion) {
    auto* sdmmc_service = GetSdmmcService();

    zassert_true(sdmmc_service->Initialize());
    sdmmc_service->RegisterIsSdCardPresentHandler([] {
        return atomic_get(&card_present) == 1;
    });

    zassert_equal(sdmmc_service->SdMonitorStart(), 0);
    zassert_true(WaitForAvailability(sdmmc_service, true));

    atomic_set(&card_present, 0);
    zassert_true(WaitForAvailability(sdmmc_service, false), "card removal was not detected");

    atomic_set(&card_present, 1);
    zassert_true(WaitForAvailability(sdmmc_service, true), "card insertion was not detected");

    zassert_equal(sdmmc_service->SdMonitorStop(), 0);

    // The volume is remounted on insertion, so it has to be writable again.
    zassert_true(sdmmc_service->WriteFile("test_sdmmc_reinsert.txt", "abc", 3));
    zassert_str_equal(ReadText("test_sdmmc_reinsert.txt").c_str(), "abc");
}

ZTEST(sdmmc_service, test_SdMonitorStop_is_idempotent) {
    auto* sdmmc_service = GetSdmmcService();

    zassert_equal(sdmmc_service->SdMonitorStart(), 0);
    zassert_equal(sdmmc_service->SdMonitorStop(), 0);
    zassert_equal(sdmmc_service->SdMonitorStop(), 0);
}

ZTEST(sdmmc_service, test_SdMonitorStart_is_idempotent) {
    auto* sdmmc_service = GetSdmmcService();

    zassert_equal(sdmmc_service->SdMonitorStart(), 0);
    zassert_equal(sdmmc_service->SdMonitorStart(), 0);

    k_msleep(100);

    zassert_equal(sdmmc_service->SdMonitorStop(), 0);
}

// A running monitor must not keep the destructor waiting forever.
ZTEST(sdmmc_service, test_destructor_stops_the_monitor) {
    DtFs::InitInternalFs();

    {
        SdmmcService local_service(DtFs::GetInternalFsMp(), DISK_NAME);

        zassert_true(local_service.Initialize());
        local_service.RegisterIsSdCardPresentHandler([] {
            return true;
        });
        zassert_equal(local_service.SdMonitorStart(), 0);

        k_msleep(100);
    }

    zassert_true(fs_test::GetFsService()->IsAvailable());
}

ZTEST(sdmmc_service, test_IsAvailable_requires_a_mounted_volume) {
    auto* sdmmc_service = GetSdmmcService();

    zassert_true(sdmmc_service->Initialize());
    zassert_true(sdmmc_service->IsAvailable());

    SdmmcService orphan_service(nullptr, DISK_NAME);

    zassert_false(orphan_service.Initialize());
    zassert_false(orphan_service.IsAvailable());
}
```
