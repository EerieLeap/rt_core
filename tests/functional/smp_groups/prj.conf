## CMakeLists.txt
```
cmake_minimum_required(VERSION 3.20.0)

set(RT_CORE_TEST_SIM_FLASH ON)
include(${CMAKE_CURRENT_SOURCE_DIR}/../../rt_core_test.cmake)

find_package(Zephyr REQUIRED HINTS $ENV{ZEPHYR_BASE})
project(functional_smp_groups)

file(GLOB_RECURSE TEST_SOURCES src/*.c src/*.cpp)

# The scenario without the assets group (CONFIG_EERIE_LEAP_SMP_ASSETS=n) tests the rest of the suite
# as a unit without it runs.
if(NOT CONFIG_EERIE_LEAP_SMP_ASSETS)
  list(FILTER TEST_SOURCES EXCLUDE REGEX "/assets_mgmt_group\\.cpp$")
endif()

# The COM domain needs CAN and CDMP, and the logging group is built with the logging controller, so
# both groups are built on their own here.
target_sources(app PRIVATE
  ${RT_CORE_DIR}/src/domain/canbus_com_domain/smp/network_mgmt_group.cpp
  ${RT_CORE_DIR}/src/domain/logging_domain/smp/logging_mgmt_group.cpp
  ${TEST_SOURCES}
)

# The test client injects requests with smp_rx_req().
target_include_directories(app PRIVATE
  ${RT_CORE_DIR}/tests/common
  ${ZEPHYR_BASE}/subsys/mgmt/mcumgr/transport/include
)

# The assets group tests count the bytes the group reads from its files and the files it closes, and make
# a write fail, by wrappers of fs_read(), fs_close() and fs_write(), which are defined in the test of
# the group.
if(CONFIG_EERIE_LEAP_SMP_ASSETS)
  zephyr_link_libraries(-Wl,--wrap=fs_read,--wrap=fs_close,--wrap=fs_write)
endif()
```

## prj.conf
```kconfig
CONFIG_ZTEST=y

# Language and Compiler
CONFIG_CPP=y
CONFIG_PICOLIBC=y
CONFIG_STD_CPP23=y
CONFIG_REQUIRES_FULL_LIBCPP=y
CONFIG_CPP_EXCEPTIONS=y
CONFIG_CPP_RTTI=y

# Memory
CONFIG_HEAP_MEM_POOL_SIZE=200000

# C++ exception unwinding needs considerably more stack than the ztest defaults.
CONFIG_MAIN_STACK_SIZE=8192
CONFIG_ZTEST_STACK_SIZE=8192

# Logging And Debugging
CONFIG_LOG=y
CONFIG_TEST_RANDOM_GENERATOR=y
CONFIG_THREAD_NAME=y

# ThreadBase::InitializeStack() falls back to k_thread_stack_alloc().
CONFIG_THREAD_STACK_INFO=y
CONFIG_DYNAMIC_THREAD=y
CONFIG_DYNAMIC_THREAD_ALLOC=y

# The assets group's volume: littlefs on the simulated flash
CONFIG_FLASH=y
CONFIG_FLASH_MAP=y
CONFIG_FILE_SYSTEM=y
CONFIG_FILE_SYSTEM_LITTLEFS=y
CONFIG_FILE_SYSTEM_MKFS=y

CONFIG_EERIE_LEAP_RT_CORE=y
CONFIG_EERIE_LEAP_CONFIGURATION=y
CONFIG_EERIE_LEAP_DOMAIN_SYSTEM=y
CONFIG_EERIE_LEAP_SMP=y
CONFIG_EERIE_LEAP_CONTROLLER_MANAGEMENT=y
CONFIG_EERIE_LEAP_DEVICE_TREE=y
CONFIG_EERIE_LEAP_EVENT_BUS=y
CONFIG_EERIE_LEAP_ASSETS=y

# The calibration group samples the ADC simulator: CONFIG_ADC stays off, as on a unit without an ADC.
CONFIG_EERIE_LEAP_ADC=y
CONFIG_EERIE_LEAP_DOMAIN_ADC=y
CONFIG_EERIE_LEAP_TIME=y

CONFIG_EERIE_LEAP_SMP_CONFIG_SESSION_TIMEOUT_MS=300
CONFIG_EERIE_LEAP_SMP_ASSETS_STAT_CRC_MAX_SIZE=8192
CONFIG_EERIE_LEAP_SMP_ASSETS_SESSION_TIMEOUT_MS=300
# More than one response holds, to exercise paging.
CONFIG_EERIE_LEAP_SMP_NETWORK_MAX_DEVICES=64

# Product and versions reported by the device group.
CONFIG_EERIE_LEAP_PRODUCT_ID=4660
CONFIG_EERIE_LEAP_REVISION=3
CONFIG_EERIE_LEAP_FEATURES_CANBUS=y
CONFIG_EERIE_LEAP_HW_VERSION_MAJOR=1
CONFIG_EERIE_LEAP_HW_VERSION_MINOR=2
CONFIG_EERIE_LEAP_HW_VERSION_PATCH=3
CONFIG_EERIE_LEAP_SW_VERSION_MAJOR=4
CONFIG_EERIE_LEAP_SW_VERSION_MINOR=5
CONFIG_EERIE_LEAP_SW_VERSION_PATCH=6
CONFIG_EERIE_LEAP_SW_VERSION_BUILD=7
```

## src/assets_test_support.h
```c
#pragma once

#include <atomic>
#include <cerrno>
#include <cstddef>
#include <cstdint>
#include <memory>
#include <optional>
#include <string>
#include <string_view>
#include <utility>
#include <vector>

#include <zephyr/fs/fs.h>
#include <zephyr/ztest.h>

#include "subsys/device_tree/dt_fs.h"
#include "subsys/fs/services/fs_service.h"
#include "subsys/fs/services/i_fs_service.h"

// The volume the assets group tests serve files from, and what they need around it.
namespace assets_group_test {

using eerie_leap::subsys::device_tree::DtFs;
using eerie_leap::subsys::fs::services::DirectoryEntry;
using eerie_leap::subsys::fs::services::FsService;
using eerie_leap::subsys::fs::services::IFsService;

/** The internal volume (littlefs on the simulated flash) the board's devicetree mounts. */
inline std::shared_ptr<FsService> GetSimFsService() {
    static std::shared_ptr<FsService> fs_service;

    if(fs_service == nullptr) {
        DtFs::InitInternalFs();
        fs_service = std::make_shared<FsService>(DtFs::GetInternalFsMp());
        zassert_true(fs_service->Initialize(), "The internal volume is not mounted");
    }

    return fs_service;
}

/**
 * A volume that can go away and come back, as an SD card does: while @p available is false it is
 * not mounted for everyone who asks, and fails what they ask for. Otherwise it is the volume it wraps.
 *
 * @p available is set by the test thread between requests and read on the configuration work queue.
 */
class SwitchableFsService : public IFsService {
public:
    std::atomic<bool> available;
    // Added to the wrapped volume's mount generation: a test counts a remount of the card here.
    std::atomic<uint32_t> remounts{ 0 };

    using IFsService::DeleteRecursive;
    using IFsService::ListFiles;
    using IFsService::WriteFile;

    explicit SwitchableFsService(std::shared_ptr<IFsService> inner, bool is_available = true) :
        available(is_available),
        inner_(std::move(inner)) {}

    bool Initialize() override {
        return inner_->Initialize();
    }
    bool IsAvailable() const override {
        return available && inner_->IsAvailable();
    }

    bool WriteFile(std::string_view path, const void* data, size_t size, bool append) override {
        return available && inner_->WriteFile(path, data, size, append);
    }

    bool ReadFile(std::string_view path, void* data, size_t size, size_t& out_len) override {
        if(!available) {
            out_len = 0;
            return false;
        }

        return inner_->ReadFile(path, data, size, out_len);
    }

    int OpenFile(std::string_view path, fs_mode_t flags, fs_file_t* file) override {
        return available ? inner_->OpenFile(path, flags, file) : -ENODEV;
    }

    bool CreateDirectory(std::string_view path) override {
        return available && inner_->CreateDirectory(path);
    }
    bool Exists(std::string_view path) const override {
        return available && inner_->Exists(path);
    }
    bool DeleteFile(std::string_view path) override {
        return available && inner_->DeleteFile(path);
    }
    bool DeleteRecursive(std::string_view path) override {
        return available && inner_->DeleteRecursive(path);
    }
    int Rename(std::string_view from, std::string_view to) override {
        return available ? inner_->Rename(from, to) : -ENODEV;
    }

    std::vector<std::string> ListFiles(std::string_view path) const override {
        return available ? inner_->ListFiles(path) : std::vector<std::string>{};
    }

    int ListDirectory(
        std::string_view path,
        size_t first,
        size_t max_entries,
        std::vector<DirectoryEntry>& entries,
        size_t& count
    ) const override {

        if(!available) {
            entries.clear();
            count = 0;

            return -ENODEV;
        }

        return inner_->ListDirectory(path, first, max_entries, entries, count);
    }

    std::optional<size_t> GetFileSize(std::string_view path) const override {
        return available ? inner_->GetFileSize(path) : std::nullopt;
    }

    uint64_t GetTotalSpace() const override {
        return available ? inner_->GetTotalSpace() : 0;
    }
    uint64_t GetUsedSpace() const override {
        return available ? inner_->GetUsedSpace() : 0;
    }
    bool Format() override {
        return available && inner_->Format();
    }
    uint32_t GetMountGeneration() const override {
        return inner_->GetMountGeneration() + remounts;
    }

private:
    std::shared_ptr<IFsService> inner_;
};

} // namespace assets_group_test
```

## src/calibration_mgmt_group.cpp
```c
#include <chrono>
#include <memory>
#include <utility>
#include <vector>

#include <zephyr/kernel.h>
#include <zephyr/mgmt/mcumgr/mgmt/mgmt_defines.h>
#include <zephyr/ztest.h>

#include "domain/adc_domain/models/adc_range.h"
#include "domain/adc_domain/services/calibration_service.h"
#include "domain/adc_domain/smp/calibration_mgmt_group.h"
#include "subsys/adc/adc_manager.h"
#include "subsys/adc/adc_simulator.h"
#include "subsys/threading/i_service.h"
#include "subsys/time/i_time_service.h"

#include "smp_groups_test_support.h"

using namespace smp_groups_test;

using eerie_leap::domain::adc_domain::models::AdcRange;
using eerie_leap::domain::adc_domain::services::CalibrationService;
using eerie_leap::domain::adc_domain::smp::CalibrationMgmtGroup;
using eerie_leap::subsys::adc::AdcCapabilities;
using eerie_leap::subsys::adc::AdcError;
using eerie_leap::subsys::adc::AdcManager;
using eerie_leap::subsys::adc::AdcSampleRequest;
using eerie_leap::subsys::adc::AdcSimulator;
using eerie_leap::subsys::adc::AdcStats;
using eerie_leap::subsys::adc::IAdc;
using eerie_leap::subsys::threading::IService;
using eerie_leap::subsys::threading::ServiceState;
using eerie_leap::subsys::time::ITimeService;

using Command = CalibrationMgmtGroup::Command;
using Error = CalibrationMgmtGroup::Error;

namespace {

// Past 2^32 ms, so the timestamp only fits the 64-bit encoding.
constexpr uint64_t NOW_MS = 1'790'000'000'123ULL;

uint8_t Id(Command command) {
    return std::to_underlying(command);
}

void AssertError(const Response& response, Error error) {
    zassert_equal(response.error_group.value_or(0), std::to_underlying(SmpGroupId::CALIBRATION));
    zassert_equal(
        response.error.value_or(0), std::to_underlying(error), "Expected error %u, got %u", std::to_underlying(error),
        response.error.value_or(0)
    );
}

// A clock that stands still, so a result's timestamp is known exactly.
class FixedTimeService : public ITimeService {
public:
    std::chrono::system_clock::time_point GetCurrentTime() override {
        return std::chrono::system_clock::time_point(std::chrono::milliseconds(NOW_MS));
    }

    std::chrono::system_clock::time_point GetTimeSinceBoot() override {
        return std::chrono::system_clock::time_point(std::chrono::milliseconds(k_uptime_get()));
    }
};

// Stands in for the processing service: pausable unless told otherwise, and counting.
class RecordingService : public IService {
private:
    ServiceState state_ = ServiceState::RUNNING;

public:
    bool is_pause_accepted = true;
    int pauses = 0;
    int resumes = 0;

    bool Initialize() override {
        return true;
    }
    bool Start() override {
        state_ = ServiceState::RUNNING;
        return true;
    }
    bool Stop() override {
        state_ = ServiceState::STOPPED;
        return true;
    }

    bool Pause() override {
        pauses++;
        if(!is_pause_accepted)
            return false;

        state_ = ServiceState::PAUSED;
        return true;
    }

    bool Resume() override {
        resumes++;
        state_ = ServiceState::RUNNING;
        return true;
    }

    [[nodiscard]] bool IsPausable() const noexcept override {
        return true;
    }
    [[nodiscard]] ServiceState GetState() const noexcept override {
        return state_;
    }
};

// One channel whose conversions wait until the gate opens, so a job can be caught before its
// first result. Open, it reads a constant.
class GatedAdc : public IAdc {
private:
    k_sem gate_{};

public:
    static constexpr float VOLTS = 1.25F;

    GatedAdc() {
        k_sem_init(&gate_, 0, 1);
    }

    void Open() {
        k_sem_give(&gate_);
    }

    bool Initialize() override {
        return true;
    }

    void Sample(const AdcSampleRequest& request) noexcept override {
        k_sem_take(&gate_, K_FOREVER);
        k_sem_give(&gate_);

        for(auto& result : request.results)
            result = { .volts = VOLTS };
    }

    [[nodiscard]] int GetChannelCount() const override {
        return 1;
    }
    [[nodiscard]] AdcCapabilities GetCapabilities() const override {
        return {};
    }
    [[nodiscard]] AdcStats GetStats() const override {
        return {};
    }
};

// The group over a calibration service on the ADC simulator (eight channels) unless given another
// ADC, as AdcController wires it on a unit without ADC hardware.
class Harness {
public:
    std::shared_ptr<AdcManager> adc_manager;
    std::shared_ptr<RecordingService> paused_service = std::make_shared<RecordingService>();
    std::shared_ptr<CalibrationService> calibration_service;
    std::unique_ptr<CalibrationMgmtGroup> group;
    SmpTestClient client;

    explicit Harness(std::shared_ptr<IAdc> adc = std::make_shared<AdcSimulator>()) {
        adc_manager = std::make_shared<AdcManager>(std::vector<std::shared_ptr<IAdc>>{ std::move(adc) });
        zassert_true(adc_manager->Initialize());

        calibration_service = std::make_shared<CalibrationService>(
            std::make_shared<FixedTimeService>(), adc_manager, paused_service
        );
        zassert_true(calibration_service->Initialize());

        group = std::make_unique<CalibrationMgmtGroup>(calibration_service, adc_manager->GetChannelCount());
        group->Register();
    }

    Harness(const Harness&) = delete;
    Harness& operator=(const Harness&) = delete;
    Harness(Harness&&) = delete;
    Harness& operator=(Harness&&) = delete;

    // The group is unregistered before the service it dispatches to goes.
    ~Harness() {
        group.reset();
        calibration_service.reset();
    }

    Response Start(uint32_t channel) {
        return client.Write(SmpGroupId::CALIBRATION, Id(Command::START), CborMap().Put("channel", channel).Build());
    }

    Response Stop() {
        return client.Write(SmpGroupId::CALIBRATION, Id(Command::STOP), CborMap().Build());
    }

    Response Read() {
        return client.Read(SmpGroupId::CALIBRATION, Id(Command::READ));
    }

    // Reads until the job has a result newer than @p after_sequence.
    Response ReadAfter(uint32_t after_sequence) {
        const int64_t end = k_uptime_get() + 10LL * CONFIG_EERIE_LEAP_ADC_CALIBRATION_SAMPLING_RATE_MS;
        auto response = Read();
        while(response.IsOk() && response.Value("seq") <= after_sequence && k_uptime_get() < end) {
            k_msleep(5);
            response = Read();
        }

        return response;
    }
};

} // namespace

ZTEST_SUITE(smp_calibration_group, NULL, NULL, NULL, NULL, NULL);

ZTEST(smp_calibration_group, test_start_read_stop_round_trip) {
    Harness harness;

    zassert_true(harness.Start(2).IsOk());
    zassert_true(harness.calibration_service->IsRunning());
    zassert_equal(harness.paused_service->pauses, 1);
    zassert_true(harness.paused_service->IsPaused());

    const auto first = harness.ReadAfter(0);
    zassert_true(first.IsOk());
    zassert_true(first.Value("seq") >= 1, "The job produced a result");
    zassert_equal(first.Value("channel"), 2);
    zassert_equal(first.Value("adc_err"), std::to_underlying(AdcError::NONE));
    zassert_true(first.Flag("running"));
    zassert_equal(first.WideValue("ts"), NOW_MS);

    const float adc_volts = first.Float("adc_v");
    zassert_true(adc_volts >= 0.0F && adc_volts <= 3.3F, "The simulator samples 0 to 3.3 V");
    zassert_within(first.Float("sensor_v"), AdcRange::Default().ToSensorVolts(adc_volts), 1e-6F);

    const auto second = harness.ReadAfter(first.Value("seq"));
    zassert_true(second.Value("seq") > first.Value("seq"), "The job keeps sampling");

    // One job at a time, and the second START pauses nothing.
    AssertError(harness.Start(2), Error::BUSY);
    AssertError(harness.Start(3), Error::BUSY);
    zassert_equal(harness.paused_service->pauses, 1);

    zassert_true(harness.Stop().IsOk());
    zassert_false(harness.calibration_service->IsRunning());
    zassert_equal(harness.paused_service->resumes, 1);
    zassert_true(harness.paused_service->IsRunning());

    // The last result stays readable.
    const auto last = harness.Read();
    zassert_true(last.IsOk());
    zassert_false(last.Flag("running"));
    zassert_equal(last.Value("channel"), 2);
    zassert_equal(last.Value("seq"), harness.calibration_service->GetLatest()->sequence);
    zassert_true(last.Value("seq") >= second.Value("seq"));
    zassert_equal(last.Value("adc_err"), std::to_underlying(AdcError::NONE));
    zassert_equal(last.WideValue("ts"), NOW_MS);
    zassert_within(last.Float("sensor_v"), AdcRange::Default().ToSensorVolts(last.Float("adc_v")), 1e-6F);

    AssertError(harness.Stop(), Error::NOT_RUNNING);
    zassert_equal(harness.paused_service->resumes, 1, "Resumed once, by the STOP that ended the job");
}

ZTEST(smp_calibration_group, test_a_new_job_starts_after_stop) {
    Harness harness;

    zassert_true(harness.Start(1).IsOk());
    const auto first_job = harness.ReadAfter(0);
    zassert_equal(first_job.Value("channel"), 1);
    zassert_true(harness.Stop().IsOk());
    const uint32_t first_job_last = harness.calibration_service->GetLatest()->sequence;

    zassert_true(harness.Start(5).IsOk());
    zassert_equal(harness.paused_service->pauses, 2);

    // A result of the previous job is never reported for the new channel: right after START the
    // job has either no result yet or one of its own.
    const auto started = harness.Read();
    zassert_true(started.IsOk());
    zassert_equal(started.Value("channel"), 5);
    zassert_true(
        started.Value("seq") == 0 || started.Value("seq") > first_job_last, "seq %u is the first job's (last %u)",
        started.Value("seq"), first_job_last
    );
    if(started.Value("seq") == 0)
        zassert_equal(started.Float("adc_v"), 0.0F);

    const auto second_job = harness.ReadAfter(first_job_last);
    zassert_true(second_job.Flag("running"));
    zassert_equal(second_job.Value("channel"), 5);
    zassert_true(second_job.Value("seq") > first_job.Value("seq"));

    zassert_true(harness.Stop().IsOk());
    zassert_equal(harness.paused_service->resumes, 2);
}

ZTEST(smp_calibration_group, test_read_before_the_first_result) {
    const auto adc = std::make_shared<GatedAdc>();
    Harness harness(adc);

    zassert_true(harness.Start(0).IsOk());

    // The job is inside its first conversion: running, with nothing sampled.
    const auto pending = harness.Read();
    zassert_true(pending.IsOk());
    zassert_true(pending.Flag("running"));
    zassert_equal(pending.Value("channel"), 0);
    zassert_equal(pending.Value("seq"), 0);
    zassert_equal(pending.Float("adc_v"), 0.0F);
    zassert_equal(pending.Value("adc_err"), std::to_underlying(AdcError::NONE));

    adc->Open();

    const auto sampled = harness.ReadAfter(0);
    zassert_true(sampled.Value("seq") >= 1);
    zassert_within(sampled.Float("adc_v"), GatedAdc::VOLTS, 1e-6F);

    zassert_true(harness.Stop().IsOk());
    zassert_equal(harness.paused_service->resumes, 1);
}

ZTEST(smp_calibration_group, test_start_rejects_a_channel_the_unit_does_not_have) {
    Harness harness;
    const auto channel_count = static_cast<uint32_t>(harness.adc_manager->GetChannelCount());

    AssertError(harness.Start(99), Error::BAD_CHANNEL);
    AssertError(harness.Start(channel_count), Error::BAD_CHANNEL);
    zassert_false(harness.calibration_service->IsRunning());
    zassert_equal(harness.paused_service->pauses, 0, "Nothing is paused for a bad channel");

    // The last channel is a good one.
    zassert_true(harness.Start(channel_count - 1).IsOk());
    zassert_true(harness.Stop().IsOk());
}

ZTEST(smp_calibration_group, test_start_is_busy_while_the_service_refuses_to_pause) {
    Harness harness;
    harness.paused_service->is_pause_accepted = false;

    AssertError(harness.Start(1), Error::BUSY);
    zassert_equal(harness.paused_service->pauses, 1);
    zassert_false(harness.calibration_service->IsRunning());
    AssertError(harness.Read(), Error::NOT_RUNNING);
    AssertError(harness.Stop(), Error::NOT_RUNNING);
    zassert_equal(harness.paused_service->resumes, 0, "Nothing it did not pause is resumed");

    harness.paused_service->is_pause_accepted = true;
    zassert_true(harness.Start(1).IsOk());
    zassert_true(harness.Stop().IsOk());
    zassert_equal(harness.paused_service->resumes, 1);
}

ZTEST(smp_calibration_group, test_read_and_stop_without_a_job_are_rejected) {
    Harness harness;

    AssertError(harness.Read(), Error::NOT_RUNNING);
    AssertError(harness.Stop(), Error::NOT_RUNNING);
    zassert_equal(harness.paused_service->pauses, 0);
    zassert_equal(harness.paused_service->resumes, 0);
}

ZTEST(smp_calibration_group, test_start_without_a_channel_is_invalid) {
    Harness harness;

    const auto response = harness.client.Write(SmpGroupId::CALIBRATION, Id(Command::START), CborMap().Build());
    zassert_false(response.IsOk());
    zassert_equal(response.Value("rc"), MGMT_ERR_EINVAL);
    zassert_false(harness.calibration_service->IsRunning());
    zassert_equal(harness.paused_service->pauses, 0);
}
```

## src/can_monitor_group_absent.cpp
```c
#include <utility>

#include <zephyr/mgmt/mcumgr/mgmt/mgmt_defines.h>
#include <zephyr/ztest.h>

#include "smp_groups_test_support.h"

using namespace smp_groups_test;

namespace {

// The CAN monitor's group (74), whose domain this suite does not build.
constexpr SmpGroupId CAN_MONITOR = SmpGroupId::CAN_MONITOR;

} // namespace

ZTEST_SUITE(smp_can_monitor_group, NULL, NULL, NULL, NULL, NULL);

ZTEST(smp_can_monitor_group, test_a_build_without_the_group_answers_not_supported) {
    SmpTestClient client;

    // STATUS and OPEN, a read and a write: as firmware without the group answers, which the app reads as
    // "unsupported".
    const auto status = client.Read(CAN_MONITOR, 0);
    zassert_equal(status.Value("rc"), MGMT_ERR_ENOTSUP);

    const auto open = client.Write(CAN_MONITOR, 1, CborMap().Put("ch", 0).Put("mode", 0).Build());
    zassert_equal(open.Value("rc"), MGMT_ERR_ENOTSUP);
}
```

## src/config_mgmt_group.cpp
```c
#include <memory>
#include <optional>
#include <utility>
#include <vector>

#include <zephyr/kernel.h>
#include <zephyr/sys/crc.h>
#include <zephyr/ztest.h>

#include "domain/configuration_domain/services/configuration_service.h"
#include "domain/configuration_domain/smp/config_mgmt_group.h"
#include "subsys/threading/work_queue_thread.h"

#include "smp_groups_test_support.h"

using namespace smp_groups_test;

using eerie_leap::domain::configuration_domain::services::ConfigurationService;
using eerie_leap::domain::configuration_domain::smp::ConfigMgmtGroup;
using eerie_leap::subsys::threading::WorkQueueThread;

using Command = ConfigMgmtGroup::Command;
using Error = ConfigMgmtGroup::Error;

namespace {

constexpr uint32_t CANBUS = std::to_underlying(ConfigurationService::Type::Canbus);
constexpr uint32_t UI = std::to_underlying(ConfigurationService::Type::Ui);
constexpr uint32_t ADC = std::to_underlying(ConfigurationService::Type::Adc);
constexpr uint32_t UI_MAX_SIZE = 2000;
constexpr size_t WRITE_CHUNK_SIZE = 900;
// test_a_manager_that_throws_refuses_the_write_with_what_it_threw_and_ends_the_session throws on the queue:
// unwinding an exception on the QEMU targets needs more stack than the usual work queue has.
constexpr int WORK_QUEUE_STACK_SIZE = 16384;

uint32_t Crc(const Bytes& data) {
    return crc32_ieee(data.data(), data.size());
}

uint8_t Id(Command command) {
    return std::to_underlying(command);
}

void AssertError(const Response& response, Error error) {
    zassert_equal(response.error_group.value_or(0), std::to_underlying(SmpGroupId::CONFIG));
    zassert_equal(
        response.error.value_or(0), std::to_underlying(error), "Expected error %u, got %u", std::to_underlying(error),
        response.error.value_or(0)
    );
}

// What the service's stored handler saw: the type and the thread, in order.
struct Reports {
    struct Entry {
        ConfigurationService::Type type;
        k_tid_t thread;
    };

    k_mutex lock{};
    std::vector<Entry> entries;

    Reports() {
        k_mutex_init(&lock);
    }

    std::vector<Entry> Get() {
        k_mutex_lock(&lock, K_FOREVER);
        auto copy = entries;
        k_mutex_unlock(&lock);

        return copy;
    }
};

class Harness {
public:
    std::shared_ptr<WorkQueueThread> work_queue;
    std::shared_ptr<ConfigurationService> configuration_service = std::make_shared<ConfigurationService>();
    std::shared_ptr<Reports> reports = std::make_shared<Reports>();
    std::shared_ptr<FakeConfigurationManager> canbus = std::make_shared<FakeConfigurationManager>();
    std::shared_ptr<FakeConfigurationManager> ui = std::make_shared<FakeConfigurationManager>();
    std::unique_ptr<ConfigMgmtGroup> group;
    SmpTestClient client;

    Harness() {
        work_queue = std::make_shared<WorkQueueThread>("smp_groups_config_wq", WORK_QUEUE_STACK_SIZE, 5);
        zassert_true(work_queue->Initialize());

        configuration_service->RegisterCborConfigurationManager(ConfigurationService::Type::Canbus, canbus);
        configuration_service->RegisterCborConfigurationManager(ConfigurationService::Type::Ui, ui, UI_MAX_SIZE);
        configuration_service->RegisterConfigurationStoredHandler([reports = reports](ConfigurationService::Type type) {
            k_mutex_lock(&reports->lock, K_FOREVER);
            reports->entries.push_back({ type, k_current_get() });
            k_mutex_unlock(&reports->lock);
        });

        group = std::make_unique<ConfigMgmtGroup>(configuration_service, work_queue);
        zassert_true(group->Initialize());
        group->Register();
    }

    Harness(const Harness&) = delete;
    Harness& operator=(const Harness&) = delete;
    Harness(Harness&&) = delete;
    Harness& operator=(Harness&&) = delete;

    ~Harness() {
        group.reset();
        configuration_service->RegisterConfigurationStoredHandler(nullptr);
        work_queue.reset();
    }

    Response Crc(uint32_t type) {
        return client.Read(SmpGroupId::CONFIG, Id(Command::STORED_CRC), CborMap().Put("type", type).Build());
    }

    Response ReadChunk(uint32_t type, uint32_t offset) {
        return client.Read(
            SmpGroupId::CONFIG, Id(Command::READ), CborMap().Put("type", type).Put("off", offset).Build()
        );
    }

    Response WriteFirst(
        uint32_t type,
        std::span<const uint8_t> chunk,
        uint32_t length,
        uint32_t crc,
        std::optional<uint32_t> token = std::nullopt
    ) {

        CborMap body;
        body.Put("type", type).Put("off", 0).Put("len", length).Put("crc", crc).Put("data", chunk);
        if(token.has_value())
            body.Put("tok", *token);

        return client.Write(SmpGroupId::CONFIG, Id(Command::WRITE), body.Build());
    }

    Response WriteNext(uint32_t type, uint32_t offset, uint32_t token, std::span<const uint8_t> chunk) {
        return client.Write(
            SmpGroupId::CONFIG, Id(Command::WRITE),
            CborMap().Put("type", type).Put("off", offset).Put("tok", token).Put("data", chunk).Build()
        );
    }

    // Returns the final response.
    Response WriteAll(uint32_t type, const Bytes& data, uint32_t crc) {
        const size_t first = std::min(data.size(), WRITE_CHUNK_SIZE);
        auto response = WriteFirst(type, std::span(data).first(first), data.size(), crc);
        if(!response.IsOk())
            return response;

        const uint32_t token = response.Value("tok");
        for(size_t offset = first; offset < data.size(); offset += WRITE_CHUNK_SIZE) {
            const size_t size = std::min(WRITE_CHUNK_SIZE, data.size() - offset);
            response = WriteNext(type, offset, token, std::span(data).subspan(offset, size));
            if(!response.IsOk())
                return response;
        }

        return response;
    }

    Bytes ReadAll(uint32_t type, uint32_t* crc = nullptr) {
        auto response = ReadChunk(type, 0);
        zassert_true(response.IsOk());

        const uint32_t length = response.Value("len");
        if(crc != nullptr)
            *crc = response.Value("crc");

        Bytes data = response.bytes["data"];
        while(data.size() < length) {
            response = ReadChunk(type, data.size());
            zassert_true(response.IsOk());
            zassert_equal(response.Value("off"), data.size());

            const auto& chunk = response.bytes["data"];
            zassert_false(chunk.empty());
            data.insert(data.end(), chunk.begin(), chunk.end());
        }

        return data;
    }
};

} // namespace

struct smp_config_group_fixture {
    Harness* harness;
};

static void* ConfigGroupSetup() {
    static smp_config_group_fixture fixture{};

    return &fixture;
}

static void ConfigGroupBefore(void* data) {
    static_cast<smp_config_group_fixture*>(data)->harness = new Harness();
}

static void ConfigGroupAfter(void* data) {
    auto* fixture = static_cast<smp_config_group_fixture*>(data);
    delete fixture->harness;
    fixture->harness = nullptr;
}

ZTEST_SUITE(smp_config_group, NULL, ConfigGroupSetup, ConfigGroupBefore, ConfigGroupAfter, NULL);

ZTEST_F(smp_config_group, test_list_reports_the_registered_types_and_caps) {
    auto response = fixture->harness->client.Read(SmpGroupId::CONFIG, Id(Command::LIST));

    zassert_true(response.IsOk());
    zassert_equal(response.entries.size(), 2);
    zassert_equal(response.entries[0]["type"], CANBUS);
    zassert_equal(response.entries[0]["max"], ConfigurationService::DEFAULT_MAX_CBOR_SIZE);
    zassert_equal(response.entries[1]["type"], UI);
    zassert_equal(response.entries[1]["max"], UI_MAX_SIZE);
}

ZTEST_F(smp_config_group, test_crc_describes_the_current_configuration) {
    Harness& harness = *fixture->harness;
    harness.canbus->stored = Pattern(1500, 7);

    const auto response = harness.Crc(CANBUS);

    zassert_true(response.IsOk());
    zassert_equal(response.Value("type"), CANBUS);
    zassert_equal(response.Value("len"), 1500);
    zassert_equal(response.Value("crc"), Crc(harness.canbus->stored));
}

ZTEST_F(smp_config_group, test_unknown_type_is_rejected) {
    Harness& harness = *fixture->harness;

    AssertError(harness.Crc(ADC), Error::UNKNOWN_TYPE);
    AssertError(harness.ReadChunk(ADC, 0), Error::UNKNOWN_TYPE);
    AssertError(harness.WriteFirst(ADC, Pattern(10, 1), 10, 0), Error::UNKNOWN_TYPE);
}

ZTEST_F(smp_config_group, test_chunked_read_returns_the_configuration) {
    Harness& harness = *fixture->harness;
    harness.canbus->stored = Pattern(3000, 3);

    uint32_t crc = 0;
    const auto data = harness.ReadAll(CANBUS, &crc);

    zassert_true(data == harness.canbus->stored);
    zassert_equal(crc, Crc(harness.canbus->stored));
}

ZTEST_F(smp_config_group, test_read_serves_the_snapshot_taken_at_offset_zero) {
    Harness& harness = *fixture->harness;
    const Bytes original = Pattern(2500, 5);
    harness.canbus->stored = original;

    auto first = harness.ReadChunk(CANBUS, 0);
    zassert_true(first.IsOk());

    harness.canbus->stored = Pattern(2500, 99);

    Bytes data = first.bytes["data"];
    while(data.size() < first.Value("len")) {
        auto response = harness.ReadChunk(CANBUS, data.size());
        zassert_true(response.IsOk());
        data.insert(data.end(), response.bytes["data"].begin(), response.bytes["data"].end());
    }

    zassert_true(data == original, "A change during the read does not mix two configurations");
    zassert_equal(first.Value("crc"), Crc(original));
}

ZTEST_F(smp_config_group, test_read_without_a_snapshot_is_rejected) {
    Harness& harness = *fixture->harness;
    harness.canbus->stored = Pattern(2000, 1);

    AssertError(harness.ReadChunk(CANBUS, 100), Error::BAD_OFFSET);

    zassert_true(harness.ReadChunk(CANBUS, 0).IsOk());
    AssertError(harness.ReadChunk(UI, 100), Error::BAD_OFFSET);
}

ZTEST_F(smp_config_group, test_chunked_write_applies_the_configuration) {
    Harness& harness = *fixture->harness;
    const Bytes data = Pattern(2500, 11);

    const auto first = harness.WriteFirst(CANBUS, std::span(data).first(WRITE_CHUNK_SIZE), data.size(), Crc(data));
    zassert_true(first.IsOk());
    zassert_equal(first.Value("off"), WRITE_CHUNK_SIZE);
    zassert_not_equal(first.Value("tok"), 0);

    const uint32_t token = first.Value("tok");
    const auto second = harness.WriteNext(
        CANBUS, WRITE_CHUNK_SIZE, token, std::span(data).subspan(WRITE_CHUNK_SIZE, WRITE_CHUNK_SIZE)
    );
    zassert_true(second.IsOk());
    zassert_equal(harness.canbus->apply_count, 0, "Nothing is applied before the last chunk");

    const auto last = harness.WriteNext(
        CANBUS, 2 * WRITE_CHUNK_SIZE, token, std::span(data).subspan(2 * WRITE_CHUNK_SIZE)
    );
    zassert_true(last.IsOk());
    zassert_equal(last.Value("off"), data.size());
    zassert_equal(harness.canbus->apply_count, 1);
    zassert_true(harness.canbus->stored == data);

    zassert_true(harness.ReadAll(CANBUS) == data, "The written configuration reads back");
}

ZTEST_F(smp_config_group, test_crc_mismatch_is_not_applied) {
    Harness& harness = *fixture->harness;
    const Bytes data = Pattern(1200, 2);

    AssertError(harness.WriteAll(CANBUS, data, Crc(data) + 1), Error::CRC_MISMATCH);
    zassert_equal(harness.canbus->apply_count, 0);
}

ZTEST_F(smp_config_group, test_rejected_configuration_reports_apply_failed) {
    Harness& harness = *fixture->harness;
    const Bytes data = Pattern(1200, 4);
    harness.canbus->reject = true;

    const auto response = harness.WriteAll(CANBUS, data, Crc(data));
    AssertError(response, Error::APPLY_FAILED);
    zassert_false(response.Has("msg"), "Without a reason there is no msg");
    zassert_equal(harness.canbus->apply_count, 1);

    harness.canbus->reject = false;
    zassert_true(harness.WriteAll(CANBUS, data, Crc(data)).IsOk(), "A failed write closes its session");
}

ZTEST_F(smp_config_group, test_apply_failed_carries_the_managers_reason) {
    Harness& harness = *fixture->harness;
    const Bytes data = Pattern(1200, 4);
    harness.canbus->reject = true;
    harness.canbus->rejection_reason = "Invalid CAN Bus COM configuration. COM bus channel is not configured";

    auto response = harness.WriteAll(CANBUS, data, Crc(data));

    AssertError(response, Error::APPLY_FAILED);
    zassert_equal(response.texts["msg"], harness.canbus->rejection_reason);

    // About the CAN validator's longest message, with names as long as it allows.
    const std::string name(32, 'n');
    harness.canbus->rejection_reason = "Invalid CAN Signal configuration. Channel: 255, Frame ID: 0x1FFFFFFF, Signal: "
        + name + ". Cannot contain duplicate signal names. " + name;
    zassert_equal(harness.WriteAll(CANBUS, data, Crc(data)).texts["msg"], harness.canbus->rejection_reason);

    harness.canbus->rejection_reason.clear();
    zassert_false(harness.WriteAll(CANBUS, data, Crc(data)).Has("msg"), "A reason does not outlive its write");
}

// A manager is meant to refuse with false and a reason. One that throws instead is still a refusal that carries
// what it threw, and the write session ends with it, so the next upload is not BUSY.
ZTEST_F(smp_config_group, test_a_manager_that_throws_refuses_the_write_with_what_it_threw_and_ends_the_session) {
    Harness& harness = *fixture->harness;
    const Bytes data = Pattern(1200, 4);
    harness.canbus->throws = true;
    harness.canbus->thrown_text =
        "Invalid UI Screen configuration. Screen ID: 0. Composition exceeds the limit of 32 nodes.";

    auto response = harness.WriteAll(CANBUS, data, Crc(data));
    AssertError(response, Error::APPLY_FAILED);
    zassert_equal(response.texts["msg"], harness.canbus->thrown_text);

    // Straight after, from another client: no session is left open.
    harness.canbus->thrown_text = "Invalid UI configuration. Duplicate screen IDs.";
    response = harness.WriteAll(CANBUS, data, Crc(data));
    AssertError(response, Error::APPLY_FAILED);
    zassert_equal(response.texts["msg"], harness.canbus->thrown_text);

    // And something that is no std::exception.
    harness.canbus->throws = false;
    harness.canbus->throws_other = true;
    response = harness.WriteAll(CANBUS, data, Crc(data));
    AssertError(response, Error::APPLY_FAILED);
    zassert_true(response.Has("msg"));

    harness.canbus->throws_other = false;
    zassert_true(harness.WriteAll(CANBUS, data, Crc(data)).IsOk(), "The session ended with the refusals");
    zassert_equal(harness.reports->Get().size(), 1U, "Only the good write is an update");
}

ZTEST_F(smp_config_group, test_a_long_reason_is_truncated_between_characters) {
    Harness& harness = *fixture->harness;
    const Bytes data = Pattern(1200, 4);
    harness.canbus->reject = true;

    harness.canbus->rejection_reason = std::string(200, 'x');
    auto response = harness.WriteAll(CANBUS, data, Crc(data));
    AssertError(response, Error::APPLY_FAILED);
    zassert_equal(response.texts["msg"], std::string(ConfigMgmtGroup::MAX_REASON_LENGTH, 'x'));

    // A two-byte UTF-8 character that would straddle the limit is left out whole.
    const std::string prefix(ConfigMgmtGroup::MAX_REASON_LENGTH - 1, 'x');
    harness.canbus->rejection_reason = prefix + "\xC3\xA9";
    response = harness.WriteAll(CANBUS, data, Crc(data));
    zassert_equal(response.texts["msg"], prefix);
}

ZTEST_F(smp_config_group, test_second_writer_is_busy_until_the_owner_restarts) {
    Harness& harness = *fixture->harness;
    const Bytes data = Pattern(2000, 8);

    const auto owner = harness.WriteFirst(CANBUS, std::span(data).first(WRITE_CHUNK_SIZE), data.size(), Crc(data));
    zassert_true(owner.IsOk());
    const uint32_t token = owner.Value("tok");

    AssertError(harness.WriteFirst(UI, Pattern(10, 1), 10, 0), Error::BUSY);

    const auto restarted = harness.WriteFirst(
        CANBUS, std::span(data).first(WRITE_CHUNK_SIZE), data.size(), Crc(data), token
    );
    zassert_true(restarted.IsOk(), "The owner may restart with its token");
    zassert_not_equal(restarted.Value("tok"), token, "A restart opens a new session");
}

ZTEST_F(smp_config_group, test_a_repeated_first_request_gets_the_sessions_token) {
    Harness& harness = *fixture->harness;
    const Bytes data = Pattern(2000, 13);
    const auto first_chunk = std::span(data).first(WRITE_CHUNK_SIZE);

    const auto first = harness.WriteFirst(CANBUS, first_chunk, data.size(), Crc(data));
    zassert_true(first.IsOk());

    // The answer got lost, so the client sends the same request again.
    const auto repeated = harness.WriteFirst(CANBUS, first_chunk, data.size(), Crc(data));
    zassert_true(repeated.IsOk(), "A repeat of the first request is not BUSY");
    zassert_equal(repeated.Value("off"), WRITE_CHUNK_SIZE);
    zassert_equal(repeated.Value("tok"), first.Value("tok"));

    const uint32_t token = repeated.Value("tok");
    zassert_true(harness
            .WriteNext(CANBUS, WRITE_CHUNK_SIZE, token, std::span(data).subspan(WRITE_CHUNK_SIZE, WRITE_CHUNK_SIZE))
            .IsOk());
    zassert_true(
        harness.WriteNext(CANBUS, 2 * WRITE_CHUNK_SIZE, token, std::span(data).subspan(2 * WRITE_CHUNK_SIZE)).IsOk()
    );
    zassert_equal(harness.canbus->apply_count, 1);
    zassert_true(harness.canbus->stored == data);
}

ZTEST_F(smp_config_group, test_only_an_exact_repeat_of_the_first_request_gets_the_token) {
    Harness& harness = *fixture->harness;
    const Bytes data = Pattern(2000, 14);
    const auto first_chunk = std::span(data).first(WRITE_CHUNK_SIZE);

    const auto first = harness.WriteFirst(CANBUS, first_chunk, data.size(), Crc(data));
    zassert_true(first.IsOk());

    Bytes other_chunk(first_chunk.begin(), first_chunk.end());
    other_chunk.back() ^= 0xFF;
    AssertError(harness.WriteFirst(CANBUS, other_chunk, data.size(), Crc(data)), Error::BUSY);
    AssertError(harness.WriteFirst(CANBUS, first_chunk.first(100), data.size(), Crc(data)), Error::BUSY);
    AssertError(harness.WriteFirst(CANBUS, first_chunk, data.size() + 1, Crc(data)), Error::BUSY);
    AssertError(harness.WriteFirst(CANBUS, first_chunk, data.size(), Crc(data) + 1), Error::BUSY);
    AssertError(harness.WriteFirst(UI, first_chunk, data.size(), Crc(data)), Error::BUSY);

    const uint32_t token = first.Value("tok");
    zassert_true(
        harness.WriteNext(CANBUS, WRITE_CHUNK_SIZE, token, std::span(data).subspan(WRITE_CHUNK_SIZE, WRITE_CHUNK_SIZE))
            .IsOk(),
        "The session is untouched"
    );
    AssertError(harness.WriteFirst(CANBUS, first_chunk, data.size(), Crc(data)), Error::BUSY);
}

ZTEST_F(smp_config_group, test_wrong_token_is_rejected) {
    Harness& harness = *fixture->harness;
    const Bytes data = Pattern(2000, 6);

    const auto first = harness.WriteFirst(CANBUS, std::span(data).first(WRITE_CHUNK_SIZE), data.size(), Crc(data));
    const uint32_t token = first.Value("tok");

    AssertError(
        harness.WriteNext(CANBUS, WRITE_CHUNK_SIZE, token + 1, std::span(data).subspan(WRITE_CHUNK_SIZE, 100)),
        Error::BAD_TOKEN
    );
    AssertError(
        harness.WriteNext(UI, WRITE_CHUNK_SIZE, token, std::span(data).subspan(WRITE_CHUNK_SIZE, 100)), Error::BAD_TOKEN
    );
}

ZTEST_F(smp_config_group, test_wrong_offset_reports_where_to_resume) {
    Harness& harness = *fixture->harness;
    const Bytes data = Pattern(1500, 9);

    const auto first = harness.WriteFirst(CANBUS, std::span(data).first(WRITE_CHUNK_SIZE), data.size(), Crc(data));
    const uint32_t token = first.Value("tok");

    const auto wrong = harness.WriteNext(CANBUS, 100, token, std::span(data).subspan(100, 10));
    AssertError(wrong, Error::BAD_OFFSET);
    zassert_equal(wrong.Value("off"), WRITE_CHUNK_SIZE);

    const auto resumed = harness.WriteNext(CANBUS, WRITE_CHUNK_SIZE, token, std::span(data).subspan(WRITE_CHUNK_SIZE));
    zassert_true(resumed.IsOk(), "The session survives a wrong offset");
    zassert_true(harness.canbus->stored == data);
}

ZTEST_F(smp_config_group, test_oversize_transfers_are_rejected) {
    Harness& harness = *fixture->harness;

    AssertError(harness.WriteFirst(UI, Pattern(10, 1), UI_MAX_SIZE + 1, 0), Error::TOO_LARGE);
    AssertError(harness.WriteFirst(CANBUS, Pattern(20, 1), 10, 0), Error::TOO_LARGE);
    zassert_equal(harness.canbus->apply_count, 0);
}

ZTEST_F(smp_config_group, test_idle_session_times_out) {
    Harness& harness = *fixture->harness;
    const Bytes data = Pattern(2000, 12);

    const auto stale = harness.WriteFirst(CANBUS, std::span(data).first(WRITE_CHUNK_SIZE), data.size(), Crc(data));
    const uint32_t token = stale.Value("tok");

    k_msleep(CONFIG_EERIE_LEAP_SMP_CONFIG_SESSION_TIMEOUT_MS + 100);

    AssertError(
        harness.WriteNext(CANBUS, WRITE_CHUNK_SIZE, token, std::span(data).subspan(WRITE_CHUNK_SIZE, 100)),
        Error::BAD_TOKEN
    );
    zassert_true(harness.WriteAll(UI, Pattern(100, 3), Crc(Pattern(100, 3))).IsOk(), "Another client may write now");
}

ZTEST_F(smp_config_group, test_unregistered_group_is_not_supported) {
    Harness& harness = *fixture->harness;
    harness.group->Unregister();

    const auto response = harness.client.Read(SmpGroupId::CONFIG, Id(Command::LIST));

    zassert_equal(response.Value("rc"), MGMT_ERR_ENOTSUP);
}

// A write stores a configuration, which the service reports with its type from the thread that
// applies it: the group's work queue, where logging learns of it (L9).
ZTEST_F(smp_config_group, test_a_write_reports_its_type_from_the_configuration_queue) {
    Harness& harness = *fixture->harness;
    const Bytes data = Pattern(1200, 5);

    zassert_true(harness.WriteAll(CANBUS, data, Crc(data)).IsOk());
    zassert_true(harness.WriteAll(UI, Pattern(100, 3), Crc(Pattern(100, 3))).IsOk());

    const auto reports = harness.reports->Get();
    zassert_equal(reports.size(), 2U);
    zassert_equal(reports[0].type, ConfigurationService::Type::Canbus);
    zassert_equal(reports[1].type, ConfigurationService::Type::Ui);
    for(const auto& report : reports) {
        zassert_equal(
            report.thread, k_work_queue_thread_get(harness.work_queue->GetWorkQueue()),
            "The report runs on the thread that applied the write"
        );
    }
}

ZTEST_F(smp_config_group, test_a_write_with_a_crc_mismatch_reports_nothing) {
    Harness& harness = *fixture->harness;
    const Bytes data = Pattern(1200, 2);

    AssertError(harness.WriteAll(CANBUS, data, Crc(data) + 1), Error::CRC_MISMATCH);

    zassert_equal(harness.reports->Get().size(), 0U);
}

ZTEST_F(smp_config_group, test_a_rejected_write_reports_nothing) {
    Harness& harness = *fixture->harness;
    const Bytes data = Pattern(1200, 4);
    harness.canbus->reject = true;

    AssertError(harness.WriteAll(CANBUS, data, Crc(data)), Error::APPLY_FAILED);
    zassert_equal(harness.canbus->apply_count, 1);

    zassert_equal(harness.reports->Get().size(), 0U, "A rejected write is not an update");
}

ZTEST_F(smp_config_group, test_a_session_that_times_out_reports_nothing) {
    Harness& harness = *fixture->harness;
    const Bytes data = Pattern(2000, 12);

    zassert_true(harness.WriteFirst(CANBUS, std::span(data).first(WRITE_CHUNK_SIZE), data.size(), Crc(data)).IsOk());
    k_msleep(CONFIG_EERIE_LEAP_SMP_CONFIG_SESSION_TIMEOUT_MS + 100);

    zassert_equal(harness.reports->Get().size(), 0U, "A write that never finished stores nothing");
}
```
