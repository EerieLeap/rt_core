## CMakeLists.txt
```
cmake_minimum_required(VERSION 3.20.0)

include(${CMAKE_CURRENT_SOURCE_DIR}/../../../rt_core_test.cmake)

find_package(Zephyr REQUIRED HINTS $ENV{ZEPHYR_BASE})
project(unit_subsys_value_randomizers)

file(GLOB_RECURSE TEST_SOURCES src/*.c src/*.cpp)

target_sources(app PRIVATE ${TEST_SOURCES})
```

## prj.conf
```kconfig
CONFIG_ZTEST=y

# Language and Compiler
CONFIG_CPP=y
CONFIG_PICOLIBC=y
CONFIG_STD_CPP23=y
CONFIG_REQUIRES_FULL_LIBCPP=y
CONFIG_CPP_EXCEPTIONS=y
CONFIG_CPP_RTTI=y

# Memory
CONFIG_HEAP_MEM_POOL_SIZE=100000

# C++ exception unwinding needs considerably more stack than the ztest defaults.
CONFIG_MAIN_STACK_SIZE=8192
CONFIG_ZTEST_STACK_SIZE=8192

# Logging And Debugging
CONFIG_LOG=y
CONFIG_TEST_RANDOM_GENERATOR=y
CONFIG_THREAD_ANALYZER=y
CONFIG_THREAD_ANALYZER_USE_LOG=y
CONFIG_THREAD_NAME=y
CONFIG_SYS_HEAP_RUNTIME_STATS=y
CONFIG_THREAD_ANALYZER_ISR_STACK_USAGE=n
CONFIG_TIMING_FUNCTIONS=y

CONFIG_EERIE_LEAP_RT_CORE=y
CONFIG_EERIE_LEAP_ADC=y
CONFIG_EERIE_LEAP_RANDOM=y
CONFIG_EERIE_LEAP_GPIO=y
```

## src/adc_random_signal.cpp
```c
#include <cmath>

#include <zephyr/ztest.h>

#include "subsys/adc/adc_random_signal.h"

using namespace eerie_leap::subsys::adc;

namespace {

AdcRandomSignalConfig Config(uint32_t seed = 42) {
    return { .volts_max = 3.3F, .move_min_ms = 200, .move_max_ms = 1000, .hold_max_ms = 500, .seed = seed };
}

} // namespace

ZTEST_SUITE(adc_random_signal, NULL, NULL, NULL, NULL, NULL);

ZTEST(adc_random_signal, test_stays_within_zero_and_volts_max) {
    AdcRandomSignal signal(Config());

    for(int64_t t = 0; t < 120000; t += 7) {
        const float v = signal.At(t);
        zassert_true(v >= 0.0F && v <= 3.3F, "t=%lld v=%f", t, static_cast<double>(v));
    }
}

ZTEST(adc_random_signal, test_is_continuous) {
    AdcRandomSignal signal(Config());

    // The fastest possible move covers at most 3.3 V in 200 ms; a 1 ms step may change by the
    // smoothstep's peak slope of 1.5 times that average.
    const float max_step = 3.3F / 200.0F * 1.5F * 1.01F;

    float last = signal.At(0);
    for(int64_t t = 1; t < 60000; t++) {
        const float v = signal.At(t);
        zassert_true(std::fabs(v - last) <= max_step, "t=%lld jump %f", t, static_cast<double>(v - last));
        last = v;
    }
}

ZTEST(adc_random_signal, test_moves_and_holds) {
    AdcRandomSignal signal(Config());

    int moving = 0;
    int still = 0;
    float last = signal.At(0);
    for(int64_t t = 1; t < 60000; t++) {
        const float v = signal.At(t);
        if(v == last)
            still++;
        else
            moving++;
        last = v;
    }

    zassert_true(moving > 1000, "moving %d", moving);
    zassert_true(still > 1000, "still %d", still);
}

ZTEST(adc_random_signal, test_covers_the_range_over_time) {
    AdcRandomSignal signal(Config());
    float min = 99.0F;
    float max = -1.0F;

    for(int64_t t = 0; t < 600000; t += 10) {
        const float v = signal.At(t);
        min = v < min ? v : min;
        max = v > max ? v : max;
    }

    zassert_true(min < 0.4F, "%f", static_cast<double>(min));
    zassert_true(max > 2.9F, "%f", static_cast<double>(max));
}

ZTEST(adc_random_signal, test_same_seed_same_signal_other_seed_differs) {
    AdcRandomSignal a(Config(5));
    AdcRandomSignal b(Config(5));
    AdcRandomSignal c(Config(6));
    int different = 0;

    for(int64_t t = 0; t < 20000; t += 13) {
        const float va = a.At(t);
        zassert_equal(va, b.At(t));
        different += va != c.At(t) ? 1 : 0;
    }

    zassert_true(different > 100);
}

ZTEST(adc_random_signal, test_move_times_follow_the_configured_bounds) {
    // Without a hold and with a fixed move time the signal is always moving, and the value is a
    // smoothstep between two targets: it reaches each target exactly at every move_ms.
    AdcRandomSignal signal({ .volts_max = 3.3F, .move_min_ms = 500, .move_max_ms = 500, .hold_max_ms = 0, .seed = 3 });

    const float start = signal.At(0);
    const float mid = signal.At(250);
    const float end = signal.At(500);
    const float next_mid = signal.At(750);
    const float next_end = signal.At(1000);

    // Halfway through a smoothstep is the midpoint of the move.
    zassert_within(mid, (start + end) / 2.0F, 0.001F);
    zassert_within(next_mid, (end + next_end) / 2.0F, 0.001F);
}

ZTEST(adc_random_signal, test_hold_is_flat_for_at_most_hold_max) {
    AdcRandomSignal signal(
        { .volts_max = 3.3F, .move_min_ms = 100, .move_max_ms = 100, .hold_max_ms = 300, .seed = 11 }
    );

    // Longest run of equal values, in ms, must not exceed hold_max (+1 for the sample that ends it).
    int64_t run_start = 0;
    int64_t longest = 0;
    float last = signal.At(0);
    for(int64_t t = 1; t < 120000; t++) {
        const float v = signal.At(t);
        if(v != last) {
            longest = (t - run_start) > longest ? (t - run_start) : longest;
            run_start = t;
        }
        last = v;
    }

    zassert_true(longest <= 301, "%lld", longest);
    zassert_true(longest >= 100, "%lld", longest);
}

ZTEST(adc_random_signal, test_a_long_gap_restarts_from_the_current_target) {
    AdcRandomSignal signal(Config());

    (void)signal.At(0);

    // A year later: bounded work, in range, and moving again.
    const int64_t later = 365LL * 24 * 3600 * 1000;
    const float v = signal.At(later);
    zassert_true(v >= 0.0F && v <= 3.3F);

    int changed = 0;
    float last = v;
    for(int64_t t = later + 1; t < later + 20000; t++) {
        const float next = signal.At(t);
        changed += next != last ? 1 : 0;
        last = next;
    }

    zassert_true(changed > 100);
}

ZTEST(adc_random_signal, test_a_gap_is_continuous_with_the_target_it_restarts_from) {
    AdcRandomSignal signal({ .volts_max = 3.3F, .move_min_ms = 100, .move_max_ms = 100, .hold_max_ms = 0, .seed = 9 });

    (void)signal.At(0);
    const float after_gap = signal.At(1000000);
    const float soon = signal.At(1000001);

    zassert_within(after_gap, soon, 0.1F);
}

ZTEST(adc_random_signal, test_time_going_back_does_not_break_the_signal) {
    AdcRandomSignal signal(Config());

    (void)signal.At(5000);
    const float v = signal.At(100);

    zassert_true(v >= 0.0F && v <= 3.3F);
}

ZTEST(adc_random_signal, test_degenerate_config_is_tolerated) {
    // max below min, zero volts: no division by zero, no NaN.
    AdcRandomSignal inverted(
        { .volts_max = 1.0F, .move_min_ms = 900, .move_max_ms = 100, .hold_max_ms = 0, .seed = 1 }
    );
    AdcRandomSignal zero_move({ .volts_max = 1.0F, .move_min_ms = 0, .move_max_ms = 0, .hold_max_ms = 0, .seed = 1 });
    AdcRandomSignal flat({ .volts_max = 0.0F, .move_min_ms = 100, .move_max_ms = 200, .hold_max_ms = 10, .seed = 1 });

    for(int64_t t = 0; t < 5000; t += 3) {
        zassert_true(!std::isnan(inverted.At(t)));
        zassert_true(!std::isnan(zero_move.At(t)));
        zassert_equal(flat.At(t), 0.0F);
    }
}
```

## src/gpio_random_signal.cpp
```c
#include <zephyr/ztest.h>

#include "subsys/gpio/gpio_random_signal.h"

using namespace eerie_leap::subsys::gpio;

ZTEST_SUITE(gpio_random_signal, NULL, NULL, NULL, NULL, NULL);

ZTEST(gpio_random_signal, test_flip_intervals_stay_within_the_hold_bounds) {
    GpioRandomSignal signal({ .hold_min_ms = 100, .hold_max_ms = 300, .seed = 8 });

    bool level = signal.At(1000);
    int64_t last_flip = -1;
    int flips = 0;

    for(int64_t t = 1000; t < 200000; t++) {
        const bool now = signal.At(t);
        if(now != level) {
            if(last_flip >= 0) {
                const int64_t interval = t - last_flip;
                zassert_true(interval >= 100 && interval <= 300, "interval %lld", interval);
            }
            last_flip = t;
            level = now;
            flips++;
        }
    }

    zassert_true(flips > 500, "%d", flips);
}

ZTEST(gpio_random_signal, test_next_flip_is_exactly_when_the_level_changes) {
    GpioRandomSignal signal({ .hold_min_ms = 50, .hold_max_ms = 400, .seed = 21 });

    bool level = signal.At(0);
    for(int i = 0; i < 200; i++) {
        const int64_t flip = signal.GetNextFlipMs();

        zassert_true(flip > 0);
        zassert_equal(signal.At(flip - 1), level, "no flip before the announced time");

        level = !level;
        zassert_equal(signal.At(flip), level, "flip at the announced time");
    }
}

ZTEST(gpio_random_signal, test_first_flip_is_a_hold_after_the_first_call) {
    GpioRandomSignal signal({ .hold_min_ms = 100, .hold_max_ms = 200, .seed = 4 });

    (void)signal.At(5000);

    zassert_true(signal.GetNextFlipMs() >= 5100 && signal.GetNextFlipMs() <= 5200);
}

ZTEST(gpio_random_signal, test_same_seed_is_deterministic) {
    GpioRandomSignal a({ .hold_min_ms = 10, .hold_max_ms = 90, .seed = 77 });
    GpioRandomSignal b({ .hold_min_ms = 10, .hold_max_ms = 90, .seed = 77 });
    GpioRandomSignal c({ .hold_min_ms = 10, .hold_max_ms = 90, .seed = 78 });
    int different = 0;

    for(int64_t t = 0; t < 20000; t += 3) {
        const bool level = a.At(t);
        zassert_equal(level, b.At(t));
        different += level != c.At(t) ? 1 : 0;
    }

    zassert_true(different > 100);
}

ZTEST(gpio_random_signal, test_both_levels_occur) {
    GpioRandomSignal signal({ .hold_min_ms = 10, .hold_max_ms = 50, .seed = 2 });
    int high = 0;

    for(int64_t t = 0; t < 10000; t++)
        high += signal.At(t) ? 1 : 0;

    zassert_true(high > 3000 && high < 7000, "%d", high);
}

ZTEST(gpio_random_signal, test_a_long_gap_costs_bounded_work_and_keeps_flipping) {
    GpioRandomSignal signal({ .hold_min_ms = 1, .hold_max_ms = 2, .seed = 6 });

    (void)signal.At(0);

    const int64_t later = 365LL * 24 * 3600 * 1000;
    (void)signal.At(later);

    // The next flip is a hold after the restart, not a long way behind.
    zassert_true(signal.GetNextFlipMs() > later && signal.GetNextFlipMs() <= later + 2);
}

ZTEST(gpio_random_signal, test_zero_hold_is_raised_to_one_ms) {
    GpioRandomSignal signal({ .hold_min_ms = 0, .hold_max_ms = 0, .seed = 3 });

    (void)signal.At(100);

    zassert_equal(signal.GetNextFlipMs(), 101);
}
```

## src/xorshift32.cpp
```c
#include <zephyr/ztest.h>

#include "utilities/math/xorshift32.hpp"

using eerie_leap::utilities::math::Xorshift32;

ZTEST_SUITE(xorshift32, NULL, NULL, NULL, NULL, NULL);

ZTEST(xorshift32, test_same_seed_gives_the_same_sequence) {
    Xorshift32 a(1234);
    Xorshift32 b(1234);

    for(int i = 0; i < 100; i++)
        zassert_equal(a.Next(), b.Next());
}

ZTEST(xorshift32, test_different_seeds_give_different_sequences) {
    Xorshift32 a(1);
    Xorshift32 b(2);

    int equal = 0;
    for(int i = 0; i < 100; i++)
        equal += a.Next() == b.Next() ? 1 : 0;

    zassert_true(equal < 3);
}

ZTEST(xorshift32, test_known_first_value_for_seed_1) {
    // x ^= x << 13; x ^= x >> 17; x ^= x << 5 from 1.
    Xorshift32 rng(1);

    zassert_equal(rng.Next(), 270369U);
}

ZTEST(xorshift32, test_zero_seed_is_replaced_and_keeps_moving) {
    Xorshift32 rng(0);

    const uint32_t first = rng.Next();
    const uint32_t second = rng.Next();

    zassert_not_equal(first, 0U);
    zassert_not_equal(second, 0U);
    zassert_not_equal(first, second);
}

ZTEST(xorshift32, test_float_stays_in_unit_interval_and_spreads) {
    Xorshift32 rng(99);
    float min = 1.0F;
    float max = 0.0F;

    for(int i = 0; i < 5000; i++) {
        const float v = rng.NextFloat();
        zassert_true(v >= 0.0F && v < 1.0F, "%f", static_cast<double>(v));
        min = v < min ? v : min;
        max = v > max ? v : max;
    }

    zassert_true(min < 0.05F);
    zassert_true(max > 0.95F);
}

ZTEST(xorshift32, test_range_includes_both_ends_and_stays_inside) {
    Xorshift32 rng(7);
    bool saw_min = false;
    bool saw_max = false;

    for(int i = 0; i < 2000; i++) {
        const uint32_t v = rng.NextInRange(10, 14);
        zassert_true(v >= 10 && v <= 14, "%u", v);
        saw_min = saw_min || v == 10;
        saw_max = saw_max || v == 14;
    }

    zassert_true(saw_min);
    zassert_true(saw_max);
}

ZTEST(xorshift32, test_degenerate_and_full_ranges) {
    Xorshift32 rng(5);

    zassert_equal(rng.NextInRange(8, 8), 8U);
    zassert_equal(rng.NextInRange(9, 3), 9U);

    // The full span overflows 32 bits; it must not wrap into a division by zero.
    for(int i = 0; i < 10; i++)
        (void)rng.NextInRange(0, UINT32_MAX);
}
```
