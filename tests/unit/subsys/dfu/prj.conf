## CMakeLists.txt
```
cmake_minimum_required(VERSION 3.20.0)

include(${CMAKE_CURRENT_SOURCE_DIR}/../../../rt_core_test.cmake)

find_package(Zephyr REQUIRED HINTS $ENV{ZEPHYR_BASE})
project(unit_subsys_dfu)

file(GLOB_RECURSE TEST_SOURCES src/*.c src/*.cpp)

target_sources(app PRIVATE ${TEST_SOURCES})
```

## prj.conf
```kconfig
CONFIG_ZTEST=y

# Language and Compiler
CONFIG_CPP=y
CONFIG_PICOLIBC=y
CONFIG_STD_CPP23=y
CONFIG_REQUIRES_FULL_LIBCPP=y
CONFIG_CPP_EXCEPTIONS=y
CONFIG_CPP_RTTI=y

# Memory
CONFIG_HEAP_MEM_POOL_SIZE=100000

# C++ exception unwinding needs considerably more stack than the ztest defaults.
CONFIG_MAIN_STACK_SIZE=8192
CONFIG_ZTEST_STACK_SIZE=8192

# Logging And Debugging
CONFIG_LOG=y
CONFIG_TEST_RANDOM_GENERATOR=y
CONFIG_THREAD_NAME=y

# ThreadBase::InitializeStack() falls back to k_thread_stack_alloc().
CONFIG_THREAD_STACK_INFO=y
CONFIG_DYNAMIC_THREAD=y
CONFIG_DYNAMIC_THREAD_ALLOC=y

# The dfu subsystem builds with image management, which needs a flash with image slots (native_sim's).
CONFIG_FLASH=y
CONFIG_FLASH_MAP=y

CONFIG_EERIE_LEAP_RT_CORE=y
CONFIG_EERIE_LEAP_SMP=y
CONFIG_EERIE_LEAP_DFU=y
```

## src/dfu_test_support.h
```c
#pragma once

#include <algorithm>
#include <cstddef>
#include <cstdint>
#include <optional>
#include <span>
#include <string_view>
#include <vector>

#include <zephyr/ztest.h>

#include "subsys/dfu/image_identity.h"

// Builds MCUboot image files for the identity tests: header, payload, protected TLVs and a few
// unprotected ones, laid out as imgtool does.
namespace dfu_test {

using eerie_leap::subsys::dfu::ImageIdentity;
using eerie_leap::subsys::dfu::ImageIdentityCollector;
using eerie_leap::subsys::dfu::ImageIdentityResult;

using Bytes = std::vector<uint8_t>;

inline constexpr uint16_t OWN_PRODUCT = 0xA401;
inline constexpr std::string_view OWN_BOARD = "esp32s3_touch_amoled_1_75/esp32s3/procpu";

inline ImageIdentity Identity(uint16_t product, std::string_view board) {
    const auto identity = ImageIdentity::Create(product, board);
    zassert_true(identity.has_value(), "Identity does not fit");

    return *identity;
}

inline ImageIdentity OwnIdentity() {
    return Identity(OWN_PRODUCT, OWN_BOARD);
}

inline void PutU16(Bytes& bytes, uint16_t value) {
    bytes.push_back(static_cast<uint8_t>(value & 0xFF));
    bytes.push_back(static_cast<uint8_t>(value >> 8));
}

inline void PutU32(Bytes& bytes, uint32_t value) {
    PutU16(bytes, static_cast<uint16_t>(value & 0xFFFF));
    PutU16(bytes, static_cast<uint16_t>(value >> 16));
}

// One TLV: type, length, value.
inline Bytes Tlv(uint16_t type, std::span<const uint8_t> value) {
    Bytes tlv;
    PutU16(tlv, type);
    PutU16(tlv, static_cast<uint16_t>(value.size()));
    tlv.insert(tlv.end(), value.begin(), value.end());

    return tlv;
}

inline Bytes IdentityTlv(const ImageIdentity& identity) {
    Bytes value(ImageIdentity::MAX_ENCODED_SIZE);
    value.resize(identity.Encode(value));

    return Tlv(ImageIdentity::TLV_TYPE, value);
}

// A protected TLV area: the info header (magic, total size) and the TLVs.
inline Bytes ProtectedArea(const std::vector<Bytes>& tlvs) {
    Bytes body;
    for(const Bytes& tlv : tlvs)
        body.insert(body.end(), tlv.begin(), tlv.end());

    Bytes area;
    PutU16(area, ImageIdentityCollector::PROTECTED_TLV_MAGIC);
    PutU16(area, static_cast<uint16_t>(4 + body.size()));
    area.insert(area.end(), body.begin(), body.end());

    return area;
}

struct ImageParts {
    size_t header_size = ImageIdentityCollector::HEADER_SIZE;
    size_t payload_size = 300;
    // The protected TLV area as it lies in the file; empty for an image without one.
    Bytes protected_area;
    // Overrides, to build malformed headers.
    uint32_t magic = ImageIdentityCollector::HEADER_MAGIC;
    std::optional<uint16_t> protected_size_field;
    // Unprotected TLVs (hash, signature) after the protected ones.
    size_t unprotected_size = 100;
};

inline Bytes MakeImage(const ImageParts& parts) {
    Bytes image;
    PutU32(image, parts.magic);
    PutU32(image, 0);
    PutU16(image, static_cast<uint16_t>(parts.header_size));
    PutU16(image, parts.protected_size_field.value_or(static_cast<uint16_t>(parts.protected_area.size())));
    PutU32(image, static_cast<uint32_t>(parts.payload_size));
    // Flags, version and padding up to the 32 bytes of the header.
    image.resize(ImageIdentityCollector::HEADER_SIZE, 0);

    image.resize(parts.header_size, 0);
    for(size_t i = 0; i < parts.payload_size; i++)
        image.push_back(static_cast<uint8_t>(0x55 + i));

    image.insert(image.end(), parts.protected_area.begin(), parts.protected_area.end());
    image.insert(image.end(), parts.unprotected_size, 0xEE);

    return image;
}

// An image with the identity in the protected TLVs.
inline Bytes MakeIdentityImage(const ImageIdentity& identity) {
    ImageParts parts;
    parts.protected_area = ProtectedArea({ IdentityTlv(identity) });

    return MakeImage(parts);
}

// Feeds @p image to @p collector in one chunk each of @p sizes, the rest in the last.
inline ImageIdentityResult
FeedChunks(ImageIdentityCollector& collector, const Bytes& image, std::span<const size_t> sizes) {
    ImageIdentityResult result = ImageIdentityResult::NEED_MORE;

    size_t offset = 0;
    for(size_t i = 0; i <= sizes.size() && offset < image.size(); i++) {
        const size_t size = i < sizes.size() ? sizes[i] : image.size() - offset;
        const size_t length = std::min(size, image.size() - offset);
        result = collector.Feed(offset, std::span(image).subspan(offset, length), image.size());
        offset += length;
    }

    return result;
}

// Feeds @p image in two chunks, cut after @p split bytes.
inline ImageIdentityResult FeedSplit(ImageIdentityCollector& collector, const Bytes& image, size_t split) {
    const size_t sizes[] = { split };

    return FeedChunks(collector, image, sizes);
}

} // namespace dfu_test
```

## src/image_identity.cpp
```c
#include <array>
#include <string>

#include <zephyr/ztest.h>

#include "dfu_test_support.h"

using namespace dfu_test;

ZTEST_SUITE(dfu_image_identity, NULL, NULL, NULL, NULL, NULL);

ZTEST(dfu_image_identity, test_encode_is_format_product_length_board) {
    const ImageIdentity identity = Identity(0xA401, "native_sim/native");

    std::array<uint8_t, ImageIdentity::MAX_ENCODED_SIZE> buffer{};
    const size_t size = identity.Encode(buffer);

    const std::string_view board = "native_sim/native";
    zassert_equal(size, 4 + board.size());
    zassert_equal(buffer[0], 1, "format");
    zassert_equal(buffer[1], 0x01, "product, low byte first");
    zassert_equal(buffer[2], 0xA4);
    zassert_equal(buffer[3], board.size());
    zassert_true(std::equal(board.begin(), board.end(), buffer.begin() + 4));
}

ZTEST(dfu_image_identity, test_encode_into_a_buffer_that_is_too_small_writes_nothing) {
    const ImageIdentity identity = OwnIdentity();

    std::array<uint8_t, 4 + OWN_BOARD.size() - 1> buffer{};
    zassert_equal(identity.Encode(buffer), 0);
    zassert_true(std::ranges::all_of(buffer, [](uint8_t byte) {
        return byte == 0;
    }));
}

ZTEST(dfu_image_identity, test_parse_returns_what_was_encoded) {
    const ImageIdentity identity = OwnIdentity();

    std::array<uint8_t, ImageIdentity::MAX_ENCODED_SIZE> buffer{};
    const size_t size = identity.Encode(buffer);

    const auto parsed = ImageIdentity::Parse(std::span(buffer).first(size));

    zassert_true(parsed.has_value());
    zassert_true(*parsed == identity);
    zassert_equal(parsed->GetProductId(), OWN_PRODUCT);
    zassert_true(parsed->GetBoard() == OWN_BOARD);
}

ZTEST(dfu_image_identity, test_longest_board_fits_and_longer_does_not) {
    const std::string longest(ImageIdentity::MAX_BOARD_LENGTH, 'b');

    const auto fits = ImageIdentity::Create(1, longest);
    zassert_true(fits.has_value());
    zassert_equal(fits->GetBoard().size(), ImageIdentity::MAX_BOARD_LENGTH);

    zassert_false(ImageIdentity::Create(1, longest + "b").has_value());
}

ZTEST(dfu_image_identity, test_longest_board_fills_the_whole_protected_area) {
    const std::string longest(ImageIdentity::MAX_BOARD_LENGTH, 'b');
    const ImageIdentity identity = Identity(OWN_PRODUCT, longest);
    const Bytes image = MakeIdentityImage(identity);

    ImageIdentityCollector collector(identity);
    zassert_equal(collector.Feed(0, image, image.size()), ImageIdentityResult::MATCH);

    // The area is the 128 bytes the unit accepts.
    zassert_equal(ProtectedArea({ IdentityTlv(identity) }).size(), ImageIdentityCollector::MAX_PROTECTED_TLV_SIZE);
}

ZTEST(dfu_image_identity, test_board_must_be_printable_ascii) {
    zassert_false(ImageIdentity::Create(1, std::string_view("a\tb")).has_value());
    zassert_false(ImageIdentity::Create(1, std::string_view("a\0b", 3)).has_value());
    zassert_false(ImageIdentity::Create(1, "caf\xC3\xA9").has_value());
    zassert_true(ImageIdentity::Create(1, "").has_value(), "An empty board is well-formed; it never matches");
}

ZTEST(dfu_image_identity, test_parse_refuses_malformed_values) {
    const Bytes good = { 1, 0x01, 0xA4, 3, 'a', 'b', 'c' };
    zassert_true(ImageIdentity::Parse(good).has_value());

    // Too short for the fixed part.
    zassert_false(ImageIdentity::Parse(std::span(good).first(3)).has_value());
    zassert_false(ImageIdentity::Parse({}).has_value());

    // Another format.
    Bytes other_format = good;
    other_format[0] = 2;
    zassert_false(ImageIdentity::Parse(other_format).has_value());

    // The board length says more, or less, than the value holds.
    Bytes longer = good;
    longer[3] = 4;
    zassert_false(ImageIdentity::Parse(longer).has_value());
    Bytes shorter = good;
    shorter[3] = 2;
    zassert_false(ImageIdentity::Parse(shorter).has_value());

    // A character outside printable ASCII.
    Bytes control = good;
    control[5] = 0x07;
    zassert_false(ImageIdentity::Parse(control).has_value());
    Bytes high = good;
    high[5] = 0xC3;
    zassert_false(ImageIdentity::Parse(high).has_value());

    // A board above the limit.
    Bytes oversize = { 1, 0x01, 0xA4, ImageIdentity::MAX_BOARD_LENGTH + 1 };
    oversize.insert(oversize.end(), ImageIdentity::MAX_BOARD_LENGTH + 1, 'x');
    zassert_false(ImageIdentity::Parse(oversize).has_value());
}

ZTEST(dfu_image_identity, test_check_compares_product_then_board) {
    const ImageIdentity own = OwnIdentity();

    zassert_equal(own.Check(Identity(OWN_PRODUCT, OWN_BOARD)), ImageIdentityResult::MATCH);
    zassert_equal(own.Check(Identity(OWN_PRODUCT + 1, OWN_BOARD)), ImageIdentityResult::WRONG_PRODUCT);
    zassert_equal(
        own.Check(Identity(OWN_PRODUCT, "esp32p4_wifi6_touch_lcd_5/esp32p4/hpcore")), ImageIdentityResult::WRONG_BOARD
    );
    // A prefix of the board is another board.
    zassert_equal(
        own.Check(Identity(OWN_PRODUCT, "esp32s3_touch_amoled_1_75/esp32s3")), ImageIdentityResult::WRONG_BOARD
    );
    // Both differ: the product is what is reported.
    zassert_equal(own.Check(Identity(0x1234, "native_sim")), ImageIdentityResult::WRONG_PRODUCT);
}
```

## src/image_identity_collector.cpp
```c
#include <utility>

#include <zephyr/ztest.h>

#include "dfu_test_support.h"

using namespace dfu_test;

namespace {

constexpr size_t NO_PAYLOAD = 0;

ImageParts WithArea(Bytes area) {
    ImageParts parts;
    parts.protected_area = std::move(area);

    return parts;
}

// The protected TLV area with the identity of @p identity among filler TLVs, before and after.
Bytes AreaWithFillers(const ImageIdentity& identity) {
    const Bytes filler_value(7, 0x42);

    return ProtectedArea({ Tlv(0x00A1, filler_value), IdentityTlv(identity), Tlv(0x00A2, filler_value) });
}

} // namespace

ZTEST_SUITE(dfu_image_identity_collector, NULL, NULL, NULL, NULL, NULL);

ZTEST(dfu_image_identity_collector, test_image_of_this_unit_matches_in_one_chunk) {
    ImageIdentityCollector collector(OwnIdentity());
    const Bytes image = MakeIdentityImage(OwnIdentity());

    zassert_equal(collector.Feed(0, image, image.size()), ImageIdentityResult::MATCH);
    zassert_equal(collector.GetResult(), ImageIdentityResult::MATCH);
}

ZTEST(dfu_image_identity_collector, test_identity_among_other_protected_tlvs_is_found) {
    ImageIdentityCollector collector(OwnIdentity());
    const Bytes image = MakeImage(WithArea(AreaWithFillers(OwnIdentity())));

    zassert_equal(collector.Feed(0, image, image.size()), ImageIdentityResult::MATCH);
}

ZTEST(dfu_image_identity_collector, test_tlv_area_split_at_every_offset_across_two_chunks) {
    const Bytes image = MakeImage(WithArea(AreaWithFillers(OwnIdentity())));

    for(size_t split = 1; split < image.size(); split++) {
        ImageIdentityCollector collector(OwnIdentity());

        const ImageIdentityResult result = FeedSplit(collector, image, split);
        zassert_equal(
            result, ImageIdentityResult::MATCH, "Split after %zu bytes: result %d", split, static_cast<int>(result)
        );
    }
}

ZTEST(dfu_image_identity_collector, test_a_decision_comes_with_the_chunk_that_completes_the_area) {
    const Bytes image = MakeImage(WithArea(AreaWithFillers(OwnIdentity())));
    const size_t area_end = ImageIdentityCollector::HEADER_SIZE + 300 + AreaWithFillers(OwnIdentity()).size();

    for(size_t split = ImageIdentityCollector::HEADER_SIZE; split < image.size(); split++) {
        ImageIdentityCollector collector(OwnIdentity());

        const ImageIdentityResult first = collector.Feed(0, std::span(image).first(split), image.size());
        zassert_equal(
            first, split >= area_end ? ImageIdentityResult::MATCH : ImageIdentityResult::NEED_MORE,
            "Split after %zu bytes", split
        );
    }
}

ZTEST(dfu_image_identity_collector, test_one_byte_chunks_match) {
    ImageIdentityCollector collector(OwnIdentity());
    const Bytes image = MakeImage(WithArea(AreaWithFillers(OwnIdentity())));

    ImageIdentityResult result = ImageIdentityResult::NEED_MORE;
    for(size_t offset = 0; offset < image.size(); offset++)
        result = collector.Feed(offset, std::span(image).subspan(offset, 1), image.size());

    zassert_equal(result, ImageIdentityResult::MATCH);
}

ZTEST(dfu_image_identity_collector, test_chunks_of_various_sizes_match) {
    const Bytes image = MakeImage(WithArea(AreaWithFillers(OwnIdentity())));

    for(const size_t size : { 7U, 31U, 32U, 33U, 64U, 100U, 256U }) {
        ImageIdentityCollector collector(OwnIdentity());

        ImageIdentityResult result = ImageIdentityResult::NEED_MORE;
        for(size_t offset = 0; offset < image.size(); offset += size) {
            const size_t length = std::min(size, image.size() - offset);
            result = collector.Feed(offset, std::span(image).subspan(offset, length), image.size());
        }

        zassert_equal(result, ImageIdentityResult::MATCH, "Chunks of %zu bytes", size);
    }
}

ZTEST(dfu_image_identity_collector, test_larger_header_size_moves_the_area) {
    ImageParts parts = WithArea(ProtectedArea({ IdentityTlv(OwnIdentity()) }));
    parts.header_size = 0x200;
    const Bytes image = MakeImage(parts);

    for(size_t split = 1; split < image.size(); split += 13) {
        ImageIdentityCollector collector(OwnIdentity());
        zassert_equal(FeedSplit(collector, image, split), ImageIdentityResult::MATCH, "Split after %zu bytes", split);
    }
}

ZTEST(dfu_image_identity_collector, test_wrong_product_at_every_split) {
    const Bytes image = MakeIdentityImage(Identity(OWN_PRODUCT + 1, OWN_BOARD));

    for(size_t split = 1; split < image.size(); split++) {
        ImageIdentityCollector collector(OwnIdentity());
        zassert_equal(
            FeedSplit(collector, image, split), ImageIdentityResult::WRONG_PRODUCT, "Split after %zu bytes", split
        );
    }
}

ZTEST(dfu_image_identity_collector, test_wrong_board_at_every_split) {
    const Bytes image = MakeIdentityImage(Identity(OWN_PRODUCT, "esp32p4_wifi6_touch_lcd_5/esp32p4/hpcore"));

    for(size_t split = 1; split < image.size(); split++) {
        ImageIdentityCollector collector(OwnIdentity());
        zassert_equal(
            FeedSplit(collector, image, split), ImageIdentityResult::WRONG_BOARD, "Split after %zu bytes", split
        );
    }
}

ZTEST(dfu_image_identity_collector, test_image_without_protected_tlvs_is_refused_with_its_first_chunk) {
    ImageIdentityCollector collector(OwnIdentity());
    const Bytes image = MakeImage(ImageParts{});

    // Only the first 64 bytes are sent: the decision does not wait for the end.
    zassert_equal(collector.Feed(0, std::span(image).first(64), image.size()), ImageIdentityResult::NO_IDENTITY);
    // And it stays, whatever follows.
    zassert_equal(collector.Feed(64, std::span(image).subspan(64, 64), image.size()), ImageIdentityResult::NO_IDENTITY);
}

ZTEST(dfu_image_identity_collector, test_protected_tlvs_without_identity_are_refused_when_complete) {
    const Bytes image = MakeImage(WithArea(ProtectedArea({ Tlv(0x00A1, Bytes(8, 1)) })));

    for(size_t split = 1; split < image.size(); split++) {
        ImageIdentityCollector collector(OwnIdentity());
        zassert_equal(
            FeedSplit(collector, image, split), ImageIdentityResult::NO_IDENTITY, "Split after %zu bytes", split
        );
    }
}

ZTEST(dfu_image_identity_collector, test_empty_protected_area_has_no_identity) {
    ImageIdentityCollector collector(OwnIdentity());
    const Bytes image = MakeImage(WithArea(ProtectedArea({})));

    zassert_equal(collector.Feed(0, image, image.size()), ImageIdentityResult::NO_IDENTITY);
}

ZTEST(dfu_image_identity_collector, test_area_of_the_largest_size_is_accepted_and_a_larger_one_refused) {
    // 128 bytes: info header, a filler and the identity.
    const Bytes identity_tlv = IdentityTlv(OwnIdentity());
    const size_t filler_value_size = ImageIdentityCollector::MAX_PROTECTED_TLV_SIZE - 4 - identity_tlv.size() - 4;
    const Bytes largest = ProtectedArea({ Tlv(0x00A1, Bytes(filler_value_size, 9)), identity_tlv });
    zassert_equal(largest.size(), ImageIdentityCollector::MAX_PROTECTED_TLV_SIZE);

    ImageIdentityCollector accepting(OwnIdentity());
    const Bytes accepted = MakeImage(WithArea(largest));
    zassert_equal(accepting.Feed(0, accepted, accepted.size()), ImageIdentityResult::MATCH);

    // One byte more: the area is refused with the first chunk, before it is complete.
    Bytes oversize = ProtectedArea({ Tlv(0x00A1, Bytes(filler_value_size + 1, 9)), identity_tlv });
    zassert_equal(oversize.size(), ImageIdentityCollector::MAX_PROTECTED_TLV_SIZE + 1);

    ImageIdentityCollector refusing(OwnIdentity());
    const Bytes refused = MakeImage(WithArea(oversize));
    zassert_equal(refusing.Feed(0, std::span(refused).first(64), refused.size()), ImageIdentityResult::BAD_IDENTITY);
}

ZTEST(dfu_image_identity_collector, test_header_with_bad_magic_is_refused) {
    ImageParts parts = WithArea(ProtectedArea({ IdentityTlv(OwnIdentity()) }));
    parts.magic = 0x12345678;
    const Bytes image = MakeImage(parts);

    ImageIdentityCollector collector(OwnIdentity());
    zassert_equal(collector.Feed(0, image, image.size()), ImageIdentityResult::BAD_IDENTITY);
}

ZTEST(dfu_image_identity_collector, test_header_size_below_the_header_is_refused) {
    // The header names a size below its own.
    Bytes image = MakeIdentityImage(OwnIdentity());
    image[8] = ImageIdentityCollector::HEADER_SIZE - 1;

    ImageIdentityCollector collector(OwnIdentity());
    zassert_equal(collector.Feed(0, image, image.size()), ImageIdentityResult::BAD_IDENTITY);
}

ZTEST(dfu_image_identity_collector, test_area_beyond_the_declared_size_is_refused) {
    const Bytes image = MakeIdentityImage(OwnIdentity());

    // The declared size ends before the protected area does.
    ImageIdentityCollector collector(OwnIdentity());
    zassert_equal(collector.Feed(0, std::span(image).first(64), image.size() - 120), ImageIdentityResult::BAD_IDENTITY);
}

ZTEST(dfu_image_identity_collector, test_area_with_a_wrong_info_magic_is_refused) {
    Bytes area = ProtectedArea({ IdentityTlv(OwnIdentity()) });
    area[0] = 0x07;
    area[1] = 0x69;
    const Bytes image = MakeImage(WithArea(area));

    ImageIdentityCollector collector(OwnIdentity());
    zassert_equal(collector.Feed(0, image, image.size()), ImageIdentityResult::BAD_IDENTITY);
}

ZTEST(dfu_image_identity_collector, test_area_with_a_wrong_total_is_refused) {
    Bytes area = ProtectedArea({ IdentityTlv(OwnIdentity()) });
    area[2]++;
    const Bytes image = MakeImage(WithArea(area));

    ImageIdentityCollector collector(OwnIdentity());
    zassert_equal(collector.Feed(0, image, image.size()), ImageIdentityResult::BAD_IDENTITY);
}

ZTEST(dfu_image_identity_collector, test_area_too_small_for_its_info_header_is_refused) {
    ImageParts parts;
    parts.protected_area = { 0x08, 0x69, 0x03 };
    const Bytes image = MakeImage(parts);

    ImageIdentityCollector collector(OwnIdentity());
    zassert_equal(collector.Feed(0, image, image.size()), ImageIdentityResult::BAD_IDENTITY);
}

ZTEST(dfu_image_identity_collector, test_tlv_that_runs_past_the_area_is_refused) {
    Bytes identity_tlv = IdentityTlv(OwnIdentity());
    // Its length field names more than the area holds.
    identity_tlv[2] = static_cast<uint8_t>(identity_tlv[2] + 1);
    const Bytes image = MakeImage(WithArea(ProtectedArea({ identity_tlv })));

    ImageIdentityCollector collector(OwnIdentity());
    zassert_equal(collector.Feed(0, image, image.size()), ImageIdentityResult::BAD_IDENTITY);
}

ZTEST(dfu_image_identity_collector, test_truncated_tlv_header_at_the_end_of_the_area_is_refused) {
    Bytes area = ProtectedArea({ Tlv(0x00A1, Bytes(4, 1)) });
    // Two stray bytes where another TLV header should start.
    area.push_back(0xA2);
    area.push_back(0x00);
    area[2] = static_cast<uint8_t>(area.size());
    const Bytes image = MakeImage(WithArea(area));

    ImageIdentityCollector collector(OwnIdentity());
    zassert_equal(collector.Feed(0, image, image.size()), ImageIdentityResult::BAD_IDENTITY);
}

ZTEST(dfu_image_identity_collector, test_malformed_identity_value_is_refused) {
    const Bytes wrong_format = { 2, 0x01, 0xA4, 3, 'a', 'b', 'c' };
    const Bytes wrong_length = { 1, 0x01, 0xA4, 9, 'a', 'b', 'c' };
    const Bytes too_short = { 1, 0x01 };

    for(const Bytes& value : { wrong_format, wrong_length, too_short }) {
        const Bytes image = MakeImage(WithArea(ProtectedArea({ Tlv(ImageIdentity::TLV_TYPE, value) })));

        ImageIdentityCollector collector(OwnIdentity());
        zassert_equal(collector.Feed(0, image, image.size()), ImageIdentityResult::BAD_IDENTITY);
    }
}

ZTEST(dfu_image_identity_collector, test_two_identities_are_refused) {
    const Bytes image = MakeImage(WithArea(ProtectedArea({ IdentityTlv(OwnIdentity()), IdentityTlv(OwnIdentity()) })));

    ImageIdentityCollector collector(OwnIdentity());
    zassert_equal(collector.Feed(0, image, image.size()), ImageIdentityResult::BAD_IDENTITY);
}

ZTEST(dfu_image_identity_collector, test_chunk_that_skips_data_is_refused) {
    const Bytes image = MakeIdentityImage(OwnIdentity());
    ImageIdentityCollector collector(OwnIdentity());

    zassert_equal(collector.Feed(0, std::span(image).first(40), image.size()), ImageIdentityResult::NEED_MORE);
    zassert_equal(
        collector.Feed(60, std::span(image).subspan(60, 40), image.size()), ImageIdentityResult::BAD_IDENTITY
    );
}

ZTEST(dfu_image_identity_collector, test_data_beyond_the_declared_size_is_refused) {
    const Bytes image = MakeIdentityImage(OwnIdentity());
    ImageIdentityCollector collector(OwnIdentity());

    zassert_equal(collector.Feed(0, std::span(image).first(64), image.size()), ImageIdentityResult::NEED_MORE);
    zassert_equal(
        collector.Feed(64, std::span(image).subspan(64), image.size() - 1), ImageIdentityResult::BAD_IDENTITY
    );
}

ZTEST(dfu_image_identity_collector, test_a_chunk_sent_again_changes_nothing) {
    const Bytes image = MakeIdentityImage(OwnIdentity());
    ImageIdentityCollector collector(OwnIdentity());

    const size_t second = 100;
    zassert_equal(collector.Feed(0, std::span(image).first(second), image.size()), ImageIdentityResult::NEED_MORE);
    zassert_equal(
        collector.Feed(second, std::span(image).subspan(second, 50), image.size()), ImageIdentityResult::NEED_MORE
    );
    // The second chunk again (its response got lost), then the rest.
    zassert_equal(
        collector.Feed(second, std::span(image).subspan(second, 50), image.size()), ImageIdentityResult::NEED_MORE
    );
    zassert_equal(
        collector.Feed(second + 50, std::span(image).subspan(second + 50), image.size()), ImageIdentityResult::MATCH
    );
}

ZTEST(dfu_image_identity_collector, test_a_chunk_at_offset_zero_starts_a_new_image) {
    ImageIdentityCollector collector(OwnIdentity());

    const Bytes refused = MakeIdentityImage(Identity(OWN_PRODUCT + 1, OWN_BOARD));
    zassert_equal(collector.Feed(0, refused, refused.size()), ImageIdentityResult::WRONG_PRODUCT);
    zassert_equal(collector.GetResult(), ImageIdentityResult::WRONG_PRODUCT);

    const Bytes accepted = MakeIdentityImage(OwnIdentity());
    zassert_equal(collector.Feed(0, std::span(accepted).first(50), accepted.size()), ImageIdentityResult::NEED_MORE);
    zassert_equal(collector.GetResult(), ImageIdentityResult::NEED_MORE);
    zassert_equal(collector.Feed(50, std::span(accepted).subspan(50), accepted.size()), ImageIdentityResult::MATCH);

    // The decision of an image stays, whatever follows it.
    zassert_equal(collector.Feed(50, std::span(accepted).subspan(50), accepted.size()), ImageIdentityResult::MATCH);
}

ZTEST(dfu_image_identity_collector, test_reset_forgets_the_image) {
    ImageIdentityCollector collector(OwnIdentity());
    const Bytes image = MakeIdentityImage(OwnIdentity());

    zassert_equal(collector.Feed(0, std::span(image).first(80), image.size()), ImageIdentityResult::NEED_MORE);
    collector.Reset();
    zassert_equal(collector.GetResult(), ImageIdentityResult::NEED_MORE);

    // After a reset the next chunk is the start of an image again.
    zassert_equal(collector.Feed(0, image, image.size()), ImageIdentityResult::MATCH);
    collector.Reset();
    zassert_equal(collector.Feed(80, std::span(image).subspan(80), image.size()), ImageIdentityResult::BAD_IDENTITY);
}

ZTEST(dfu_image_identity_collector, test_empty_chunks_are_harmless) {
    ImageIdentityCollector collector(OwnIdentity());
    const Bytes image = MakeIdentityImage(OwnIdentity());

    zassert_equal(collector.Feed(0, {}, image.size()), ImageIdentityResult::NEED_MORE);
    zassert_equal(collector.Feed(0, std::span(image).first(40), image.size()), ImageIdentityResult::NEED_MORE);
    zassert_equal(collector.Feed(40, {}, image.size()), ImageIdentityResult::NEED_MORE);
    zassert_equal(collector.Feed(40, std::span(image).subspan(40), image.size()), ImageIdentityResult::MATCH);
}

ZTEST(dfu_image_identity_collector, test_images_with_no_payload_work) {
    ImageParts parts = WithArea(ProtectedArea({ IdentityTlv(OwnIdentity()) }));
    parts.payload_size = NO_PAYLOAD;
    const Bytes image = MakeImage(parts);

    for(size_t split = 1; split < image.size(); split++) {
        ImageIdentityCollector collector(OwnIdentity());
        zassert_equal(FeedSplit(collector, image, split), ImageIdentityResult::MATCH, "Split after %zu bytes", split);
    }
}
```
