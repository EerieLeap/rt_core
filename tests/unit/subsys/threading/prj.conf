## CMakeLists.txt
```
cmake_minimum_required(VERSION 3.20.0)

include(${CMAKE_CURRENT_SOURCE_DIR}/../../../rt_core_test.cmake)

find_package(Zephyr REQUIRED HINTS $ENV{ZEPHYR_BASE})
project(unit_subsys_threading)

file(GLOB_RECURSE TEST_SOURCES src/*.c src/*.cpp)

target_sources(app PRIVATE ${TEST_SOURCES})
```

## prj.conf
```kconfig
CONFIG_ZTEST=y

# Language and Compiler
CONFIG_CPP=y
CONFIG_PICOLIBC=y
CONFIG_STD_CPP23=y
CONFIG_REQUIRES_FULL_LIBCPP=y
CONFIG_CPP_EXCEPTIONS=y
CONFIG_CPP_RTTI=y

# Memory
CONFIG_HEAP_MEM_POOL_SIZE=100000

# C++ exception unwinding needs considerably more stack than the ztest defaults.
CONFIG_MAIN_STACK_SIZE=8192
CONFIG_ZTEST_STACK_SIZE=8192

# Logging And Debugging
CONFIG_LOG=y
CONFIG_TEST_RANDOM_GENERATOR=y
CONFIG_THREAD_NAME=y

# ThreadBase::InitializeStack() falls back to k_thread_stack_alloc().
CONFIG_THREAD_STACK_INFO=y
CONFIG_DYNAMIC_THREAD=y
CONFIG_DYNAMIC_THREAD_ALLOC=y

CONFIG_EERIE_LEAP_RT_CORE=y
CONFIG_EERIE_LEAP_THREADING=y
```

## src/service_base.cpp
```c
#include <stdexcept>

#include <zephyr/kernel.h>
#include <zephyr/ztest.h>

#include "subsys/threading/service_base.h"

using eerie_leap::subsys::threading::ServiceBase;
using eerie_leap::subsys::threading::ServiceState;

namespace {

class ThrowingService : public ServiceBase<> {
private:
    bool DoStart() override {
        start_calls++;
        if(throw_on_start)
            throw std::runtime_error("start failed");

        return true;
    }

    bool DoStop() override {
        stop_calls++;
        if(throw_on_stop)
            throw std::runtime_error("stop failed");

        return true;
    }

public:
    bool throw_on_start = false;
    bool throw_on_stop = false;
    int start_calls = 0;
    int stop_calls = 0;
};

// Pausable; DoPause() reports that it entered and waits to be released, so another thread's
// transition can be attempted while it runs.
class BlockingPauseService : public ServiceBase<> {
private:
    bool DoStart() override {
        start_calls++;
        return true;
    }

    bool DoStop() override {
        stop_calls++;
        return true;
    }

    bool DoPause() override {
        pause_calls++;
        k_sem_give(&pause_entered);
        k_sem_take(&pause_release, K_FOREVER);
        return true;
    }

    bool DoResume() override {
        resume_calls++;
        return true;
    }

public:
    k_sem pause_entered{};
    k_sem pause_release{};
    int start_calls = 0;
    int stop_calls = 0;
    int pause_calls = 0;
    int resume_calls = 0;

    BlockingPauseService() {
        k_sem_init(&pause_entered, 0, 1);
        k_sem_init(&pause_release, 0, 1);
    }

    [[nodiscard]] bool IsPausable() const noexcept override {
        return true;
    }
};

constexpr int TRANSITION_THREAD_PRIORITY = 5;

K_THREAD_STACK_DEFINE(pausing_stack, 4096);
K_THREAD_STACK_DEFINE(stopping_stack, 4096);

struct Transition {
    BlockingPauseService* service;
    bool result;
};

void PauseFromAnotherThread(void* context, void*, void*) {
    auto* transition = static_cast<Transition*>(context);
    transition->result = transition->service->Pause();
}

void StopFromAnotherThread(void* context, void*, void*) {
    auto* transition = static_cast<Transition*>(context);
    transition->result = transition->service->Stop();
}

} // namespace

ZTEST_SUITE(service_base, NULL, NULL, NULL, NULL, NULL);

// A calibration Pause() on one thread and a configuration restart's Stop() on another: the Stop()
// waits for the pause to complete instead of tearing the service down under it, and wins last.
ZTEST(service_base, test_a_transition_waits_for_one_in_progress_on_another_thread) {
    BlockingPauseService service;
    zassert_true(service.Start());

    Transition pause{ .service = &service, .result = false };
    k_thread pausing;
    k_thread_create(
        &pausing, pausing_stack, K_THREAD_STACK_SIZEOF(pausing_stack), PauseFromAnotherThread, &pause, nullptr, nullptr,
        TRANSITION_THREAD_PRIORITY, 0, K_NO_WAIT
    );
    zassert_ok(k_sem_take(&service.pause_entered, K_SECONDS(1)));

    Transition stop{ .service = &service, .result = false };
    k_thread stopping;
    k_thread_create(
        &stopping, stopping_stack, K_THREAD_STACK_SIZEOF(stopping_stack), StopFromAnotherThread, &stop, nullptr,
        nullptr, TRANSITION_THREAD_PRIORITY, 0, K_NO_WAIT
    );
    k_msleep(50);

    // Taken before the release and asserted after the joins, so a failure leaves no thread behind.
    const int stop_calls_during_pause = service.stop_calls;
    const ServiceState state_during_pause = service.GetState();

    k_sem_give(&service.pause_release);
    zassert_ok(k_thread_join(&pausing, K_SECONDS(1)));
    zassert_ok(k_thread_join(&stopping, K_SECONDS(1)));

    zassert_equal(stop_calls_during_pause, 0, "Stop() ran while the pause was in progress");
    zassert_equal(state_during_pause, ServiceState::RUNNING);

    zassert_true(pause.result);
    zassert_true(stop.result);
    zassert_equal(service.pause_calls, 1);
    zassert_equal(service.stop_calls, 1);
    zassert_equal(service.GetState(), ServiceState::STOPPED, "The later transition is the one that holds");

    // A resume of what the restart has taken back is refused rather than acted on.
    zassert_false(service.Resume());
    zassert_equal(service.resume_calls, 0);
}

ZTEST(service_base, test_Start_restores_state_when_DoStart_throws) {
    ThrowingService service;
    service.throw_on_start = true;

    bool is_thrown = false;
    try {
        service.Start();
    } catch(const std::runtime_error&) {
        is_thrown = true;
    }

    zassert_true(is_thrown);
    zassert_equal(service.GetState(), ServiceState::STOPPED);

    service.throw_on_start = false;
    zassert_true(service.Start(), "A later Start() is not refused");
    zassert_equal(service.GetState(), ServiceState::RUNNING);
    zassert_equal(service.start_calls, 2);
}

ZTEST(service_base, test_Stop_restores_state_when_DoStop_throws) {
    ThrowingService service;
    zassert_true(service.Start());

    service.throw_on_stop = true;

    bool is_thrown = false;
    try {
        service.Stop();
    } catch(const std::runtime_error&) {
        is_thrown = true;
    }

    zassert_true(is_thrown);
    zassert_equal(service.GetState(), ServiceState::RUNNING);

    service.throw_on_stop = false;
    zassert_true(service.Stop(), "A later Stop() is not refused");
    zassert_equal(service.GetState(), ServiceState::STOPPED);
    zassert_equal(service.stop_calls, 2);
}
```

## src/thread_base.cpp
```c
#include <cstddef>
#include <cstdint>
#include <memory_resource>
#include <string>

#include <zephyr/ztest.h>

#include "subsys/threading/thread_base.h"

using eerie_leap::subsys::threading::ThreadBase;

namespace {

constexpr int STACK_SIZE = 1024;

// Larger than CONFIG_HEAP_MEM_POOL_SIZE, so the kernel allocator has to refuse it.
constexpr int OVERSIZED_STACK_SIZE = 4 * 1024 * 1024;

// ThreadBase keeps everything the constructor derives in protected state.
class ProbeThreadBase : public ThreadBase {
public:
    using ThreadBase::ThreadBase;

    [[nodiscard]] int Priority() const {
        return k_priority_;
    }
    [[nodiscard]] int StackSize() const {
        return k_stack_size_;
    }
    [[nodiscard]] const std::string& Name() const {
        return name_;
    }
};

class TrackingMemoryResource : public std::pmr::memory_resource {
public:
    int allocations = 0;
    int deallocations = 0;
    std::size_t allocated_bytes = 0;
    std::size_t allocated_alignment = 0;
    std::size_t deallocated_bytes = 0;
    std::size_t deallocated_alignment = 0;
    void* allocated_pointer = nullptr;
    void* deallocated_pointer = nullptr;

private:
    std::pmr::memory_resource* upstream_ = std::pmr::new_delete_resource();

    void* do_allocate(std::size_t bytes, std::size_t alignment) override {
        ++allocations;
        allocated_bytes = bytes;
        allocated_alignment = alignment;
        allocated_pointer = upstream_->allocate(bytes, alignment);

        return allocated_pointer;
    }

    void do_deallocate(void* pointer, std::size_t bytes, std::size_t alignment) override {
        ++deallocations;
        deallocated_bytes = bytes;
        deallocated_alignment = alignment;
        deallocated_pointer = pointer;
        upstream_->deallocate(pointer, bytes, alignment);
    }

    [[nodiscard]] bool do_is_equal(const std::pmr::memory_resource& other) const noexcept override {
        return this == &other;
    }
};

} // namespace

ZTEST_SUITE(thread_base, NULL, NULL, NULL, NULL, NULL);

ZTEST(thread_base, test_constructor_keeps_name_and_stack_size) {
    const ProbeThreadBase thread("worker", STACK_SIZE, 5);

    zassert_equal(thread.Name(), std::string("worker"));
    zassert_equal(thread.StackSize(), STACK_SIZE);
}

ZTEST(thread_base, test_constructor_maps_preemptive_priority_to_positive) {
    const ProbeThreadBase from_positive("preemptive_positive", STACK_SIZE, 7, false);
    const ProbeThreadBase from_negative("preemptive_negative", STACK_SIZE, -7, false);

    zassert_equal(from_positive.Priority(), 7);
    zassert_equal(from_negative.Priority(), 7);
}

ZTEST(thread_base, test_constructor_maps_cooperative_priority_to_negative) {
    const ProbeThreadBase from_positive("cooperative_positive", STACK_SIZE, 7, true);
    const ProbeThreadBase from_negative("cooperative_negative", STACK_SIZE, -7, true);

    zassert_equal(from_positive.Priority(), -7);
    zassert_equal(from_negative.Priority(), -7);
}

ZTEST(thread_base, test_constructor_keeps_priority_zero_cooperative) {
    const ProbeThreadBase thread("cooperative_zero", STACK_SIZE, 0, true);

    zassert_true(thread.Priority() < 0, "priority %d is preemptive", thread.Priority());
}

ZTEST(thread_base, test_constructor_defaults_to_preemptive) {
    const ProbeThreadBase thread("defaulted", STACK_SIZE, 3);

    zassert_true(thread.Priority() > 0);
}

ZTEST(thread_base, test_GetStack_is_null_before_initialization) {
    const ProbeThreadBase thread("unstarted", STACK_SIZE, 5);

    zassert_is_null(thread.GetStack());
}

ZTEST(thread_base, test_InitializeStack_uses_the_kernel_allocator_by_default) {
    ProbeThreadBase thread("kernel_stack", STACK_SIZE, 5);

    zassert_true(thread.InitializeStack());
    zassert_not_null(thread.GetStack());
}

ZTEST(thread_base, test_InitializeStack_reports_an_allocation_failure) {
    ProbeThreadBase thread("oversized_stack", OVERSIZED_STACK_SIZE, 5);

    zassert_false(thread.InitializeStack());
    zassert_is_null(thread.GetStack());
}

ZTEST(thread_base, test_InitializeStack_uses_the_supplied_memory_resource) {
    TrackingMemoryResource resource;

    {
        ProbeThreadBase thread("pmr_stack", STACK_SIZE, 5, false, &resource);
        thread.InitializeStack();

        zassert_equal(resource.allocations, 1);
        zassert_equal(resource.allocated_bytes, K_KERNEL_STACK_LEN(STACK_SIZE));
        zassert_equal(resource.allocated_alignment, static_cast<std::size_t>(Z_KERNEL_STACK_OBJ_ALIGN));
        zassert_equal(thread.GetStack(), resource.allocated_pointer);
        zassert_equal(resource.deallocations, 0);
    }

    zassert_equal(resource.deallocations, 1);
    zassert_equal(resource.deallocated_pointer, resource.allocated_pointer);
    zassert_equal(resource.deallocated_bytes, K_KERNEL_STACK_LEN(STACK_SIZE));
    zassert_equal(resource.deallocated_alignment, static_cast<std::size_t>(Z_KERNEL_STACK_OBJ_ALIGN));
}

ZTEST(thread_base, test_InitializeStack_honours_the_stack_alignment) {
    ProbeThreadBase thread("aligned_stack", STACK_SIZE, 5);

    thread.InitializeStack();

    // NOLINTNEXTLINE(cppcoreguidelines-pro-type-reinterpret-cast): address arithmetic for a stack alignment check
    zassert_equal(reinterpret_cast<uintptr_t>(thread.GetStack()) % Z_KERNEL_STACK_OBJ_ALIGN, 0);
}

ZTEST(thread_base, test_InitializeStack_keeps_the_stack_it_already_allocated) {
    TrackingMemoryResource resource;
    ProbeThreadBase thread("reinitialized_stack", STACK_SIZE, 5, false, &resource);

    thread.InitializeStack();
    const k_thread_stack_t* stack = thread.GetStack();

    thread.InitializeStack();

    zassert_equal(resource.allocations, 1);
    zassert_equal(thread.GetStack(), stack);
}

ZTEST(thread_base, test_destructor_does_not_free_an_unallocated_stack) {
    TrackingMemoryResource resource;

    {
        const ProbeThreadBase thread("never_initialized", STACK_SIZE, 5, false, &resource);
    }

    zassert_equal(resource.allocations, 0);
    zassert_equal(resource.deallocations, 0);
}

ZTEST(thread_base, test_stacks_of_separate_instances_do_not_overlap) {
    ProbeThreadBase first("first_stack", STACK_SIZE, 5);
    ProbeThreadBase second("second_stack", STACK_SIZE, 5);

    first.InitializeStack();
    second.InitializeStack();

    zassert_not_null(first.GetStack());
    zassert_not_null(second.GetStack());
    zassert_true(first.GetStack() != second.GetStack());
}
```

## src/work_queue_task.cpp
```c
#include <memory>

#include <zephyr/ztest.h>

#include "subsys/threading/work_queue_task.h"

using eerie_leap::subsys::threading::WorkQueueTask;
using eerie_leap::subsys::threading::WorkQueueTaskResult;

namespace {

struct Payload {
    int value = 0;
    int* destructions = nullptr;

    Payload() = default;
    Payload(const Payload&) = delete;
    Payload& operator=(const Payload&) = delete;
    Payload(Payload&&) = delete;
    Payload& operator=(Payload&&) = delete;

    ~Payload() {
        if(destructions != nullptr)
            ++(*destructions);
    }
};

// These cases never submit anything, so the kernel objects only have to be valid storage.
k_work_q idle_queue{};
k_work_sync idle_sync{};

void NoopWorkHandler(k_work*) {}

WorkQueueTask<Payload> MakeTask(const WorkQueueTask<Payload>::Handler& handler) {
    return { &idle_queue, &idle_sync, NoopWorkHandler, handler };
}

} // namespace

ZTEST_SUITE(work_queue_task, NULL, NULL, NULL, NULL, NULL);

ZTEST(work_queue_task, test_WorkQueueTaskResult_defaults_to_no_reschedule) {
    WorkQueueTaskResult result;
    const k_timeout_t no_wait = K_NO_WAIT;

    zassert_false(result.reschedule);
    zassert_equal(result.delay.ticks, no_wait.ticks);
}

ZTEST(work_queue_task, test_GetUserdata_is_null_until_user_data_is_set) {
    const auto task = MakeTask([](Payload*) {
        return WorkQueueTaskResult{};
    });

    zassert_is_null(task.GetUserdata());
}

ZTEST(work_queue_task, test_Execute_forwards_owned_user_data_to_the_handler) {
    Payload* observed = nullptr;
    auto task = MakeTask([&observed](Payload* payload) {
        observed = payload;
        return WorkQueueTaskResult{};
    });

    auto payload = std::make_unique<Payload>();
    payload->value = 42;
    const Payload* expected = payload.get();
    task.SetUserData(std::move(payload));

    task.Execute();

    zassert_equal(observed, expected);
    zassert_equal(observed->value, 42);
    zassert_equal(task.GetUserdata(), expected);
}

ZTEST(work_queue_task, test_Execute_forwards_borrowed_user_data_to_the_handler) {
    Payload payload;
    payload.value = 7;

    Payload* observed = nullptr;
    auto task = MakeTask([&observed](Payload* argument) {
        observed = argument;
        return WorkQueueTaskResult{};
    });

    task.SetUserData(&payload);
    task.Execute();

    zassert_equal(observed, &payload);
    zassert_equal(task.GetUserdata(), &payload);
}

ZTEST(work_queue_task, test_Execute_returns_the_handler_result) {
    auto task = MakeTask([](Payload*) {
        return WorkQueueTaskResult{ .reschedule = true, .delay = K_MSEC(25) };
    });

    task.SetUserData(std::make_unique<Payload>());

    const auto result = task.Execute();
    const k_timeout_t expected_delay = K_MSEC(25);

    zassert_true(result.reschedule);
    zassert_equal(result.delay.ticks, expected_delay.ticks);
}

ZTEST(work_queue_task, test_Execute_can_be_repeated) {
    int calls = 0;
    auto task = MakeTask([&calls](Payload*) {
        ++calls;
        return WorkQueueTaskResult{};
    });

    task.SetUserData(std::make_unique<Payload>());

    task.Execute();
    task.Execute();
    task.Execute();

    zassert_equal(calls, 3);
}

ZTEST(work_queue_task, test_SetUserData_releases_the_previously_owned_payload) {
    int destructions = 0;
    auto task = MakeTask([](Payload*) {
        return WorkQueueTaskResult{};
    });

    auto first = std::make_unique<Payload>();
    first->destructions = &destructions;
    task.SetUserData(std::move(first));

    auto second = std::make_unique<Payload>();
    const Payload* expected = second.get();
    task.SetUserData(std::move(second));

    zassert_equal(destructions, 1);
    zassert_equal(task.GetUserdata(), expected);
}

ZTEST(work_queue_task, test_owned_user_data_is_released_with_the_task) {
    int destructions = 0;

    {
        auto task = MakeTask([](Payload*) {
            return WorkQueueTaskResult{};
        });

        auto payload = std::make_unique<Payload>();
        payload->destructions = &destructions;
        task.SetUserData(std::move(payload));

        zassert_equal(destructions, 0);
    }

    zassert_equal(destructions, 1);
}

ZTEST(work_queue_task, test_borrowed_user_data_outlives_the_task) {
    int destructions = 0;
    Payload payload;
    payload.destructions = &destructions;

    {
        auto task = MakeTask([](Payload*) {
            return WorkQueueTaskResult{};
        });
        task.SetUserData(&payload);
    }

    zassert_equal(destructions, 0);
}

ZTEST(work_queue_task, test_IsScheduled_is_false_before_the_task_is_submitted) {
    auto task = MakeTask([](Payload*) {
        return WorkQueueTaskResult{};
    });
    task.SetUserData(std::make_unique<Payload>());

    zassert_false(task.IsScheduled());
}

ZTEST(work_queue_task, test_Cancel_reports_nothing_to_cancel_for_an_idle_task) {
    auto task = MakeTask([](Payload*) {
        return WorkQueueTaskResult{};
    });
    task.SetUserData(std::make_unique<Payload>());

    zassert_false(task.Cancel());
}
```
