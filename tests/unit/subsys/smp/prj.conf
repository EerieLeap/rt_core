## CMakeLists.txt
```
cmake_minimum_required(VERSION 3.20.0)

include(${CMAKE_CURRENT_SOURCE_DIR}/../../../rt_core_test.cmake)

find_package(Zephyr REQUIRED HINTS $ENV{ZEPHYR_BASE})
project(unit_subsys_smp)

file(GLOB_RECURSE TEST_SOURCES src/*.c src/*.cpp)

target_sources(app PRIVATE ${TEST_SOURCES})
```

## prj.conf
```kconfig
CONFIG_ZTEST=y

# Language and Compiler
CONFIG_CPP=y
CONFIG_PICOLIBC=y
CONFIG_STD_CPP23=y
CONFIG_REQUIRES_FULL_LIBCPP=y
CONFIG_CPP_EXCEPTIONS=y
CONFIG_CPP_RTTI=y

# Memory
CONFIG_HEAP_MEM_POOL_SIZE=100000

# C++ exception unwinding needs considerably more stack than the ztest defaults.
CONFIG_MAIN_STACK_SIZE=8192
CONFIG_ZTEST_STACK_SIZE=8192

# Logging And Debugging
CONFIG_LOG=y
CONFIG_TEST_RANDOM_GENERATOR=y
CONFIG_THREAD_NAME=y

# ThreadBase::InitializeStack() falls back to k_thread_stack_alloc().
CONFIG_THREAD_STACK_INFO=y
CONFIG_DYNAMIC_THREAD=y
CONFIG_DYNAMIC_THREAD_ALLOC=y

# CANBus. Only the framing logic is exercised, but the transport links against Canbus.
CONFIG_CAN=y
CONFIG_CAN_FD_MODE=y
CONFIG_CAN_LOOPBACK=y

# The 512 byte default overflows on the 64-bit QEMU targets.
CONFIG_CAN_LOOPBACK_TX_THREAD_STACK_SIZE=2048

CONFIG_EERIE_LEAP_RT_CORE=y
CONFIG_EERIE_LEAP_THREADING=y
CONFIG_EERIE_LEAP_CANBUS=y
CONFIG_EERIE_LEAP_SMP_CAN=y
```

## src/smp_can_frame_format.cpp
```c
#include <zephyr/ztest.h>

#include "subsys/smp/can/smp_can_frame_format.h"

using eerie_leap::subsys::smp::can::SmpCanFrameFormat;

ZTEST_SUITE(smp_can_frame_format, NULL, NULL, NULL, NULL, NULL);

ZTEST(smp_can_frame_format, test_classic_frames_are_8_bytes) {
    constexpr SmpCanFrameFormat CLASSIC;

    zassert_false(CLASSIC.IsCanFd());
    zassert_equal(CLASSIC.GetFrameSize(), 8);
    zassert_equal(CLASSIC.GetDataSize(), 7);
    zassert_equal(CLASSIC.GetPaddedSize(5), 5);
    zassert_equal(CLASSIC.GetFrameCount(15), 3);
}

ZTEST(smp_can_frame_format, test_can_fd_frames_are_64_bytes) {
    constexpr SmpCanFrameFormat CAN_FD(true);

    zassert_true(CAN_FD.IsCanFd());
    zassert_equal(CAN_FD.GetFrameSize(), 64);
    zassert_equal(CAN_FD.GetDataSize(), 63);
    zassert_equal(CAN_FD.GetFrameCount(126), 2);
    zassert_equal(CAN_FD.GetFrameCount(127), 3);
}

ZTEST(smp_can_frame_format, test_can_fd_lengths_round_up_to_a_valid_dlc) {
    constexpr SmpCanFrameFormat CAN_FD(true);

    zassert_equal(CAN_FD.GetPaddedSize(8), 8);
    zassert_equal(CAN_FD.GetPaddedSize(9), 12);
    zassert_equal(CAN_FD.GetPaddedSize(13), 16);
    zassert_equal(CAN_FD.GetPaddedSize(24), 24);
    zassert_equal(CAN_FD.GetPaddedSize(25), 32);
    zassert_equal(CAN_FD.GetPaddedSize(33), 48);
    zassert_equal(CAN_FD.GetPaddedSize(49), 64);
    zassert_equal(CAN_FD.GetPaddedSize(64), 64);
}

ZTEST(smp_can_frame_format, test_frame_time_follows_the_bitrates) {
    constexpr SmpCanFrameFormat CLASSIC;
    constexpr SmpCanFrameFormat CAN_FD(true);

    zassert_equal(CLASSIC.GetFrameTimeNs(500000), 320000);
    zassert_equal(CLASSIC.GetFrameTimeNs(500000, 2000000), 320000, "Classic frames ignore the data bitrate");
    zassert_equal(CAN_FD.GetFrameTimeNs(500000, 2000000), 470000);
    zassert_equal(CAN_FD.GetFrameTimeNs(500000), 1520000, "Without a data bitrate the data phase runs at 500 kbit/s");
    zassert_equal(CAN_FD.GetFrameTimeNs(0, 2000000), 0);
}
```

## src/smp_can_framer.cpp
```c
#include <algorithm>

#include <zephyr/ztest.h>

#include "smp_test_support.h"

using namespace smp_test;

ZTEST_SUITE(smp_can_framer, NULL, NULL, NULL, NULL, NULL);

ZTEST(smp_can_framer, test_first_frame_is_marked_start) {
    auto packet = MakePacket(20);
    auto frames = MakeFrames(packet);

    zassert_equal(frames.size(), SmpCanFramer::GetFrameCount(packet.size()));
    zassert_equal(frames.size(), 4);
    zassert_equal(frames[0][0], SmpCanFrameFormat::START_FLAG);
    zassert_equal(frames[1][0], 1);
    zassert_equal(frames[3][0], 3);
}

ZTEST(smp_can_framer, test_only_the_last_frame_is_short) {
    auto packet = MakePacket(20);     // 28 bytes: 7 + 7 + 7 + 7
    auto odd_packet = MakePacket(22); // 30 bytes: 7 + 7 + 7 + 7 + 2

    for(const auto& frame : MakeFrames(packet))
        zassert_equal(frame.size(), SmpCanFrameFormat::CLASSIC_FRAME_SIZE);

    auto odd_frames = MakeFrames(odd_packet);
    zassert_equal(odd_frames.size(), 5);
    zassert_equal(odd_frames.back().size(), 3);
}

ZTEST(smp_can_framer, test_frames_carry_the_packet_in_order) {
    auto packet = MakePacket(40);
    std::vector<uint8_t> joined;

    for(const auto& frame : MakeFrames(packet))
        joined.insert(joined.end(), frame.begin() + 1, frame.end());

    zassert_true(joined == packet);
}

ZTEST(smp_can_framer, test_sequence_wraps_after_127) {
    auto packet = MakePacket(1000);
    auto frames = MakeFrames(packet);

    zassert_true(frames.size() > 129);
    zassert_equal(frames[127][0], 127);
    zassert_equal(frames[128][0], 0, "Frame 128 wraps to sequence 0 without the start flag");
    zassert_equal(frames[129][0], 1);
}

ZTEST(smp_can_framer, test_empty_packet_has_no_frames) {
    SmpCanFramer framer(std::span<const uint8_t>{});
    std::array<uint8_t, SmpCanFrameFormat::MAX_FRAME_SIZE> frame{};

    zassert_true(framer.IsDone());
    zassert_equal(framer.Encode(frame), 0);
    zassert_equal(SmpCanFramer::GetFrameCount(0), 0);
}

ZTEST(smp_can_framer, test_encode_does_not_advance) {
    auto packet = MakePacket(10);
    SmpCanFramer framer(packet);
    std::array<uint8_t, SmpCanFrameFormat::MAX_FRAME_SIZE> first{};
    std::array<uint8_t, SmpCanFrameFormat::MAX_FRAME_SIZE> again{};

    framer.Encode(first);
    framer.Encode(again);

    zassert_true(first == again, "A frame that failed to send must be encoded again unchanged");
}

ZTEST(smp_can_framer, test_can_fd_frames_carry_63_bytes) {
    constexpr SmpCanFrameFormat CAN_FD(true);
    auto packet = MakePacket(118); // 126 bytes: 63 + 63
    auto frames = MakeFrames(packet, CAN_FD);

    zassert_equal(frames.size(), 2);
    zassert_equal(frames[0].size(), SmpCanFrameFormat::CAN_FD_FRAME_SIZE);
    zassert_equal(frames[1].size(), SmpCanFrameFormat::CAN_FD_FRAME_SIZE);
    zassert_equal(frames[1][0], 1);
    zassert_equal(SmpCanFramer::GetFrameCount(1008, CAN_FD), 16);
}

ZTEST(smp_can_framer, test_short_can_fd_frame_is_padded_to_a_valid_length) {
    constexpr SmpCanFrameFormat CAN_FD(true);
    auto packet = MakePacket(68); // 76 bytes: 63 + 13, sent as a 16-byte frame
    auto frames = MakeFrames(packet, CAN_FD);

    zassert_equal(frames.size(), 2);
    zassert_equal(frames[1].size(), 16);
    zassert_true(std::equal(packet.begin() + 63, packet.end(), frames[1].begin() + 1));
    zassert_true(
        std::all_of(
            frames[1].begin() + 14, frames[1].end(),
            [](uint8_t byte) {
                return byte == 0;
            }
        ),
        "Padding is zeroed"
    );
}

ZTEST(smp_can_framer, test_can_fd_frames_up_to_8_bytes_are_not_padded) {
    constexpr SmpCanFrameFormat CAN_FD(true);
    auto frames = MakeFrames(MakePacket(60), CAN_FD); // 68 bytes: 63 + 5

    zassert_equal(frames.size(), 2);
    zassert_equal(frames[1].size(), 6);

    auto header_only = MakeFrames(MakePacket(0), CAN_FD);
    zassert_equal(header_only[0].size(), 12, "9 bytes go out as a 12-byte frame");
}
```

## src/smp_can_id_layout.cpp
```c
#include <stdexcept>

#include <zephyr/ztest.h>

#include "subsys/smp/can/smp_can_id_layout.h"

using eerie_leap::subsys::smp::can::SmpCanIdLayout;

ZTEST_SUITE(smp_can_id_layout, NULL, NULL, NULL, NULL, NULL);

ZTEST(smp_can_id_layout, test_id_carries_target_and_source) {
    constexpr SmpCanIdLayout LAYOUT;

    constexpr uint32_t ID = LAYOUT.MakeId(0x07, 0x03);

    zassert_equal(ID, 0x1FF00703);
    zassert_equal(SmpCanIdLayout::GetTarget(ID), 0x07);
    zassert_equal(SmpCanIdLayout::GetSource(ID), 0x03);
    zassert_true(LAYOUT.Contains(ID));
    zassert_false(LAYOUT.Contains(0x1FE00703));
}

ZTEST(smp_can_id_layout, test_target_filter_accepts_any_source) {
    constexpr SmpCanIdLayout LAYOUT(0x1E000000);
    constexpr uint32_t FILTER_ID = LAYOUT.GetTargetFilterId(0x07);

    const auto matches = [&](uint32_t id) {
        return (id & SmpCanIdLayout::TARGET_FILTER_MASK) == FILTER_ID;
    };

    zassert_true(matches(LAYOUT.MakeId(0x07, 0x01)));
    zassert_true(matches(LAYOUT.MakeId(0x07, 0xFE)));
    zassert_false(matches(LAYOUT.MakeId(0x08, 0x01)));
    zassert_false(matches(SmpCanIdLayout().MakeId(0x07, 0x01)));
}

ZTEST(smp_can_id_layout, test_base_must_be_29_bit_with_clear_address_bits) {
    zassert_true(SmpCanIdLayout::IsValidBase(SmpCanIdLayout::DEFAULT_BASE));
    zassert_true(SmpCanIdLayout::IsValidBase(0x00010000));
    zassert_false(SmpCanIdLayout::IsValidBase(0x1FF00100));
    zassert_false(SmpCanIdLayout::IsValidBase(0x20000000));

    bool threw = false;
    try {
        SmpCanIdLayout layout(0x1FF00001);
        (void)layout;
    } catch(const std::invalid_argument&) {
        threw = true;
    }

    zassert_true(threw);
}

ZTEST(smp_can_id_layout, test_unassigned_and_broadcast_are_not_addresses) {
    zassert_false(SmpCanIdLayout::IsValidAddress(0x00));
    zassert_false(SmpCanIdLayout::IsValidAddress(0xFF));
    zassert_true(SmpCanIdLayout::IsValidAddress(0x01));
    zassert_true(SmpCanIdLayout::IsValidAddress(0xFE));
}
```

## src/smp_can_pacer.cpp
```c
#include <stdexcept>

#include <zephyr/ztest.h>

#include "subsys/smp/can/smp_can_frame_format.h"
#include "subsys/smp/can/smp_can_pacer.h"

using eerie_leap::subsys::smp::can::SmpCanFrameFormat;
using eerie_leap::subsys::smp::can::SmpCanPacer;

ZTEST_SUITE(smp_can_pacer, NULL, NULL, NULL, NULL, NULL);

namespace {

constexpr uint32_t BITRATE = 500000;
constexpr uint8_t SHARE = 25;
constexpr uint32_t BURST = 8;

// 160 bit times at 500 kbit/s.
constexpr uint32_t FRAME_TIME_NS = SmpCanFrameFormat().GetFrameTimeNs(BITRATE);

// 25 % of the bus time / 320 us per frame.
constexpr uint32_t FRAMES_PER_SECOND = 781;

SmpCanPacer MakePacer() {
    return { FRAME_TIME_NS, SHARE, BURST };
}

uint32_t SendAvailable(SmpCanPacer& pacer) {
    uint32_t sent = 0;
    while(pacer.CanSend()) {
        pacer.OnSent();
        sent++;
    }

    return sent;
}

} // namespace

ZTEST(smp_can_pacer, test_rate_is_the_share_of_the_bus_time) {
    zassert_equal(FRAME_TIME_NS, 320000);
    zassert_equal(MakePacer().GetFramesPerSecond(), FRAMES_PER_SECOND);
}

ZTEST(smp_can_pacer, test_can_fd_rate_follows_both_bitrates) {
    // 60 bit times at 500 kbit/s + 700 at 2 Mbit/s = 470 us.
    SmpCanPacer pacer(SmpCanFrameFormat(true).GetFrameTimeNs(BITRATE, 2000000), SHARE, BURST);

    zassert_equal(pacer.GetFramesPerSecond(), 531);
}

ZTEST(smp_can_pacer, test_burst_is_available_after_reset) {
    SmpCanPacer pacer = MakePacer();
    pacer.Reset(0);

    zassert_equal(SendAvailable(pacer), BURST);
    zassert_true(pacer.GetWaitUs() > 0);
}

ZTEST(smp_can_pacer, test_wait_matches_one_frame_time) {
    SmpCanPacer pacer = MakePacer();
    pacer.Reset(0);
    SendAvailable(pacer);

    // A 320 us frame at a 25 % share.
    zassert_equal(pacer.GetWaitUs(), 1280);

    pacer.Update(1279);
    zassert_false(pacer.CanSend());

    pacer.Update(1280);
    zassert_true(pacer.CanSend());
}

ZTEST(smp_can_pacer, test_wait_for_several_frames) {
    SmpCanPacer pacer = MakePacer();
    pacer.Reset(0);
    SendAvailable(pacer);

    zassert_equal(pacer.GetWaitUs(4), 4LL * 1280);
    zassert_equal(
        pacer.GetWaitUs(100), static_cast<int64_t>(BURST) * 1280, "Never waits for more than the bucket holds"
    );

    pacer.Update(4LL * 1280);
    zassert_equal(pacer.GetWaitUs(4), 0);
    zassert_equal(SendAvailable(pacer), 4);
}

ZTEST(smp_can_pacer, test_long_run_rate_stays_within_the_share) {
    SmpCanPacer pacer = MakePacer();
    pacer.Reset(0);

    uint32_t sent = 0;
    for(int64_t now_us = 0; now_us <= 1'000'000; now_us += 100) {
        pacer.Update(now_us);
        sent += SendAvailable(pacer);
    }

    zassert_true(sent <= FRAMES_PER_SECOND + BURST + 1, "Sent %u frames in 1 s", sent);
    zassert_true(sent >= FRAMES_PER_SECOND, "Sent %u frames in 1 s", sent);
}

ZTEST(smp_can_pacer, test_coarse_ticks_cannot_exceed_the_burst) {
    SmpCanPacer pacer = MakePacer();
    pacer.Reset(0);
    SendAvailable(pacer);

    pacer.Update(10'000'000);

    zassert_equal(SendAvailable(pacer), BURST, "Idle time only refills the bucket");
}

ZTEST(smp_can_pacer, test_time_going_backwards_adds_no_credit) {
    SmpCanPacer pacer = MakePacer();
    pacer.Reset(5000);
    SendAvailable(pacer);

    pacer.Update(1000);

    zassert_false(pacer.CanSend());
}

ZTEST(smp_can_pacer, test_default_pacer_never_sends) {
    SmpCanPacer pacer;
    pacer.Reset(0);

    zassert_false(pacer.CanSend());
}

ZTEST(smp_can_pacer, test_invalid_parameters_are_rejected) {
    const auto rejects = [](uint32_t frame_time_ns, uint8_t share, uint32_t burst) {
        try {
            SmpCanPacer pacer(frame_time_ns, share, burst);
            (void)pacer;
        } catch(const std::invalid_argument&) {
            return true;
        }

        return false;
    };

    zassert_true(rejects(0, SHARE, BURST));
    zassert_true(rejects(FRAME_TIME_NS, 0, BURST));
    zassert_true(rejects(FRAME_TIME_NS, 101, BURST));
    zassert_true(rejects(FRAME_TIME_NS, SHARE, 0));
    zassert_false(rejects(FRAME_TIME_NS, 100, 1));
}
```

## src/smp_can_reassembler.cpp
```c
#include <algorithm>
#include <array>
#include <vector>

#include <zephyr/ztest.h>

#include "subsys/smp/can/smp_can_reassembler.h"

#include "smp_test_support.h"

using namespace smp_test;
using eerie_leap::subsys::smp::can::SmpCanReassembler;

using Result = SmpCanReassembler::Result;

ZTEST_SUITE(smp_can_reassembler, NULL, NULL, NULL, NULL, NULL);

namespace {

constexpr int64_t TIMEOUT_MS = SmpCanReassembler::DEFAULT_TIMEOUT_MS;

struct Receiver {
    std::array<uint8_t, 1024> buffer{};
    SmpCanReassembler reassembler;

    explicit Receiver(SmpCanFrameFormat format = {}) {
        reassembler.Attach(buffer, format);
    }

    Result Feed(const std::vector<Frame>& frames, int64_t now_ms = 0) {
        Result result = Result::IGNORED;
        for(const auto& frame : frames)
            result = reassembler.Accept(frame, now_ms);

        return result;
    }

    bool Holds(const std::vector<uint8_t>& packet) const {
        return reassembler.GetLength() == packet.size() && std::equal(packet.begin(), packet.end(), buffer.begin());
    }
};

} // namespace

ZTEST(smp_can_reassembler, test_single_frame_packet_completes) {
    Receiver receiver;
    auto packet = MakePacket(0);

    zassert_equal(receiver.Feed(MakeFrames(packet)), Result::COMPLETE);
    zassert_true(receiver.Holds(packet));
    zassert_false(receiver.reassembler.IsActive());
}

ZTEST(smp_can_reassembler, test_packets_of_every_frame_boundary_round_trip) {
    for(size_t body_size = 0; body_size <= 30; body_size++) {
        Receiver receiver;
        auto packet = MakePacket(body_size);

        zassert_equal(receiver.Feed(MakeFrames(packet)), Result::COMPLETE, "Body size %zu", body_size);
        zassert_true(receiver.Holds(packet), "Body size %zu", body_size);
    }
}

ZTEST(smp_can_reassembler, test_sequence_wrap_is_accepted) {
    Receiver receiver;
    auto packet = MakePacket(1000);

    zassert_equal(receiver.Feed(MakeFrames(packet)), Result::COMPLETE);
    zassert_true(receiver.Holds(packet));
}

ZTEST(smp_can_reassembler, test_intermediate_frames_are_in_progress) {
    Receiver receiver;
    auto frames = MakeFrames(MakePacket(20));

    for(size_t i = 0; i + 1 < frames.size(); i++)
        zassert_equal(receiver.reassembler.Accept(frames[i], 0), Result::IN_PROGRESS);

    zassert_true(receiver.reassembler.IsActive());
}

ZTEST(smp_can_reassembler, test_sequence_gap_drops_the_packet) {
    Receiver receiver;
    auto frames = MakeFrames(MakePacket(30));
    frames.erase(frames.begin() + 2);

    zassert_equal(receiver.reassembler.Accept(frames[0], 0), Result::IN_PROGRESS);
    zassert_equal(receiver.reassembler.Accept(frames[1], 0), Result::IN_PROGRESS);
    zassert_equal(receiver.reassembler.Accept(frames[2], 0), Result::DROPPED);
    zassert_equal(
        receiver.reassembler.Accept(frames[3], 0), Result::IGNORED, "The rest of a dropped packet is ignored"
    );
}

ZTEST(smp_can_reassembler, test_start_frame_restarts_the_packet) {
    Receiver receiver;
    auto first = MakeFrames(MakePacket(30));
    auto second_packet = MakePacket(12);

    receiver.reassembler.Accept(first[0], 0);
    receiver.reassembler.Accept(first[1], 0);

    zassert_equal(receiver.Feed(MakeFrames(second_packet)), Result::COMPLETE);
    zassert_true(receiver.Holds(second_packet));
}

ZTEST(smp_can_reassembler, test_continuation_without_start_is_ignored) {
    Receiver receiver;
    auto frames = MakeFrames(MakePacket(30));

    zassert_equal(receiver.reassembler.Accept(frames[1], 0), Result::IGNORED);
    zassert_false(receiver.reassembler.IsActive());
}

ZTEST(smp_can_reassembler, test_start_frame_with_nonzero_sequence_is_dropped) {
    Receiver receiver;
    auto frames = MakeFrames(MakePacket(30));
    frames[0][0] |= 0x05;

    zassert_equal(receiver.reassembler.Accept(frames[0], 0), Result::DROPPED);
}

ZTEST(smp_can_reassembler, test_packet_larger_than_the_buffer_is_dropped) {
    std::array<uint8_t, 64> buffer{};
    SmpCanReassembler reassembler;
    reassembler.Attach(buffer);

    auto frames = MakeFrames(MakePacket(100));

    zassert_equal(reassembler.Accept(frames[0], 0), Result::IN_PROGRESS);
    zassert_equal(
        reassembler.Accept(frames[1], 0), Result::DROPPED,
        "Dropped as soon as the header announces more than the buffer holds"
    );
}

ZTEST(smp_can_reassembler, test_short_intermediate_frame_is_dropped) {
    Receiver receiver;
    auto frames = MakeFrames(MakePacket(30));
    frames[1].pop_back();

    receiver.reassembler.Accept(frames[0], 0);

    zassert_equal(receiver.reassembler.Accept(frames[1], 0), Result::DROPPED);
}

ZTEST(smp_can_reassembler, test_data_beyond_the_packet_is_dropped) {
    Receiver receiver;
    auto frames = MakeFrames(MakePacket(2)); // 10 bytes: 7 + 3
    frames[1].push_back(0xAA);

    receiver.reassembler.Accept(frames[0], 0);

    zassert_equal(receiver.reassembler.Accept(frames[1], 0), Result::DROPPED);
}

ZTEST(smp_can_reassembler, test_empty_and_oversize_frames_are_rejected) {
    Receiver receiver;
    const Frame oversize(9, 0x80);

    zassert_equal(receiver.reassembler.Accept({}, 0), Result::IGNORED);
    zassert_equal(receiver.reassembler.Accept(oversize, 0), Result::IGNORED);
    zassert_equal(
        receiver.reassembler.Accept(Frame{ SmpCanFrameFormat::START_FLAG }, 0), Result::DROPPED,
        "A start frame must carry data"
    );
}

ZTEST(smp_can_reassembler, test_silent_source_times_out) {
    Receiver receiver;
    auto frames = MakeFrames(MakePacket(30));

    receiver.reassembler.Accept(frames[0], 1000);

    zassert_false(receiver.reassembler.IsExpired(1000 + TIMEOUT_MS));
    zassert_true(receiver.reassembler.IsExpired(1000 + TIMEOUT_MS + 1));
    zassert_equal(
        receiver.reassembler.Accept(frames[1], 1000 + TIMEOUT_MS + 1), Result::IGNORED,
        "A frame after the timeout does not continue the stale packet"
    );
}

ZTEST(smp_can_reassembler, test_each_frame_extends_the_timeout) {
    Receiver receiver;
    auto packet = MakePacket(30);
    auto frames = MakeFrames(packet);
    Result result = Result::IGNORED;

    for(size_t i = 0; i < frames.size(); i++)
        result = receiver.reassembler.Accept(frames[i], static_cast<int64_t>(i) * TIMEOUT_MS);

    zassert_equal(result, Result::COMPLETE);
    zassert_true(receiver.Holds(packet));
}

ZTEST(smp_can_reassembler, test_can_fd_packets_round_trip_with_padding) {
    constexpr SmpCanFrameFormat CAN_FD(true);

    for(size_t body_size = 0; body_size <= 200; body_size++) {
        Receiver receiver(CAN_FD);
        auto packet = MakePacket(body_size);

        zassert_equal(receiver.Feed(MakeFrames(packet, CAN_FD)), Result::COMPLETE, "Body size %zu", body_size);
        zassert_true(receiver.Holds(packet), "Body size %zu", body_size);
    }
}

ZTEST(smp_can_reassembler, test_can_fd_padding_may_reach_past_a_full_buffer) {
    constexpr SmpCanFrameFormat CAN_FD(true);
    Receiver receiver(CAN_FD);
    auto packet = MakePacket(receiver.buffer.size() - SmpHeader::SIZE); // last frame: 17 bytes, sent as 20

    auto frames = MakeFrames(packet, CAN_FD);
    zassert_equal(frames.back().size(), 20);

    zassert_equal(receiver.Feed(frames), Result::COMPLETE);
    zassert_true(receiver.Holds(packet));
}

ZTEST(smp_can_reassembler, test_can_fd_last_frame_with_wrong_padding_is_dropped) {
    constexpr SmpCanFrameFormat CAN_FD(true);
    Receiver receiver(CAN_FD);
    auto frames = MakeFrames(MakePacket(68), CAN_FD); // last frame: 14 bytes, sent as 16
    frames[1].resize(20, 0);

    receiver.reassembler.Accept(frames[0], 0);

    zassert_equal(receiver.reassembler.Accept(frames[1], 0), Result::DROPPED);
}

ZTEST(smp_can_reassembler, test_classic_frames_do_not_continue_a_can_fd_packet) {
    constexpr SmpCanFrameFormat CAN_FD(true);
    Receiver receiver(CAN_FD);
    auto packet = MakePacket(200);
    auto fd_frames = MakeFrames(packet, CAN_FD);
    auto classic_frames = MakeFrames(packet);

    receiver.reassembler.Accept(fd_frames[0], 0);
    classic_frames[1][0] = fd_frames[1][0];

    zassert_equal(
        receiver.reassembler.Accept(classic_frames[1], 0), Result::DROPPED,
        "A short intermediate frame breaks the CAN FD format"
    );
}

ZTEST(smp_can_reassembler, test_can_fd_frame_on_a_classic_receiver_is_rejected) {
    Receiver receiver;
    auto frames = MakeFrames(MakePacket(100), SmpCanFrameFormat(true));

    zassert_equal(receiver.reassembler.Accept(frames[0], 0), Result::IGNORED);
}
```

## src/smp_header.cpp
```c
#include <array>
#include <cstdint>

#include <zephyr/ztest.h>

#include "subsys/smp/smp_header.h"

using eerie_leap::subsys::smp::SmpHeader;
using eerie_leap::subsys::smp::SmpOperation;

ZTEST_SUITE(smp_header, NULL, NULL, NULL, NULL, NULL);

ZTEST(smp_header, test_encode_matches_the_wire_layout) {
    const SmpHeader header{
        .operation = SmpOperation::WRITE,
        .version = 1,
        .flags = 0,
        .length = 0x0102,
        .group = 0x0040,
        .sequence = 9,
        .command_id = 3,
    };

    std::array<uint8_t, SmpHeader::SIZE> data{};
    header.Encode(data);

    constexpr std::array<uint8_t, SmpHeader::SIZE> EXPECTED = { 0x0A, 0x00, 0x01, 0x02, 0x00, 0x40, 0x09, 0x03 };
    zassert_mem_equal(data.data(), EXPECTED.data(), EXPECTED.size());
}

ZTEST(smp_header, test_parse_round_trips) {
    constexpr std::array<uint8_t, SmpHeader::SIZE> DATA = { 0x0B, 0x00, 0x00, 0x05, 0x00, 0x00, 0x2A, 0x00 };

    auto header = SmpHeader::Parse(DATA);

    zassert_true(header.has_value());
    zassert_equal(header->operation, SmpOperation::WRITE_RESPONSE);
    zassert_equal(header->version, 1);
    zassert_equal(header->length, 5);
    zassert_equal(header->group, 0);
    zassert_equal(header->sequence, 0x2A);
    zassert_equal(header->GetPacketSize(), 13);
    zassert_true(header->IsResponse());
    zassert_false(header->IsRequest());
}

ZTEST(smp_header, test_short_input_is_rejected) {
    constexpr std::array<uint8_t, SmpHeader::SIZE - 1> DATA{};

    zassert_false(SmpHeader::Parse(DATA).has_value());
}

ZTEST(smp_header, test_read_and_write_are_requests) {
    zassert_true(SmpHeader{ .operation = SmpOperation::READ }.IsRequest());
    zassert_true(SmpHeader{ .operation = SmpOperation::WRITE }.IsRequest());
    zassert_true(SmpHeader{ .operation = SmpOperation::READ_RESPONSE }.IsResponse());
    zassert_false(SmpHeader{ .operation = static_cast<SmpOperation>(5) }.IsRequest());
    zassert_false(SmpHeader{ .operation = static_cast<SmpOperation>(5) }.IsResponse());
}
```

## src/smp_test_support.h
```c
#pragma once

#include <array>
#include <cstdint>
#include <vector>

#include "subsys/smp/can/smp_can_framer.h"
#include "subsys/smp/smp_header.h"

namespace smp_test {

using eerie_leap::subsys::smp::SmpHeader;
using eerie_leap::subsys::smp::SmpOperation;
using eerie_leap::subsys::smp::can::SmpCanFrameFormat;
using eerie_leap::subsys::smp::can::SmpCanFramer;

using Frame = std::vector<uint8_t>;

// An SMP write request with a body of the given size.
inline std::vector<uint8_t> MakePacket(size_t body_size) {
    const SmpHeader header{
        .operation = SmpOperation::WRITE,
        .version = 1,
        .length = static_cast<uint16_t>(body_size),
        .group = 64,
        .sequence = 7,
        .command_id = 1,
    };

    std::vector<uint8_t> packet(SmpHeader::SIZE + body_size);
    header.Encode(std::span<uint8_t, SmpHeader::SIZE>(packet.data(), SmpHeader::SIZE));
    for(size_t i = 0; i < body_size; i++)
        packet[SmpHeader::SIZE + i] = static_cast<uint8_t>(i * 7 + 3);

    return packet;
}

inline std::vector<Frame> MakeFrames(std::span<const uint8_t> packet, SmpCanFrameFormat format = {}) {
    std::vector<Frame> frames;
    SmpCanFramer framer(packet, format);

    while(!framer.IsDone()) {
        std::array<uint8_t, SmpCanFrameFormat::MAX_FRAME_SIZE> frame{};
        const size_t size = framer.Encode(frame);
        frames.emplace_back(frame.begin(), frame.begin() + size);
        framer.Advance();
    }

    return frames;
}

} // namespace smp_test
```
