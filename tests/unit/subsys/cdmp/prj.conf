## CMakeLists.txt
```
cmake_minimum_required(VERSION 3.20.0)

include(${CMAKE_CURRENT_SOURCE_DIR}/../../../rt_core_test.cmake)

find_package(Zephyr REQUIRED HINTS $ENV{ZEPHYR_BASE})
project(unit_subsys_cdmp)

file(GLOB_RECURSE TEST_SOURCES src/*.c src/*.cpp)

target_sources(app PRIVATE ${TEST_SOURCES})
target_include_directories(app PRIVATE ${CMAKE_CURRENT_SOURCE_DIR}/../../../common)

# The QEMU boards have no hwinfo driver, so hwinfo_get_device_id() answers -ENOSYS there and
# CdmpUid::Generate() never takes its hardware branch. A fixed device id stands in for one; the
# suite switches it off to reach the random fallback (cdmp_uid.cpp, under the same condition).
if(NOT CONFIG_HWINFO_HAS_DRIVER)
    target_sources(app PRIVATE fakes/hwinfo_device_id.cpp)
    target_include_directories(app PRIVATE fakes)
endif()
```

## prj.conf
```kconfig
CONFIG_ZTEST=y

# Language and Compiler
CONFIG_CPP=y
CONFIG_PICOLIBC=y
CONFIG_STD_CPP23=y
CONFIG_REQUIRES_FULL_LIBCPP=y
CONFIG_CPP_EXCEPTIONS=y
CONFIG_CPP_RTTI=y

# Memory
CONFIG_HEAP_MEM_POOL_SIZE=100000

# C++ exception unwinding needs considerably more stack than the ztest defaults.
CONFIG_MAIN_STACK_SIZE=8192
CONFIG_ZTEST_STACK_SIZE=8192

# Logging And Debugging
CONFIG_LOG=y
CONFIG_TEST_RANDOM_GENERATOR=y
CONFIG_THREAD_NAME=y

# ThreadBase::InitializeStack() falls back to k_thread_stack_alloc().
CONFIG_THREAD_STACK_INFO=y
CONFIG_DYNAMIC_THREAD=y
CONFIG_DYNAMIC_THREAD_ALLOC=y

# CANBus. The CDMP services link against Canbus, and the flow tests record frames on a loopback controller.
CONFIG_CAN=y
CONFIG_CAN_FD_MODE=y
CONFIG_CAN_LOOPBACK=y

# The 512 byte default overflows on the 64-bit QEMU targets.
CONFIG_CAN_LOOPBACK_TX_THREAD_STACK_SIZE=2048

CONFIG_EERIE_LEAP_RT_CORE=y
CONFIG_EERIE_LEAP_THREADING=y
CONFIG_EERIE_LEAP_CANBUS=y
CONFIG_EERIE_LEAP_CDMP=y
```

## src/cdmp_can_id_manager.cpp
```c
#include <stdexcept>

#include <zephyr/ztest.h>

#include "subsys/cdmp/utilities/cdmp_can_id_manager.h"

using eerie_leap::subsys::canbus::CanId;
using eerie_leap::subsys::cdmp::utilities::CdmpCanIdManager;

ZTEST_SUITE(cdmp_can_id_manager, NULL, NULL, NULL, NULL, NULL);

ZTEST(cdmp_can_id_manager, test_ids_are_standard_offsets_from_the_base) {
    CdmpCanIdManager manager;

    zassert_equal(manager.GetBaseCanId(), CdmpCanIdManager::DEFAULT_BASE_CAN_ID);
    zassert_equal(manager.GetManagementCanId().id, 0x700);
    zassert_equal(manager.GetHeartbeatCanId().id, 0x701);
    zassert_equal(manager.GetCommandRequestCanId().id, 0x702);
    zassert_equal(manager.GetCommandResponseCanId().id, 0x703);
    zassert_equal(manager.GetCapabilityCanId(0).id, 0x714);
    zassert_false(manager.GetHeartbeatCanId().is_extended, "CDMP uses 11-bit identifiers only");
}

ZTEST(cdmp_can_id_manager, test_base_must_leave_room_for_the_id_range) {
    zassert_true(CdmpCanIdManager::IsValidBaseCanId(0x000));
    zassert_true(CdmpCanIdManager::IsValidBaseCanId(0x79C), "Base + 99 = 0x7FF still fits");
    zassert_false(CdmpCanIdManager::IsValidBaseCanId(0x79D));
    zassert_false(CdmpCanIdManager::IsValidBaseCanId(0xFFFFFFF0), "Must not wrap around");
}

ZTEST(cdmp_can_id_manager, test_base_can_be_changed) {
    CdmpCanIdManager manager;

    manager.SetBaseCanId(0x600);

    zassert_equal(manager.GetBaseCanId(), 0x600);
    zassert_equal(manager.GetHeartbeatCanId().id, 0x601);
}

ZTEST(cdmp_can_id_manager, test_invalid_base_is_rejected) {
    CdmpCanIdManager manager;
    bool threw = false;

    try {
        manager.SetBaseCanId(0x7F0);
    } catch(const std::invalid_argument&) {
        threw = true;
    }

    zassert_true(threw);
    zassert_equal(manager.GetBaseCanId(), CdmpCanIdManager::DEFAULT_BASE_CAN_ID, "A rejected base must not be applied");
}

ZTEST(cdmp_can_id_manager, test_capability_bit_out_of_range_is_rejected) {
    CdmpCanIdManager manager;
    bool threw = false;

    try {
        (void)manager.GetCapabilityCanId(32);
    } catch(const std::invalid_argument&) {
        threw = true;
    }

    zassert_true(threw);
}

ZTEST(cdmp_can_id_manager, test_receive_ids_share_one_filter_at_an_aligned_base) {
    CdmpCanIdManager manager;

    const auto filter = manager.GetReceiveFilter(manager.GetManagementCanId());
    zassert_equal(filter.id, 0x700);
    zassert_equal(filter.mask, 0x7F8);
    zassert_false(filter.is_extended);

    for(const auto& id :
        { manager.GetHeartbeatCanId(), manager.GetCommandRequestCanId(), manager.GetCommandResponseCanId(),
            manager.GetStateChangeRequestCanId(), manager.GetStateChangeResponseCanId() }) {

        zassert_true(manager.GetReceiveFilter(id) == filter, "0x%03X shares the block filter", id.id);
        zassert_true(filter.Matches(id));
    }

    zassert_false(filter.Matches(CanId::Standard(0x6FF)), "The block stays inside the CDMP range");
    zassert_false(filter.Matches(CanId::Standard(0x708)));
}

ZTEST(cdmp_can_id_manager, test_receive_ids_use_exact_filters_at_an_unaligned_base) {
    CdmpCanIdManager manager(0x604);

    for(const auto& id : { manager.GetManagementCanId(), manager.GetStateChangeResponseCanId() }) {
        const auto filter = manager.GetReceiveFilter(id);
        zassert_true(filter.IsExact(), "An aligned block would reach below the base");
        zassert_equal(filter.id, id.id);
    }
}
```

## src/cdmp_receive_filter.cpp
```c
#include <array>
#include <cstdint>
#include <memory>
#include <vector>

#include <zephyr/device.h>
#include <zephyr/devicetree.h>
#include <zephyr/drivers/can.h>
#include <zephyr/kernel.h>
#include <zephyr/ztest.h>

#include "cdmp_test_features.h"
#include "subsys/canbus/canbus.h"
#include "subsys/canbus/canbus_proxy.hpp"
#include "subsys/cdmp/models/cdmp_device.h"
#include "subsys/cdmp/services/cdmp_canbus_service_base.h"

using eerie_leap::tests::DISPLAY_FEATURES;

using namespace eerie_leap::subsys::canbus;
using namespace eerie_leap::subsys::cdmp::models;
using namespace eerie_leap::subsys::cdmp::services;
using namespace eerie_leap::subsys::cdmp::utilities;

namespace {

const device* ReceiveFilterLoopbackDevice() {
    return DEVICE_DT_GET(DT_NODELABEL(can_loopback0));
}

// Exposes the receive registration the CDMP services share.
class ProbeService final : public CdmpCanbusServiceBase {
private:
    bool DoStart() override {
        return true;
    }
    bool DoStop() override {
        return true;
    }

public:
    using CdmpCanbusServiceBase::CdmpCanbusServiceBase;
    using CdmpCanbusServiceBase::RegisterReceiveHandler;
};

struct FrameCounter {
    k_sem received{};

    FrameCounter() {
        k_sem_init(&received, 0, K_SEM_MAX_LIMIT);
    }

    CanFrameHandler Handler() {
        return [this](const CanFrame&) {
            k_sem_give(&received);
        };
    }

    bool Received(int timeout_ms = 200) {
        return k_sem_take(&received, K_MSEC(timeout_ms)) == 0;
    }
};

// Fills the controller's free filter slots with a filter no test frame matches, then frees them.
size_t CountFreeControllerFilters() {
    const can_filter unused{ .id = 0x0F0, .mask = CAN_STD_ID_MASK, .flags = 0 };
    std::vector<int> filter_ids;

    int filter_id = 0;
    while((filter_id = can_add_rx_filter(
               ReceiveFilterLoopbackDevice(), [](const device*, can_frame*, void*) {}, nullptr, &unused
           ))
        >= 0) {

        filter_ids.push_back(filter_id);
    }

    for(const int id : filter_ids)
        can_remove_rx_filter(ReceiveFilterLoopbackDevice(), id);

    return filter_ids.size();
}

struct ReceiveFilterFixture {
    std::shared_ptr<CdmpCanIdManager> ids = std::make_shared<CdmpCanIdManager>();
    std::shared_ptr<CdmpDevice> device = std::make_shared<CdmpDevice>(0x12345678, DISPLAY_FEATURES);
    std::shared_ptr<CanbusProxy> canbus;
    ProbeService probe{ ids, device };
    std::vector<int> handler_ids;

    ReceiveFilterFixture() {
        auto running_canbus = std::make_unique<Canbus>(
            CanbusConfig(ReceiveFilterLoopbackDevice(), CanbusType::CLASSICAL_CAN, 500000, 0, CAN_MODE_LOOPBACK)
        );
        zassert_true(running_canbus->Initialize(), "Canbus::Initialize() failed");
        zassert_true(running_canbus->Start(), "Canbus::Start() failed");
        canbus = std::make_shared<CanbusProxy>(std::move(running_canbus));

        probe.Configure(canbus);
    }

    ReceiveFilterFixture(const ReceiveFilterFixture&) = delete;
    ReceiveFilterFixture& operator=(const ReceiveFilterFixture&) = delete;
    ReceiveFilterFixture(ReceiveFilterFixture&&) = delete;
    ReceiveFilterFixture& operator=(ReceiveFilterFixture&&) = delete;

    ~ReceiveFilterFixture() {
        // Get() instead of operator->, which throws when the proxy holds no instance.
        if(Canbus* live_bus = canbus->Get(); live_bus != nullptr) {
            for(const int handler_id : handler_ids)
                live_bus->RemoveFrameReceivedHandler(handler_id);
        }
    }

    int Keep(int handler_id) {
        if(handler_id > 0)
            handler_ids.push_back(handler_id);

        return handler_id;
    }

    void Send(uint32_t id) {
        const std::array<uint8_t, 1> data{ 0x01 };
        zassert_ok((*canbus)->SendFrame(CanId::Standard(id), data, K_MSEC(100)));
    }
};

void StopReceiveFilterLoopback(void* /*fixture*/) {
    can_stop(ReceiveFilterLoopbackDevice());
}

} // namespace

ZTEST_SUITE(cdmp_receive_filter, NULL, NULL, NULL, StopReceiveFilterLoopback, NULL);

ZTEST(cdmp_receive_filter, test_receive_ids_share_one_controller_filter) {
    ReceiveFilterFixture fixture;
    const size_t free_before = CountFreeControllerFilters();
    FrameCounter management;
    FrameCounter heartbeat;

    zassert_true(
        fixture.Keep(fixture.probe.RegisterReceiveHandler(fixture.ids->GetManagementCanId(), management.Handler())) > 0
    );
    zassert_true(
        fixture.Keep(fixture.probe.RegisterReceiveHandler(fixture.ids->GetHeartbeatCanId(), heartbeat.Handler())) > 0
    );

    zassert_equal(free_before - CountFreeControllerFilters(), 1, "Both IDs share the CDMP block filter");

    fixture.Send(fixture.ids->GetManagementCanId().id);
    zassert_true(management.Received());
    zassert_false(heartbeat.Received(50), "A handler only sees the frames of its own ID");

    fixture.Send(fixture.ids->GetHeartbeatCanId().id);
    zassert_true(heartbeat.Received());
    zassert_false(management.Received(50));
}

ZTEST(cdmp_receive_filter, test_overlapping_route_makes_cdmp_use_exact_filters) {
    ReceiveFilterFixture fixture;
    FrameCounter route;
    FrameCounter management;

    // A route inside Base+0..Base+7 that registered first, as a misconfigured CAN message would.
    const uint32_t route_id = fixture.ids->GetBaseCanId() + 6;
    zassert_true(
        fixture.Keep((*fixture.canbus)->RegisterFrameReceivedHandler(CanId::Standard(route_id), route.Handler())) > 0
    );

    zassert_true(
        fixture.Keep(fixture.probe.RegisterReceiveHandler(fixture.ids->GetManagementCanId(), management.Handler())) > 0,
        "CDMP falls back to its exact filter"
    );

    fixture.Send(fixture.ids->GetManagementCanId().id);
    zassert_true(management.Received());

    fixture.Send(route_id);
    zassert_true(route.Received(), "The route keeps receiving its frames");
    zassert_false(management.Received(50));
}
```

## src/cdmp_transaction.cpp
```c
#include <memory>
#include <optional>
#include <span>
#include <utility>
#include <vector>

#include <zephyr/kernel.h>
#include <zephyr/ztest.h>

#include "cdmp_test_features.h"
#include "subsys/cdmp/models/messages/cdmp_command_response_message.h"
#include "subsys/cdmp/services/command_service/cdmp_transaction_service.h"
#include "subsys/threading/work_queue_thread.h"

using eerie_leap::tests::DISPLAY_FEATURES;

using namespace eerie_leap::subsys::cdmp::models;
using namespace eerie_leap::subsys::cdmp::services::command_service;
using namespace eerie_leap::subsys::cdmp::utilities;

using eerie_leap::subsys::threading::WorkQueueThread;

namespace {

constexpr uint8_t TARGET_ID = 4;
constexpr uint8_t OTHER_ID = 5;
constexpr uint8_t LOGGING_COMMAND = 0x20;
constexpr uint8_t STATE_SYNC_REQUEST = std::to_underlying(CdmpServiceCommandCode::STATE_SYNC_REQUEST);

struct TransactionFixture {
    std::shared_ptr<WorkQueueThread> work_queue = std::make_shared<WorkQueueThread>(
        "cdmp_test_wq",
        CONFIG_EERIE_LEAP_CDMP_WORK_QUEUE_STACK_SIZE,
        CONFIG_EERIE_LEAP_CDMP_WORK_QUEUE_PRIORITY
    );
    std::shared_ptr<CdmpDevice> device = std::make_shared<CdmpDevice>(0x11111111, DISPLAY_FEATURES);
    std::unique_ptr<CdmpTransactionService> transactions;

    k_sem completed{};
    std::vector<CdmpResultCode> results;

    TransactionFixture() {
        zassert_true(work_queue->Initialize());
        transactions = std::make_unique<CdmpTransactionService>(work_queue, device);
        transactions->Initialize();
        k_sem_init(&completed, 0, K_SEM_MAX_LIMIT);
    }

    TransactionFixture(const TransactionFixture&) = delete;
    TransactionFixture& operator=(const TransactionFixture&) = delete;
    TransactionFixture(TransactionFixture&&) = delete;
    TransactionFixture& operator=(TransactionFixture&&) = delete;

    ~TransactionFixture() {
        transactions.reset();
        work_queue->Stop();
    }

    uint8_t Start(uint8_t target_device_id, uint8_t command_code, int timeout_ms = 1000) {
        return transactions->StartTransaction(
            target_device_id, command_code, timeout_ms,
            [this](uint8_t, CdmpResultCode result_code, std::span<const uint8_t>) {
                results.push_back(result_code);
                k_sem_give(&completed);
            }
        );
    }

    void Respond(uint8_t source, uint8_t command_code, uint8_t transaction_id) const {
        transactions->CompleteTransaction(
            { .source_device_id = source,
                .command_code = command_code,
                .transaction_id = transaction_id,
                .result_code = CdmpResultCode::SUCCESS,
                .data = {} }
        );
    }
};

} // namespace

ZTEST_SUITE(cdmp_transaction, NULL, NULL, NULL, NULL, NULL);

ZTEST(cdmp_transaction, test_response_must_echo_the_command_and_come_from_the_target) {
    TransactionFixture fixture;
    const uint8_t transaction_id = fixture.Start(TARGET_ID, LOGGING_COMMAND);

    // Other exchanges on the bus that happen to carry the same transaction ID.
    fixture.Respond(TARGET_ID, STATE_SYNC_REQUEST, transaction_id);
    fixture.Respond(OTHER_ID, LOGGING_COMMAND, transaction_id);

    zassert_true(fixture.transactions->IsTransactionPending(transaction_id));
    zassert_true(fixture.results.empty(), "Neither answers this request");

    fixture.Respond(TARGET_ID, LOGGING_COMMAND, transaction_id);

    zassert_false(fixture.transactions->IsTransactionPending(transaction_id));
    zassert_equal(fixture.results.size(), 1);
    zassert_equal(fixture.results[0], CdmpResultCode::SUCCESS);
}

ZTEST(cdmp_transaction, test_any_device_answers_a_broadcast_request) {
    TransactionFixture fixture;
    const uint8_t transaction_id = fixture.Start(CdmpDevice::DEVICE_ID_BROADCAST, LOGGING_COMMAND);

    fixture.Respond(OTHER_ID, LOGGING_COMMAND, transaction_id);

    zassert_false(fixture.transactions->IsTransactionPending(transaction_id));
    zassert_equal(fixture.results.size(), 1);
}

ZTEST(cdmp_transaction, test_unanswered_transaction_times_out) {
    TransactionFixture fixture;
    fixture.transactions->Start();

    const uint8_t transaction_id = fixture.Start(TARGET_ID, LOGGING_COMMAND, 50);

    zassert_equal(
        k_sem_take(&fixture.completed, K_MSEC(2 * CONFIG_EERIE_LEAP_CDMP_CMD_TRANSACTION_TIMEOUT_MS)), 0,
        "The timeout task expires it"
    );
    zassert_equal(fixture.results[0], CdmpResultCode::TIMEOUT);
    zassert_false(fixture.transactions->IsTransactionPending(transaction_id));
}

ZTEST(cdmp_transaction, test_stop_cancels_pending_transactions) {
    TransactionFixture fixture;
    fixture.transactions->Start();

    fixture.Start(TARGET_ID, LOGGING_COMMAND);
    fixture.Start(CdmpDevice::DEVICE_ID_BROADCAST, STATE_SYNC_REQUEST);
    zassert_equal(fixture.transactions->GetPendingTransactionCount(), 2);

    fixture.transactions->Stop();

    zassert_equal(fixture.transactions->GetPendingTransactionCount(), 0);
    zassert_equal(fixture.results.size(), 2);
    for(const auto result_code : fixture.results)
        zassert_equal(result_code, CdmpResultCode::CANCELLED);

    // Stopped, the timeout task no longer runs, so a new transaction stays pending.
    const uint8_t transaction_id = fixture.Start(TARGET_ID, LOGGING_COMMAND, 10);
    k_msleep(CONFIG_EERIE_LEAP_CDMP_CMD_TRANSACTION_TIMEOUT_MS);
    zassert_true(fixture.transactions->IsTransactionPending(transaction_id));
}
```

## src/cdmp_uid.cpp
```c
#include <array>
#include <cstdint>

#include <zephyr/drivers/hwinfo.h>
#include <zephyr/ztest.h>

#include "subsys/cdmp/utilities/cdmp_uid.h"

#ifndef CONFIG_HWINFO_HAS_DRIVER
    #include "hwinfo_device_id.h"
#endif

using eerie_leap::subsys::cdmp::utilities::CdmpUid;

ZTEST_SUITE(cdmp_uid, NULL, NULL, NULL, NULL, NULL);

ZTEST(cdmp_uid, test_empty_and_blank_ids_are_rejected) {
    constexpr std::array<uint8_t, 6> ZEROS{};
    constexpr std::array<uint8_t, 6> ONES = { 0xFF, 0xFF, 0xFF, 0xFF, 0xFF, 0xFF };

    zassert_false(CdmpUid::FromHardwareId({}).has_value());
    zassert_false(CdmpUid::FromHardwareId(ZEROS).has_value(), "An unprogrammed all-zero id has no identity");
    zassert_false(CdmpUid::FromHardwareId(ONES).has_value(), "An unprogrammed all-ones id has no identity");
}

ZTEST(cdmp_uid, test_hardware_id_folds_deterministically) {
    constexpr std::array<uint8_t, 6> MAC_A = { 0x24, 0x6F, 0x28, 0x01, 0x02, 0x03 };
    constexpr std::array<uint8_t, 6> MAC_B = { 0x24, 0x6F, 0x28, 0x01, 0x02, 0x04 };

    auto uid_a = CdmpUid::FromHardwareId(MAC_A);
    auto uid_a_again = CdmpUid::FromHardwareId(MAC_A);
    auto uid_b = CdmpUid::FromHardwareId(MAC_B);

    zassert_true(uid_a.has_value());
    zassert_true(uid_b.has_value());
    zassert_not_equal(uid_a.value(), 0);
    zassert_equal(uid_a.value(), uid_a_again.value(), "The same hardware id must give the same UID");
    zassert_not_equal(uid_a.value(), uid_b.value());
}

// Takes the hardware branch on every board of the suite (a driver, or the fake device id of the QEMU
// boards); the fallback has its own case below.
ZTEST(cdmp_uid, test_generated_uid_is_non_zero) {
    zassert_not_equal(CdmpUid::Generate(), 0);
}

ZTEST(cdmp_uid, test_generated_uid_is_stable_when_hardware_id_exists) {
    std::array<uint8_t, 16> hardware_id{};
    const ssize_t length = hwinfo_get_device_id(hardware_id.data(), hardware_id.size());
    // A board without a hwinfo driver gets a fixed id from fakes/hwinfo_device_id.cpp.
    zassert_true(length > 0, "The board has no hardware id: no hwinfo driver and no fake device id");

    const auto expected = CdmpUid::FromHardwareId({ hardware_id.data(), static_cast<size_t>(length) });
    zassert_true(expected.has_value(), "The hardware id is blank");

    const uint32_t uid = CdmpUid::Generate();
    zassert_equal(uid, expected.value(), "A hardware-derived UID must come from the hardware id");
    zassert_equal(CdmpUid::Generate(), uid, "A hardware-derived UID must not change");
}

#ifndef CONFIG_HWINFO_HAS_DRIVER
// The documented fallback (docs/cdmp.md): without a hardware id each UID is drawn at random. Only
// a board that links the fake device id can have it taken away, which is every board without a
// hwinfo driver.
ZTEST(cdmp_uid, test_generated_uid_falls_back_to_a_random_non_zero_uid_without_a_hardware_id) {
    SetFakeHwinfoDeviceIdAvailable(false);
    const uint32_t first = CdmpUid::Generate();
    const uint32_t second = CdmpUid::Generate();
    SetFakeHwinfoDeviceIdAvailable(true);

    zassert_not_equal(first, 0);
    zassert_not_equal(second, 0);
    zassert_not_equal(first, second, "Without a hardware id each UID is drawn at random");
}
#endif
```
