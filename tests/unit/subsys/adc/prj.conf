## CMakeLists.txt
```
cmake_minimum_required(VERSION 3.20.0)

include(${CMAKE_CURRENT_SOURCE_DIR}/../../../rt_core_test.cmake)

find_package(Zephyr REQUIRED HINTS $ENV{ZEPHYR_BASE})
project(unit_subsys_adc)

file(GLOB_RECURSE TEST_SOURCES src/*.c src/*.cpp)

target_sources(app PRIVATE ${TEST_SOURCES})
```

## prj.conf
```kconfig
CONFIG_ZTEST=y

# Language and Compiler
CONFIG_CPP=y
CONFIG_PICOLIBC=y
CONFIG_STD_CPP23=y
CONFIG_REQUIRES_FULL_LIBCPP=y
CONFIG_CPP_EXCEPTIONS=y
CONFIG_CPP_RTTI=y

# Memory
CONFIG_HEAP_MEM_POOL_SIZE=100000

# C++ exception unwinding needs considerably more stack than the ztest defaults.
CONFIG_MAIN_STACK_SIZE=8192
CONFIG_ZTEST_STACK_SIZE=8192

# Logging And Debugging
CONFIG_LOG=y
CONFIG_TEST_RANDOM_GENERATOR=y
CONFIG_THREAD_ANALYZER=y
CONFIG_THREAD_ANALYZER_USE_LOG=y
CONFIG_THREAD_NAME=y
CONFIG_SYS_HEAP_RUNTIME_STATS=y
CONFIG_THREAD_ANALYZER_ISR_STACK_USAGE=n
CONFIG_TIMING_FUNCTIONS=y

CONFIG_EERIE_LEAP_RT_CORE=y
CONFIG_EERIE_LEAP_ADC=y
CONFIG_EERIE_LEAP_RANDOM=y
```

## src/adc_calibrator.cpp
```c
#include <memory>
#include <memory_resource>
#include <stdexcept>
#include <zephyr/ztest.h>

#include "utilities/voltage_interpolator/calibration_data.h"
#include "utilities/voltage_interpolator/interpolation_method.h"
#include "subsys/adc/utilities/adc_calibrator.h"

using namespace eerie_leap::utilities::voltage_interpolator;
using eerie_leap::subsys::adc::utilities::AdcCalibrator;

namespace {

constexpr float kAdcMaxVolts = CONFIG_EERIE_LEAP_ADC_VOLTAGE_MAX_MV / 1000.0F;
constexpr float kSensorMaxVolts = CONFIG_EERIE_LEAP_SENSOR_VOLTAGE_MAX_MV / 1000.0F;

std::shared_ptr<std::pmr::vector<CalibrationData>> MakeTable(std::initializer_list<CalibrationData> points) {
    return std::make_shared<std::pmr::vector<CalibrationData>>(points);
}

} // namespace

ZTEST_SUITE(adc_calibrator, NULL, NULL, NULL, NULL, NULL);

ZTEST(adc_calibrator, test_InterpolateToInputRange_maps_adc_range_to_sensor_range) {
    zassert_between_inclusive(AdcCalibrator::InterpolateToInputRange(0.0F), -0.001, 0.001);
    zassert_between_inclusive(AdcCalibrator::InterpolateToInputRange(kAdcMaxVolts),
        kSensorMaxVolts - 0.001, kSensorMaxVolts + 0.001);
    zassert_between_inclusive(AdcCalibrator::InterpolateToInputRange(kAdcMaxVolts / 2.0F),
        kSensorMaxVolts / 2.0 - 0.001, kSensorMaxVolts / 2.0 + 0.001);
}

ZTEST(adc_calibrator, test_InterpolateToInputRange_is_monotonic) {
    float previous = AdcCalibrator::InterpolateToInputRange(0.0F);

    for(int step = 1; step <= 100; ++step) {
        float value = AdcCalibrator::InterpolateToInputRange(kAdcMaxVolts * step / 100.0F);

        zassert_true(value >= previous, "value dropped at step %d", step);
        previous = value;
    }
}

ZTEST(adc_calibrator, test_InterpolateToInputRange_handles_out_of_range_input) {
    // The ADC can report slightly outside the calibrated span; this must not read past the table.
    zassert_true(AdcCalibrator::InterpolateToInputRange(-0.5F) < 0.0F);
    zassert_true(AdcCalibrator::InterpolateToInputRange(kAdcMaxVolts * 2.0F) > kSensorMaxVolts);
}

ZTEST(adc_calibrator, test_constructor_rejects_null_calibration_data) {
    bool threw = false;
    try {
        AdcCalibrator calibrator(InterpolationMethod::LINEAR, nullptr);
        (void)calibrator;
    } catch(const std::invalid_argument&) {
        threw = true;
    }

    zassert_true(threw);
}

ZTEST(adc_calibrator, test_constructor_rejects_table_with_fewer_than_two_points) {
    bool threw = false;
    try {
        AdcCalibrator calibrator(InterpolationMethod::LINEAR, MakeTable({{0.0F, 0.0F}}));
        (void)calibrator;
    } catch(const std::invalid_argument&) {
        threw = true;
    }

    zassert_true(threw);
}

ZTEST(adc_calibrator, test_constructor_rejects_unsupported_interpolation_method) {
    bool threw = false;
    try {
        AdcCalibrator calibrator(InterpolationMethod::NONE, MakeTable({{0.0F, 0.0F}, {5.0F, 5.0F}}));
        (void)calibrator;
    } catch(const std::runtime_error&) {
        threw = true;
    }

    zassert_true(threw);
}

ZTEST(adc_calibrator, test_GetInterpolationMethod) {
    AdcCalibrator linear(InterpolationMethod::LINEAR, MakeTable({{0.0F, 0.0F}, {5.0F, 5.0F}}));
    AdcCalibrator spline(InterpolationMethod::CUBIC_SPLINE,
        MakeTable({{0.0F, 0.0F}, {1.0F, 1.1F}, {3.0F, 3.2F}, {5.0F, 5.0F}}));

    zassert_equal(linear.GetInterpolationMethod(), InterpolationMethod::LINEAR);
    zassert_equal(spline.GetInterpolationMethod(), InterpolationMethod::CUBIC_SPLINE);
}

ZTEST(adc_calibrator, test_GetCalibrationTable_returns_the_original_table) {
    auto table = MakeTable({{0.0F, 0.0F}, {3.0F, 3.3F}});
    AdcCalibrator calibrator(InterpolationMethod::LINEAR, table);

    auto retrieved = calibrator.GetCalibrationTable();

    zassert_equal(retrieved.get(), table.get());
    zassert_equal(retrieved->size(), 2);
    zassert_equal(retrieved->at(1).voltage, 3.0F);
    zassert_equal(retrieved->at(1).value, 3.3F);
}

ZTEST(adc_calibrator, test_InterpolateToCalibratedRange_with_identity_table) {
    AdcCalibrator calibrator(InterpolationMethod::LINEAR, MakeTable({{0.0F, 0.0F}, {5.0F, 5.0F}}));

    zassert_between_inclusive(calibrator.InterpolateToCalibratedRange(2.5F), 2.49, 2.51);
    zassert_between_inclusive(calibrator.InterpolateToCalibratedRange(5.0F), 4.99, 5.01);
}

ZTEST(adc_calibrator, test_InterpolateToCalibratedRange_inverts_the_calibration) {
    // The calibrator maps a measured value back to the voltage that produced it.
    AdcCalibrator calibrator(InterpolationMethod::LINEAR, MakeTable({{0.0F, 0.0F}, {3.0F, 3.3F}}));

    zassert_between_inclusive(calibrator.InterpolateToCalibratedRange(3.3F), 2.99, 3.01);
    zassert_between_inclusive(calibrator.InterpolateToCalibratedRange(1.65F), 1.49, 1.51);
}

ZTEST(adc_calibrator, test_InterpolateToCalibratedRange_passes_through_calibration_points) {
    auto table = MakeTable({{0.501F, 0.469F}, {1.0F, 0.968F}, {2.0F, 1.970F}, {3.002F, 2.98F}, {5.0F, 5.0F}});

    for(auto method : { InterpolationMethod::LINEAR, InterpolationMethod::CUBIC_SPLINE }) {
        AdcCalibrator calibrator(method, table);

        for(const auto& point : *table) {
            float result = calibrator.InterpolateToCalibratedRange(point.value);

            zassert_between_inclusive(result, point.voltage - 0.01, point.voltage + 0.01,
                "measured %f mapped to %f instead of %f",
                (double)point.value, (double)result, (double)point.voltage);
        }
    }
}

ZTEST(adc_calibrator, test_calibrators_are_independent) {
    AdcCalibrator identity(InterpolationMethod::LINEAR, MakeTable({{0.0F, 0.0F}, {5.0F, 5.0F}}));
    AdcCalibrator halved(InterpolationMethod::LINEAR, MakeTable({{0.0F, 0.0F}, {2.5F, 5.0F}}));

    zassert_between_inclusive(identity.InterpolateToCalibratedRange(5.0F), 4.99, 5.01);
    zassert_between_inclusive(halved.InterpolateToCalibratedRange(5.0F), 2.49, 2.51);
}
```

## src/adc_simulator.cpp
```c
#include <cerrno>
#include <memory>
#include <optional>
#include <stdexcept>
#include <vector>
#include <zephyr/ztest.h>

#include "subsys/adc/adc_factory.hpp"
#include "subsys/adc/adc_manager.h"
#include "subsys/adc/adc_simulator.h"

using namespace eerie_leap::subsys::adc;
using eerie_leap::subsys::device_tree::AdcDTInfo;

namespace {

constexpr int SIMULATOR_CHANNELS = 8;

float SampleOne(IAdc& adc, uint8_t channel, uint16_t samples = 16) {
    const uint8_t channels[1] = { channel };
    AdcSample results[1];
    const AdcSampleRequest request{ .channels = channels, .results = results, .samples = samples };

    adc.Sample(request);
    zassert_equal(results[0].error, AdcError::NONE, "channel %u", channel);

    return results[0].volts;
}

} // namespace

ZTEST_SUITE(adc_simulator, NULL, NULL, NULL, NULL, NULL);

ZTEST(adc_simulator, test_Initialize_succeeds) {
    AdcSimulator adc;

    zassert_true(adc.Initialize());
    zassert_equal(adc.GetChannelCount(), SIMULATOR_CHANNELS);
}

ZTEST(adc_simulator, test_capabilities_are_reported) {
    AdcSimulator adc;
    adc.Initialize();

    const auto capabilities = adc.GetCapabilities();

    zassert_false(capabilities.burst);
    zassert_false(capabilities.multi_channel);
    zassert_equal(capabilities.us_per_conversion, 0);
}

ZTEST(adc_simulator, test_Sample_marks_out_of_range_channels) {
    AdcSimulator adc;
    adc.Initialize();

    const uint8_t channels[3] = { 7, SIMULATOR_CHANNELS, 100 };
    AdcSample results[3];
    const AdcSampleRequest request{ .channels = channels, .results = results, .samples = 16 };
    adc.Sample(request);

    zassert_equal(results[0].error, AdcError::NONE);
    zassert_between_inclusive(results[0].volts, 0.0F, 3.3F);

    for(const int i : { 1, 2 }) {
        zassert_equal(results[i].error, AdcError::CHANNEL_OUT_OF_RANGE, "channel %u should be rejected", channels[i]);
        zassert_equal(results[i].errno_value, -EINVAL);
    }

    zassert_equal(adc.GetStats().requests, 1);
    zassert_equal(adc.GetStats().errors, 2);
}

ZTEST(adc_simulator, test_Sample_marks_unordered_channels) {
    AdcSimulator adc;
    adc.Initialize();

    // The same contract as the hardware ADC: channels ascending, each at most once.
    const uint8_t channels[3] = { 3, 1, 3 };
    AdcSample results[3];
    const AdcSampleRequest request{ .channels = channels, .results = results, .samples = 16 };
    adc.Sample(request);

    zassert_equal(results[0].error, AdcError::NONE);

    for(const int i : { 1, 2 }) {
        zassert_equal(results[i].error, AdcError::CHANNEL_OUT_OF_RANGE, "entry %d should be rejected", i);
        zassert_equal(results[i].errno_value, -EINVAL);
    }

    zassert_equal(adc.GetStats().errors, 2);
    zassert_equal(adc.GetStats().conversions, 1);
}

ZTEST(adc_simulator, test_Sample_accepts_an_empty_request) {
    AdcSimulator adc;
    adc.Initialize();

    adc.Sample(AdcSampleRequest{});

    zassert_equal(adc.GetStats().requests, 1);
    zassert_equal(adc.GetStats().errors, 0);
}

ZTEST(adc_simulator, test_Sample_clamps_samples_to_at_least_one) {
    AdcSimulator adc;
    adc.Initialize();

    const float volts = SampleOne(adc, 0, 0);

    zassert_between_inclusive(volts, 0.0F, 3.3F, "zero samples must still produce a reading");
    zassert_equal(adc.GetStats().conversions, 1);
}

ZTEST(adc_simulator, test_Sample_stays_within_the_adc_range) {
    AdcSimulator adc;
    adc.Initialize();

    for(int channel = 0; channel < adc.GetChannelCount(); ++channel) {
        for(int i = 0; i < 50; ++i) {
            const float volts = SampleOne(adc, channel);
            zassert_between_inclusive(volts, 0.0F, 3.3F);
        }
    }
}

ZTEST(adc_simulator, test_Sample_varies) {
    AdcSimulator adc;
    adc.Initialize();

    const float first = SampleOne(adc, 0);
    bool changed = false;
    for(int i = 0; i < 20 && !changed; ++i)
        changed = SampleOne(adc, 0) != first;

    zassert_true(changed, "simulated readings should not be constant");
}

ZTEST_SUITE(adc_simulator_manager, NULL, NULL, NULL, NULL, NULL);

ZTEST(adc_simulator_manager, test_counts) {
    AdcManager manager({ std::make_shared<AdcSimulator>() });

    zassert_true(manager.Initialize());
    zassert_equal(manager.GetAdcCount(), 1);
    zassert_equal(manager.GetChannelCount(), SIMULATOR_CHANNELS);
    zassert_equal(manager.GetAdcs().size(), 1);
}

ZTEST(adc_simulator_manager, test_rejects_a_null_adc) {
    bool threw = false;
    try {
        const AdcManager manager({ nullptr });
    } catch(const std::invalid_argument&) {
        threw = true;
    }

    zassert_true(threw);
}

ZTEST(adc_simulator_manager, test_Resolve_maps_global_to_local) {
    const auto simulator = std::make_shared<AdcSimulator>();
    AdcManager manager({ simulator });
    manager.Initialize();

    for(int channel = 0; channel < SIMULATOR_CHANNELS; ++channel) {
        const auto handle = manager.Resolve(channel);

        zassert_equal(handle.adc, simulator.get());
        zassert_equal(static_cast<int>(handle.local_channel), channel);
    }
}

ZTEST(adc_simulator_manager, test_Resolve_rejects_out_of_range_channels) {
    AdcManager manager({ std::make_shared<AdcSimulator>() });
    manager.Initialize();

    for(const int channel : { -1, SIMULATOR_CHANNELS, 100 }) {
        bool threw = false;
        try {
            manager.Resolve(channel);
        } catch(const std::invalid_argument&) {
            threw = true;
        }

        zassert_true(threw, "channel %d should be rejected", channel);
    }
}

ZTEST(adc_simulator_manager, test_Resolve_spans_two_simulators) {
    AdcManager manager({ std::make_shared<AdcSimulator>(), std::make_shared<AdcSimulator>() });
    manager.Initialize();

    zassert_equal(manager.GetChannelCount(), 2 * SIMULATOR_CHANNELS);

    const auto last_of_first = manager.Resolve(SIMULATOR_CHANNELS - 1);
    const auto first_of_second = manager.Resolve(SIMULATOR_CHANNELS);

    zassert_equal(last_of_first.adc, manager.GetAdcs()[0].get());
    zassert_equal(last_of_first.local_channel, SIMULATOR_CHANNELS - 1);
    zassert_equal(first_of_second.adc, manager.GetAdcs()[1].get());
    zassert_equal(first_of_second.local_channel, 0);
}

ZTEST(adc_simulator_manager, test_resolved_channels_read_within_range) {
    AdcManager manager({ std::make_shared<AdcSimulator>() });
    manager.Initialize();

    for(int channel = 0; channel < SIMULATOR_CHANNELS; ++channel) {
        const auto handle = manager.Resolve(channel);

        for(int i = 0; i < 25; ++i) {
            const float volts = SampleOne(*handle.adc, handle.local_channel);
            zassert_between_inclusive(volts, 0.0F, 3.3F);
        }
    }
}

#ifndef CONFIG_ADC
// A unit without an ADC driver (rt_gauge) may still describe ADCs in its device tree.
ZTEST(adc_simulator_manager, test_factory_ignores_device_tree_without_a_driver) {
    static std::optional<std::vector<AdcDTInfo>> dt_adcs = std::vector<AdcDTInfo>{ AdcDTInfo{ .adc_device = nullptr,
        .channel_configs = { adc_channel_cfg{} },
        .references_mv = { 3300 },
        .resolutions = { 12 },
        .oversampling = { 0 } } };

    AdcFactory factory([] -> std::optional<std::vector<AdcDTInfo>>& {
        return dt_adcs;
    });
    const auto manager = factory.Create();

    zassert_equal(manager->GetAdcCount(), 1);
    zassert_not_null(dynamic_cast<AdcSimulator*>(manager->GetAdcs()[0].get()));
    zassert_true(manager->Initialize());
    zassert_equal(manager->GetChannelCount(), SIMULATOR_CHANNELS);
}
#endif
```
