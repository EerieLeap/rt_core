## CMakeLists.txt
```
cmake_minimum_required(VERSION 3.20.0)

include(${CMAKE_CURRENT_SOURCE_DIR}/../../../rt_core_test.cmake)

find_package(Zephyr REQUIRED HINTS $ENV{ZEPHYR_BASE})
project(unit_subsys_dfu_confirmation)

file(GLOB_RECURSE TEST_SOURCES src/*.c src/*.cpp)

# The sources under test are compiled straight into the test. CONFIG_EERIE_LEAP_DFU would also pull in
# img_mgmt, the flash simulator and the SMP stack, none of which these cases use. The two Zephyr
# implementations are included to prove that they compile (as stubs) without MCUboot and a watchdog.
set(DFU_SRC_DIR ${RT_CORE_DIR}/src/subsys/dfu)

target_sources(app PRIVATE
    ${TEST_SOURCES}
    ${DFU_SRC_DIR}/image_confirmation.cpp
    ${DFU_SRC_DIR}/mcuboot_boot_control.cpp
    ${DFU_SRC_DIR}/work_queue_probe.cpp
    ${DFU_SRC_DIR}/zephyr_watchdog.cpp
)
target_include_directories(app PRIVATE ${RT_CORE_DIR}/src)
```

## prj.conf
```kconfig
CONFIG_ZTEST=y

# Language and Compiler
CONFIG_CPP=y
CONFIG_PICOLIBC=y
CONFIG_STD_CPP23=y
CONFIG_REQUIRES_FULL_LIBCPP=y
CONFIG_CPP_EXCEPTIONS=y
CONFIG_CPP_RTTI=y

# Memory
CONFIG_HEAP_MEM_POOL_SIZE=100000

# C++ exception unwinding needs considerably more stack than the ztest defaults.
CONFIG_MAIN_STACK_SIZE=8192
CONFIG_ZTEST_STACK_SIZE=8192

# Logging And Debugging
CONFIG_LOG=y
CONFIG_THREAD_NAME=y
```

## src/boot_dependencies.cpp
```c
#include <cerrno>

#include <zephyr/ztest.h>

#include "subsys/dfu/mcuboot_boot_control.h"
#include "subsys/dfu/zephyr_watchdog.h"

using eerie_leap::subsys::dfu::McubootBootControl;
using eerie_leap::subsys::dfu::ZephyrWatchdog;

// native_sim has neither an MCUboot image manager in this suite nor a watchdog0 alias: these cases pin down
// what the Zephyr implementations do then, which is what lets a build with EERIE_LEAP_DFU compile there.

ZTEST_SUITE(dfu_boot_dependencies, NULL, NULL, NULL, NULL, NULL);

ZTEST(dfu_boot_dependencies, test_boot_control_without_an_image_manager_is_confirmed_and_cannot_confirm) {
#ifdef CONFIG_MCUBOOT_IMG_MANAGER
    ztest_test_skip();
#else
    McubootBootControl boot_control;

    zassert_true(boot_control.IsConfirmed());
    zassert_equal(boot_control.Confirm(), -ENOTSUP);
#endif
}

ZTEST(dfu_boot_dependencies, test_watchdog_without_the_alias_is_unsupported) {
    if(ZephyrWatchdog::IsSupported())
        ztest_test_skip();

    ZephyrWatchdog watchdog;

    zassert_equal(watchdog.Install(8000), -ENOTSUP);
    zassert_equal(watchdog.Start(), -ENOTSUP);
    zassert_equal(watchdog.Feed(), -ENOTSUP);
    zassert_equal(watchdog.Disable(), -ENOTSUP);
}
```

## src/dfu_fakes.h
```c
#pragma once

#include <cstdint>

#include "subsys/dfu/i_boot_control.h"
#include "subsys/dfu/i_probe.h"
#include "subsys/dfu/i_watchdog.h"

namespace dfu_fakes {

using eerie_leap::subsys::dfu::IBootControl;
using eerie_leap::subsys::dfu::IProbe;
using eerie_leap::subsys::dfu::IWatchdog;

class FakeBootControl final : public IBootControl {
public:
    bool confirmed = false;
    int confirm_result = 0;
    mutable int is_confirmed_calls = 0;
    int confirm_calls = 0;

    [[nodiscard]] bool IsConfirmed() const override {
        ++is_confirmed_calls;
        return confirmed;
    }

    [[nodiscard]] int Confirm() override {
        ++confirm_calls;
        if(confirm_result == 0)
            confirmed = true;

        return confirm_result;
    }
};

class FakeWatchdog final : public IWatchdog {
public:
    int install_result = 0;
    int start_result = 0;
    int feed_result = 0;
    int disable_result = 0;

    int install_calls = 0;
    int start_calls = 0;
    int feed_calls = 0;
    int disable_calls = 0;
    uint32_t installed_timeout_ms = 0;
    /// Started and not disabled: the unit would reset without a feed.
    bool is_running = false;

    [[nodiscard]] int Install(uint32_t timeout_ms) override {
        ++install_calls;
        installed_timeout_ms = timeout_ms;
        return install_result;
    }

    [[nodiscard]] int Start() override {
        ++start_calls;
        if(start_result == 0)
            is_running = true;

        return start_result;
    }

    [[nodiscard]] int Feed() override {
        ++feed_calls;
        return feed_result;
    }

    [[nodiscard]] int Disable() override {
        ++disable_calls;
        if(disable_result == 0)
            is_running = false;

        return disable_result;
    }
};

/// Runs only when the test says so: Arm() leaves it pending and Run() is the work queue getting to it.
class FakeProbe final : public IProbe {
private:
    const char* name_;

public:
    bool ran = false;
    bool is_pending = false;
    /// A stuck probe never runs, like a work queue that is blocked.
    bool is_stuck = false;
    int arm_calls = 0;

    explicit FakeProbe(const char* name) :
        name_(name) {}

    void Arm() override {
        ++arm_calls;
        ran = false;
        is_pending = true;
    }

    [[nodiscard]] bool Check() const override {
        return ran;
    }

    [[nodiscard]] const char* GetName() const override {
        return name_;
    }

    void Run() {
        if(!is_pending || is_stuck)
            return;

        is_pending = false;
        ran = true;
    }
};

} // namespace dfu_fakes
```

## src/image_confirmation.cpp
```c
#include <cerrno>
#include <cstdint>
#include <memory>

#include <zephyr/ztest.h>

#include "subsys/dfu/image_confirmation.h"

#include "dfu_fakes.h"

using eerie_leap::subsys::dfu::DfuState;
using eerie_leap::subsys::dfu::ImageConfirmation;
using eerie_leap::subsys::dfu::ImageConfirmationConfig;

using dfu_fakes::FakeBootControl;
using dfu_fakes::FakeProbe;
using dfu_fakes::FakeWatchdog;

namespace {

constexpr int64_t TICK_MS = 2000; // The default watchdog timeout (8000 ms) over four.
constexpr int64_t BOOT_DEADLINE_MS = 60000;
constexpr int64_t CONFIRM_DELAY_MS = 20000;

/** The machine under test with fakes for everything around it and a clock the test moves by hand. */
struct Harness {
    FakeBootControl boot;
    FakeWatchdog watchdog;
    FakeProbe probe_a{ "a" };
    FakeProbe probe_b{ "b" };
    int64_t now_ms = 5000;
    ImageConfirmationConfig config{
        .self_confirm = true,
        .boot_deadline_ms = BOOT_DEADLINE_MS,
        .confirm_delay_ms = CONFIRM_DELAY_MS,
        .watchdog_timeout_ms = 8000,
    };
    std::unique_ptr<ImageConfirmation> machine;

    Harness() = default;
    Harness(const Harness&) = delete;
    Harness& operator=(const Harness&) = delete;
    Harness(Harness&&) = delete;
    Harness& operator=(Harness&&) = delete;
    ~Harness() = default;

    ImageConfirmation& Create(bool with_watchdog = true) {
        machine = std::make_unique<ImageConfirmation>(
            boot, with_watchdog ? &watchdog : nullptr,
            [this] {
                return now_ms;
            },
            config
        );

        return *machine;
    }

    /** Lets time pass, the armed probes run (the stuck ones do not) and the machine tick. */
    void Step(int64_t ms = TICK_MS) {
        now_ms += ms;
        probe_a.Run();
        probe_b.Run();
        machine->Tick();
    }

    void StepTicks(int count) {
        for(int i = 0; i < count; ++i)
            Step();
    }

    /** An unconfirmed image with both probes registered and one healthy tick behind it. */
    ImageConfirmation& StartVerifying() {
        ImageConfirmation& m = Create();
        m.AddProbe(probe_a);
        m.AddProbe(probe_b);
        zassert_equal(m.Initialize(), 0);
        Step();

        return m;
    }

    /** StartVerifying() and the boot reported complete right after a healthy tick. */
    ImageConfirmation& StartConfirming() {
        ImageConfirmation& m = StartVerifying();
        m.ReportBootComplete();

        return m;
    }
};

void AssertState(const ImageConfirmation& machine, DfuState expected) {
    zassert_equal(static_cast<uint32_t>(machine.GetState()), static_cast<uint32_t>(expected));
}

} // namespace

ZTEST_SUITE(image_confirmation, NULL, NULL, NULL, NULL, NULL);

ZTEST(image_confirmation, test_confirmed_image_arms_nothing) {
    Harness h;
    h.boot.confirmed = true;
    ImageConfirmation& m = h.Create();
    m.AddProbe(h.probe_a);

    zassert_equal(m.Initialize(), 0);
    m.ReportBootComplete();
    h.StepTicks(3);

    AssertState(m, DfuState::CONFIRMED);
    zassert_true(m.IsConfirmed());
    zassert_false(m.NeedsTick());
    zassert_false(m.GetConfirmInMs().has_value());
    zassert_equal(h.boot.is_confirmed_calls, 1, "Initialize reads the confirmation once, and nothing else does");
    zassert_equal(h.boot.confirm_calls, 0);
    zassert_equal(h.watchdog.install_calls, 0);
    zassert_equal(h.watchdog.start_calls, 0);
    zassert_equal(h.watchdog.feed_calls, 0);
    zassert_equal(h.watchdog.disable_calls, 0);
    zassert_equal(h.probe_a.arm_calls, 0);
}

ZTEST(image_confirmation, test_unconfirmed_image_arms_the_watchdog_and_waits_for_boot_complete) {
    Harness h;
    ImageConfirmation& m = h.Create();

    zassert_equal(m.Initialize(), 0);

    AssertState(m, DfuState::VERIFYING);
    zassert_false(m.IsConfirmed());
    zassert_true(m.NeedsTick());
    zassert_false(m.GetConfirmInMs().has_value());
    zassert_equal(h.watchdog.install_calls, 1);
    zassert_equal(h.watchdog.installed_timeout_ms, 8000U);
    zassert_equal(h.watchdog.start_calls, 1);
    zassert_true(h.watchdog.is_running);
    zassert_equal(h.watchdog.feed_calls, 0);
    zassert_equal(h.boot.confirm_calls, 0);
    zassert_equal(m.GetTickIntervalMs(), static_cast<uint32_t>(TICK_MS));
}

ZTEST(image_confirmation, test_unconfirmed_image_confirms_after_boot_complete_plus_delay_then_disables_the_watchdog) {
    Harness h;
    ImageConfirmation& m = h.StartVerifying();
    h.Step();
    zassert_equal(h.watchdog.feed_calls, 2);

    m.ReportBootComplete();
    AssertState(m, DfuState::CONFIRMING);
    zassert_true(m.NeedsTick());

    // 18 s after boot complete: still healthy, still fed, not yet confirmed.
    h.StepTicks(9);
    AssertState(m, DfuState::CONFIRMING);
    zassert_equal(h.boot.confirm_calls, 0);
    zassert_equal(h.watchdog.feed_calls, 2 + 9);
    zassert_true(h.watchdog.is_running);

    // 20 s: the delay has passed.
    h.Step();
    AssertState(m, DfuState::CONFIRMED);
    zassert_true(m.IsConfirmed());
    zassert_equal(h.boot.confirm_calls, 1);
    zassert_equal(h.watchdog.disable_calls, 1);
    zassert_false(h.watchdog.is_running);
    zassert_false(m.NeedsTick());
    zassert_false(m.GetConfirmInMs().has_value());

    // Nothing is left to do.
    const int feeds = h.watchdog.feed_calls;
    h.StepTicks(3);
    zassert_equal(h.watchdog.feed_calls, feeds);
    zassert_equal(h.watchdog.disable_calls, 1);
    zassert_equal(h.boot.confirm_calls, 1);
}

ZTEST(image_confirmation, test_probes_are_not_posted_while_verifying) {
    Harness h;
    ImageConfirmation& m = h.StartVerifying();

    h.StepTicks(4);

    AssertState(m, DfuState::VERIFYING);
    zassert_equal(h.probe_a.arm_calls, 0);
    zassert_equal(h.probe_b.arm_calls, 0);
    zassert_equal(h.watchdog.feed_calls, 5);
}

ZTEST(image_confirmation, test_probes_are_posted_every_tick_once_the_boot_is_complete) {
    Harness h;
    ImageConfirmation& m = h.StartConfirming();
    zassert_equal(h.probe_a.arm_calls, 0, "Boot complete alone posts nothing; the next tick does");

    h.Step();
    zassert_equal(h.probe_a.arm_calls, 1);
    zassert_equal(h.probe_b.arm_calls, 1);

    h.StepTicks(4);

    AssertState(m, DfuState::CONFIRMING);
    zassert_equal(h.probe_a.arm_calls, 5);
    zassert_equal(h.probe_b.arm_calls, 5);
    zassert_equal(h.watchdog.feed_calls, 6);
}

ZTEST(image_confirmation, test_stuck_probe_does_not_fail_a_verifying_image) {
    Harness h;
    ImageConfirmation& m = h.StartVerifying();

    // The init code of a booting unit can keep the work queues from running for a long time.
    h.probe_a.is_stuck = true;
    h.probe_b.is_stuck = true;
    h.StepTicks(20);

    AssertState(m, DfuState::VERIFYING);
    zassert_equal(h.watchdog.feed_calls, 21, "The boot deadline decides, not the probes");
    zassert_true(m.NeedsTick());
}

ZTEST(image_confirmation, test_probes_starved_during_the_boot_get_their_time_after_boot_complete) {
    Harness h;
    ImageConfirmation& m = h.StartVerifying();
    h.probe_a.is_stuck = true;
    h.StepTicks(10);

    // The unit is up and the queues run again.
    h.probe_a.is_stuck = false;
    m.ReportBootComplete();
    h.StepTicks(3);

    AssertState(m, DfuState::CONFIRMING);
    zassert_equal(h.watchdog.feed_calls, 1 + 10 + 3);
}

ZTEST(image_confirmation, test_stuck_probe_fails_a_confirming_image) {
    Harness h;
    ImageConfirmation& m = h.StartConfirming();
    h.StepTicks(4);
    AssertState(m, DfuState::CONFIRMING);

    // Waiting for less than half the watchdog timeout (4 s) is allowed, and the unit is fed meanwhile.
    h.probe_a.is_stuck = true;
    h.Step();
    AssertState(m, DfuState::CONFIRMING);
    const int feeds = h.watchdog.feed_calls;

    // 4 s: the probe has waited half the timeout.
    h.Step();
    AssertState(m, DfuState::FAILED);
    zassert_equal(h.watchdog.feed_calls, feeds, "The tick that finds a stuck probe does not feed");
    zassert_true(h.watchdog.is_running, "The watchdog is left to reset the unit");

    h.probe_a.is_stuck = false;
    h.StepTicks(20);
    AssertState(m, DfuState::FAILED);
    zassert_equal(h.watchdog.feed_calls, feeds);
    zassert_equal(h.boot.confirm_calls, 0, "An unhealthy image is never confirmed");
    zassert_equal(h.watchdog.disable_calls, 0);
    zassert_false(m.GetConfirmInMs().has_value());
}

ZTEST(image_confirmation, test_the_image_is_not_confirmed_while_a_probe_is_outstanding) {
    Harness h;
    ImageConfirmation& m = h.StartConfirming();

    // 18 s after boot complete, healthy: every probe was posted again by this tick.
    h.StepTicks(9);
    AssertState(m, DfuState::CONFIRMING);
    zassert_equal(h.boot.confirm_calls, 0);

    // The queue gets stuck just before the delay expires (20 s): the probe posted at 18 s is outstanding.
    h.probe_a.is_stuck = true;
    h.Step();
    AssertState(m, DfuState::CONFIRMING);
    zassert_equal(h.boot.confirm_calls, 0, "The delay has passed, but a probe has not run since it was posted");
    zassert_true(h.watchdog.is_running);
    zassert_equal(m.GetConfirmInMs().value_or(1U), 0U);

    // Half the watchdog timeout (4 s) after it was posted, the probe fails the image instead.
    h.Step();
    AssertState(m, DfuState::FAILED);
    zassert_equal(h.boot.confirm_calls, 0);

    h.probe_a.is_stuck = false;
    h.StepTicks(5);
    AssertState(m, DfuState::FAILED);
    zassert_equal(h.boot.confirm_calls, 0);
}

ZTEST(image_confirmation, test_the_confirmation_follows_a_probe_that_runs_late) {
    Harness h;
    ImageConfirmation& m = h.StartConfirming();
    h.StepTicks(9);

    h.probe_a.is_stuck = true;
    h.Step();
    AssertState(m, DfuState::CONFIRMING);
    zassert_equal(h.boot.confirm_calls, 0);

    // The queue gets to the probe before its time is up: the next tick confirms.
    h.probe_a.is_stuck = false;
    h.Step();
    AssertState(m, DfuState::CONFIRMED);
    zassert_equal(h.boot.confirm_calls, 1);
}

ZTEST(image_confirmation, test_a_probe_posted_this_tick_has_not_run_yet) {
    Harness h;
    h.config.confirm_delay_ms = 0;
    ImageConfirmation& m = h.StartConfirming();

    // The delay is over at once, but the first tick after boot complete only posts the probes.
    h.Step();
    AssertState(m, DfuState::CONFIRMING);
    zassert_equal(h.boot.confirm_calls, 0);

    h.Step();
    AssertState(m, DfuState::CONFIRMED);
    zassert_equal(h.boot.confirm_calls, 1);
}

ZTEST(image_confirmation, test_a_probe_that_runs_late_keeps_the_image_healthy) {
    Harness h;
    ImageConfirmation& m = h.StartConfirming();
    h.StepTicks(4);

    // The queue is busy for one tick, then gets to the probe: it ran after 4 s, which is late but ran.
    h.probe_b.is_stuck = true;
    h.Step();
    h.probe_b.is_stuck = false;
    h.Step();
    AssertState(m, DfuState::CONFIRMING);
    const int feeds = h.watchdog.feed_calls;

    h.StepTicks(3);
    AssertState(m, DfuState::CONFIRMING);
    zassert_equal(h.watchdog.feed_calls, feeds + 3);
}

ZTEST(image_confirmation, test_a_new_probe_gets_its_time_to_run) {
    Harness h;
    ImageConfirmation& m = h.StartConfirming();
    h.StepTicks(2);

    FakeProbe late("late");
    late.is_stuck = true;
    m.AddProbe(late);
    zassert_equal(late.arm_calls, 0, "AddProbe does not post the probe");

    // The first tick after AddProbe posts it, and does not judge it yet.
    h.Step();
    AssertState(m, DfuState::CONFIRMING);
    zassert_equal(late.arm_calls, 1);

    // Within its time.
    h.Step();
    AssertState(m, DfuState::CONFIRMING);

    // Half the watchdog timeout after it was posted, it did not run.
    h.Step();
    AssertState(m, DfuState::FAILED);
}

ZTEST(image_confirmation, test_client_confirm_stands_down_a_failed_image) {
    Harness h;
    ImageConfirmation& m = h.StartConfirming();
    h.StepTicks(2);
    h.probe_a.is_stuck = true;
    h.StepTicks(2);
    AssertState(m, DfuState::FAILED);
    zassert_true(m.NeedsTick(), "The watchdog still runs, so a client's confirm can still save the image");

    h.boot.confirmed = true;
    h.Step();

    AssertState(m, DfuState::CONFIRMED);
    zassert_equal(h.boot.confirm_calls, 0);
    zassert_equal(h.watchdog.disable_calls, 1);
    zassert_false(h.watchdog.is_running);
    zassert_false(m.NeedsTick());
}

ZTEST(image_confirmation, test_client_confirm_stands_down_an_image_that_missed_its_deadline) {
    Harness h;
    ImageConfirmation& m = h.StartVerifying();
    h.StepTicks(30);
    AssertState(m, DfuState::FAILED);

    h.boot.confirmed = true;
    h.Step();

    AssertState(m, DfuState::CONFIRMED);
    zassert_false(h.watchdog.is_running);
}

ZTEST(image_confirmation, test_a_failed_image_without_a_watchdog_needs_no_tick) {
    Harness h;
    ImageConfirmation& m = h.Create(false);
    zassert_equal(m.Initialize(), 0);

    h.StepTicks(30);

    AssertState(m, DfuState::FAILED);
    zassert_false(m.NeedsTick());
}

ZTEST(image_confirmation, test_missed_boot_deadline_stops_feeding) {
    Harness h;
    ImageConfirmation& m = h.StartVerifying();

    // 58 s after Initialize: still inside the deadline.
    h.StepTicks(28);
    AssertState(m, DfuState::VERIFYING);
    zassert_equal(h.watchdog.feed_calls, 29);

    // 60 s: the deadline.
    h.Step();
    AssertState(m, DfuState::FAILED);
    zassert_equal(h.watchdog.feed_calls, 29);

    h.StepTicks(5);
    AssertState(m, DfuState::FAILED);
    zassert_equal(h.watchdog.feed_calls, 29);
    zassert_equal(h.boot.confirm_calls, 0);
}

ZTEST(image_confirmation, test_boot_complete_after_the_deadline_fails_the_image) {
    Harness h;
    ImageConfirmation& m = h.StartVerifying();

    h.now_ms += BOOT_DEADLINE_MS - TICK_MS;
    m.ReportBootComplete();

    AssertState(m, DfuState::FAILED);
    zassert_false(m.GetConfirmInMs().has_value());

    h.StepTicks(3);
    AssertState(m, DfuState::FAILED);
    zassert_equal(h.watchdog.feed_calls, 1);
    zassert_equal(h.boot.confirm_calls, 0);
}

ZTEST(image_confirmation, test_boot_complete_just_inside_the_deadline_is_accepted) {
    Harness h;
    ImageConfirmation& m = h.StartVerifying();

    h.now_ms += BOOT_DEADLINE_MS - TICK_MS - 1;
    m.ReportBootComplete();

    AssertState(m, DfuState::CONFIRMING);
}

ZTEST(image_confirmation, test_client_confirm_stands_down_a_verifying_image) {
    Harness h;
    ImageConfirmation& m = h.StartVerifying();

    h.boot.confirmed = true;
    h.Step();

    AssertState(m, DfuState::CONFIRMED);
    zassert_equal(h.boot.confirm_calls, 0, "The machine does not write a confirmation that is already there");
    zassert_equal(h.watchdog.disable_calls, 1);
    zassert_false(h.watchdog.is_running);
    zassert_false(m.NeedsTick());

    const int feeds = h.watchdog.feed_calls;
    h.StepTicks(3);
    zassert_equal(h.watchdog.feed_calls, feeds);
    zassert_equal(h.watchdog.disable_calls, 1);
}

ZTEST(image_confirmation, test_client_confirm_stands_down_a_confirming_image) {
    Harness h;
    ImageConfirmation& m = h.StartConfirming();
    h.StepTicks(3);

    h.boot.confirmed = true;
    h.Step();

    AssertState(m, DfuState::CONFIRMED);
    zassert_equal(h.boot.confirm_calls, 0);
    zassert_equal(h.watchdog.disable_calls, 1);
    zassert_false(m.GetConfirmInMs().has_value());

    h.StepTicks(15);
    zassert_equal(h.boot.confirm_calls, 0);
    zassert_equal(h.watchdog.disable_calls, 1);
}

ZTEST(image_confirmation, test_failed_confirm_write_is_retried) {
    Harness h;
    ImageConfirmation& m = h.StartConfirming();
    h.boot.confirm_result = -EIO;

    h.StepTicks(10);

    AssertState(m, DfuState::CONFIRMING);
    zassert_equal(h.boot.confirm_calls, 1);
    zassert_true(h.watchdog.is_running);
    zassert_equal(h.watchdog.disable_calls, 0);
    zassert_true(m.NeedsTick());
    zassert_equal(m.GetConfirmInMs().value_or(1U), 0U);

    // Still fed and retried on every tick.
    const int feeds = h.watchdog.feed_calls;
    h.Step();
    zassert_equal(h.boot.confirm_calls, 2);
    zassert_equal(h.watchdog.feed_calls, feeds + 1);
    AssertState(m, DfuState::CONFIRMING);

    h.boot.confirm_result = 0;
    h.Step();
    zassert_equal(h.boot.confirm_calls, 3);
    AssertState(m, DfuState::CONFIRMED);
    zassert_equal(h.watchdog.disable_calls, 1);
}

ZTEST(image_confirmation, test_without_self_confirm_the_image_never_confirms_but_keeps_feeding) {
    Harness h;
    h.config.self_confirm = false;
    ImageConfirmation& m = h.StartConfirming();
    const int feeds = h.watchdog.feed_calls;

    h.StepTicks(30);

    AssertState(m, DfuState::CONFIRMING);
    zassert_equal(h.boot.confirm_calls, 0);
    zassert_equal(h.watchdog.feed_calls, feeds + 30);
    zassert_true(h.watchdog.is_running);
    zassert_false(m.GetConfirmInMs().has_value(), "There is no self-confirmation to count down to");

    // A client's confirm still ends it.
    h.boot.confirmed = true;
    h.Step();
    AssertState(m, DfuState::CONFIRMED);
    zassert_equal(h.watchdog.disable_calls, 1);
}

ZTEST(image_confirmation, test_confirm_in_ms_counts_down) {
    Harness h;
    ImageConfirmation& m = h.StartVerifying();
    zassert_false(m.GetConfirmInMs().has_value(), "Not before boot complete");

    m.ReportBootComplete();
    zassert_equal(m.GetConfirmInMs().value_or(0U), 20000U);

    h.now_ms += 2500;
    zassert_equal(m.GetConfirmInMs().value_or(0U), 17500U);

    h.now_ms += 17500;
    zassert_equal(m.GetConfirmInMs().value_or(1U), 0U);

    h.now_ms += 5000;
    zassert_equal(m.GetConfirmInMs().value_or(1U), 0U, "It stops at 0");
}

ZTEST(image_confirmation, test_repeated_boot_complete_does_not_restart_the_delay) {
    Harness h;
    ImageConfirmation& m = h.StartConfirming();

    h.now_ms += 5000;
    m.ReportBootComplete();

    zassert_equal(m.GetConfirmInMs().value_or(0U), 15000U);
    AssertState(m, DfuState::CONFIRMING);
}

ZTEST(image_confirmation, test_a_board_without_a_watchdog_still_confirms) {
    Harness h;
    ImageConfirmation& m = h.Create(false);
    m.AddProbe(h.probe_a);

    zassert_equal(m.Initialize(), 0);
    AssertState(m, DfuState::VERIFYING);
    h.Step();
    m.ReportBootComplete();
    h.StepTicks(10);

    AssertState(m, DfuState::CONFIRMED);
    zassert_equal(h.boot.confirm_calls, 1);
    zassert_equal(h.watchdog.install_calls, 0);
    zassert_equal(h.watchdog.feed_calls, 0);
    zassert_equal(h.watchdog.disable_calls, 0);
}

ZTEST(image_confirmation, test_watchdog_install_failure_is_reported_and_the_machine_still_runs) {
    Harness h;
    h.watchdog.install_result = -EIO;
    ImageConfirmation& m = h.Create();

    zassert_equal(m.Initialize(), -EIO);
    AssertState(m, DfuState::VERIFYING);
    zassert_equal(h.watchdog.start_calls, 0);

    m.ReportBootComplete();
    h.StepTicks(10);

    AssertState(m, DfuState::CONFIRMED);
    zassert_equal(h.watchdog.feed_calls, 0);
    zassert_equal(h.watchdog.disable_calls, 0, "A watchdog that never ran is not disabled");
}

ZTEST(image_confirmation, test_watchdog_start_failure_is_reported_and_the_machine_still_runs) {
    Harness h;
    h.watchdog.start_result = -EIO;
    ImageConfirmation& m = h.Create();

    zassert_equal(m.Initialize(), -EIO);
    AssertState(m, DfuState::VERIFYING);

    m.ReportBootComplete();
    h.StepTicks(10);

    AssertState(m, DfuState::CONFIRMED);
    zassert_equal(h.watchdog.feed_calls, 0);
    zassert_equal(h.watchdog.disable_calls, 0);
}

ZTEST(image_confirmation, test_failed_watchdog_disable_is_retried_while_it_is_fed) {
    Harness h;
    ImageConfirmation& m = h.StartConfirming();
    h.boot.confirmed = true;
    h.watchdog.disable_result = -EIO;

    h.Step();

    AssertState(m, DfuState::CONFIRMED);
    zassert_equal(h.watchdog.disable_calls, 1);
    zassert_true(h.watchdog.is_running);
    zassert_true(m.NeedsTick(), "The watchdog must not be left to reset a confirmed image");

    const int feeds = h.watchdog.feed_calls;
    h.Step();
    zassert_equal(h.watchdog.disable_calls, 2);
    zassert_true(h.watchdog.feed_calls > feeds);

    h.watchdog.disable_result = 0;
    h.Step();
    zassert_equal(h.watchdog.disable_calls, 3);
    zassert_false(h.watchdog.is_running);
    zassert_false(m.NeedsTick());
}

ZTEST(image_confirmation, test_tick_interval_is_a_quarter_of_the_watchdog_timeout) {
    Harness h;

    h.config.watchdog_timeout_ms = 8000;
    zassert_equal(h.Create().GetTickIntervalMs(), 2000U);

    h.config.watchdog_timeout_ms = 3;
    zassert_equal(h.Create().GetTickIntervalMs(), 1U);

    h.config.watchdog_timeout_ms = 0;
    zassert_equal(h.Create().GetTickIntervalMs(), 1U);
}

ZTEST(image_confirmation, test_a_clock_that_wraps_in_the_middle_of_the_flow_is_handled) {
    Harness h;
    // Initialize and the boot deadline sit before the wrap, the confirmation after it.
    h.now_ms = 0x100000000LL - 12000;
    ImageConfirmation& m = h.StartVerifying();
    m.ReportBootComplete();
    zassert_equal(m.GetConfirmInMs().value_or(0U), 20000U);

    h.StepTicks(9);
    AssertState(m, DfuState::CONFIRMING);
    zassert_true(h.now_ms > 0x100000000LL);
    zassert_equal(m.GetConfirmInMs().value_or(0U), 2000U);

    h.Step();
    AssertState(m, DfuState::CONFIRMED);
    zassert_equal(h.boot.confirm_calls, 1);
}
```

## src/work_queue_probe.cpp
```c
#include <cstring>

#include <zephyr/kernel.h>
#include <zephyr/ztest.h>

#include "subsys/dfu/work_queue_probe.h"

using eerie_leap::subsys::dfu::WorkQueueProbe;

namespace {

constexpr size_t QUEUE_STACK_SIZE = 2048;
constexpr int QUEUE_PRIORITY = K_PRIO_PREEMPT(8);
constexpr int WAIT_MS = 1000;

K_THREAD_STACK_DEFINE(queue_stack, QUEUE_STACK_SIZE);
k_work_q queue;

/** A work item that keeps the queue's thread busy until the test releases it. */
struct Blocker {
    k_work work;
    k_sem entered;
    k_sem release;
};

Blocker blocker;

void BlockerHandler(k_work*) {
    k_sem_give(&blocker.entered);
    k_sem_take(&blocker.release, K_FOREVER);
}

bool WaitUntilRan(const WorkQueueProbe& probe) {
    for(int i = 0; i < WAIT_MS; ++i) {
        if(probe.Check())
            return true;

        k_msleep(1);
    }

    return false;
}

void* SetupQueue() {
    k_work_queue_init(&queue);
    k_work_queue_start(&queue, queue_stack, K_THREAD_STACK_SIZEOF(queue_stack), QUEUE_PRIORITY, nullptr);

    return nullptr;
}

void TeardownQueue(void*) {
    // Every test has released its blocker, so the queue drains and stops.
    zassert_true(k_work_queue_drain(&queue, true) >= 0);
    zassert_equal(k_work_queue_stop(&queue, K_MSEC(WAIT_MS)), 0);
}

void ResetBlocker(void*) {
    k_work_init(&blocker.work, BlockerHandler);
    k_sem_init(&blocker.entered, 0, 1);
    k_sem_init(&blocker.release, 0, 1);
}

} // namespace

ZTEST_SUITE(work_queue_probe, NULL, SetupQueue, ResetBlocker, NULL, TeardownQueue);

ZTEST(work_queue_probe, test_probe_runs_on_its_work_queue) {
    WorkQueueProbe probe("test_queue", &queue);

    zassert_false(probe.Check(), "A probe that was never armed has not run");
    zassert_equal(strcmp(probe.GetName(), "test_queue"), 0);

    probe.Arm();
    zassert_true(WaitUntilRan(probe));

    // Each Arm() starts over.
    probe.Arm();
    zassert_true(WaitUntilRan(probe));
}

ZTEST(work_queue_probe, test_probe_does_not_run_while_the_queue_is_stuck) {
    WorkQueueProbe probe("test_queue", &queue);

    k_work_submit_to_queue(&queue, &blocker.work);
    zassert_equal(k_sem_take(&blocker.entered, K_MSEC(WAIT_MS)), 0, "The queue never got to the blocker");

    probe.Arm();
    k_msleep(50);
    zassert_false(probe.Check(), "A blocked queue cannot run the probe");

    // Arming again while the first request is still queued does not queue a second one.
    probe.Arm();
    k_msleep(10);
    zassert_false(probe.Check());

    k_sem_give(&blocker.release);
    zassert_true(WaitUntilRan(probe), "The probe runs once the queue is free again");
}

ZTEST(work_queue_probe, test_destroying_a_queued_probe_cancels_its_work) {
    k_work_submit_to_queue(&queue, &blocker.work);
    zassert_equal(k_sem_take(&blocker.entered, K_MSEC(WAIT_MS)), 0);

    {
        WorkQueueProbe probe("test_queue", &queue);
        probe.Arm();
    }

    // The queue must not touch the destroyed probe.
    k_sem_give(&blocker.release);
    zassert_true(k_work_queue_drain(&queue, false) >= 0);
}
```
