## CMakeLists.txt
```
cmake_minimum_required(VERSION 3.20.0)

include(${CMAKE_CURRENT_SOURCE_DIR}/../../../rt_core_test.cmake)

find_package(Zephyr REQUIRED HINTS $ENV{ZEPHYR_BASE})
project(unit_subsys_canbus)

file(GLOB_RECURSE TEST_SOURCES src/*.c src/*.cpp)

target_sources(app PRIVATE ${TEST_SOURCES})
```

## prj.conf
```kconfig
CONFIG_ZTEST=y

# Language and Compiler
CONFIG_CPP=y
CONFIG_PICOLIBC=y
CONFIG_STD_CPP23=y
CONFIG_REQUIRES_FULL_LIBCPP=y
CONFIG_CPP_EXCEPTIONS=y
CONFIG_CPP_RTTI=y

# Memory
CONFIG_HEAP_MEM_POOL_SIZE=100000

# C++ exception unwinding needs considerably more stack than the ztest defaults.
CONFIG_MAIN_STACK_SIZE=8192
CONFIG_ZTEST_STACK_SIZE=8192

# Logging And Debugging
CONFIG_LOG=y
CONFIG_TEST_RANDOM_GENERATOR=y
CONFIG_THREAD_NAME=y

# ThreadBase::InitializeStack() falls back to k_thread_stack_alloc().
CONFIG_THREAD_STACK_INFO=y
CONFIG_DYNAMIC_THREAD=y
CONFIG_DYNAMIC_THREAD_ALLOC=y

# CANBus. The controller is never started here, but Canbus needs a real device.
CONFIG_CAN=y
CONFIG_CAN_FD_MODE=y
CONFIG_CAN_LOOPBACK=y

# The 512 byte default overflows on the 64-bit QEMU targets.
CONFIG_CAN_LOOPBACK_TX_THREAD_STACK_SIZE=2048

CONFIG_EERIE_LEAP_RT_CORE=y
CONFIG_EERIE_LEAP_THREADING=y
CONFIG_EERIE_LEAP_CANBUS=y
```

## src/can_frame.cpp
```c
#include <cstdint>

#include <zephyr/ztest.h>

#include "subsys/canbus/can_frame.h"

using eerie_leap::subsys::canbus::CanFrame;

ZTEST_SUITE(can_frame, NULL, NULL, NULL, NULL, NULL);

ZTEST(can_frame, test_default_fields_are_zeroed) {
    CanFrame frame;

    zassert_equal(frame.id, 0);
    zassert_false(frame.is_extended);
    zassert_false(frame.is_transmit);
    zassert_false(frame.is_can_fd);
    zassert_false(frame.is_bitrate_switch);
    zassert_false(frame.is_remote_request);
    zassert_false(frame.is_error_state_indicator);
    zassert_true(frame.data.empty());
    zassert_equal(frame.dlc, 0);
    zassert_equal(frame.time_us, 0);
}

ZTEST(can_frame, test_receive_fields_follow_the_flags_in_designated_initialization) {
    CanFrame frame{ .id = 0x123,
        .is_remote_request = true,
        .is_error_state_indicator = true,
        .data = {},
        .dlc = 8,
        .time_us = 5'000'000'000ULL };

    zassert_true(frame.is_remote_request);
    zassert_true(frame.is_error_state_indicator);
    zassert_true(frame.data.empty(), "A remote frame has a DLC but no payload");
    zassert_equal(frame.dlc, 8);
    zassert_equal(frame.time_us, 5'000'000'000ULL);
}

ZTEST(can_frame, test_designated_initialization) {
    CanFrame frame{ .id = 0x18FF1234, .is_extended = true, .is_can_fd = true, .data = { 0x11, 0x22, 0x33 } };

    zassert_equal(frame.id, 0x18FF1234);
    zassert_true(frame.is_extended);
    zassert_true(frame.is_can_fd);
    zassert_false(frame.is_bitrate_switch);
    zassert_equal(frame.data.size(), 3);
    zassert_equal(frame.data[2], 0x33);
}

ZTEST(can_frame, test_copy_is_independent) {
    CanFrame original{ .id = 0x321, .data = { 1, 2, 3 } };

    CanFrame copy = original;
    copy.data[0] = 0xFF;

    zassert_equal(original.data[0], 1);
    zassert_equal(copy.data[0], 0xFF);
}
```

## src/can_frame_payload.cpp
```c
#include <array>
#include <cstdint>
#include <span>
#include <vector>

#include <zephyr/ztest.h>

#include "subsys/canbus/can_frame_payload.h"

using eerie_leap::subsys::canbus::CAN_FRAME_MAX_DATA_LENGTH;
using eerie_leap::subsys::canbus::CanFramePayload;

ZTEST_SUITE(can_frame_payload, NULL, NULL, NULL, NULL, NULL);

ZTEST(can_frame_payload, test_default_payload_is_empty) {
    CanFramePayload payload;

    zassert_equal(payload.size(), 0);
    zassert_true(payload.empty());
    zassert_equal(payload.capacity(), CAN_FRAME_MAX_DATA_LENGTH);
}

ZTEST(can_frame_payload, test_initializer_list_construction) {
    CanFramePayload payload({ 0x11, 0x22, 0x33 });

    zassert_equal(payload.size(), 3);
    zassert_equal(payload[0], 0x11);
    zassert_equal(payload[2], 0x33);
}

ZTEST(can_frame_payload, test_vector_construction) {
    const std::vector<uint8_t> bytes(8, 0x5A);
    CanFramePayload payload(bytes);

    zassert_equal(payload.size(), 8);
    for(const auto byte : payload)
        zassert_equal(byte, 0x5A);
}

ZTEST(can_frame_payload, test_array_construction) {
    const std::array<uint8_t, 4> bytes = { 1, 2, 3, 4 };
    CanFramePayload payload(bytes);

    zassert_equal(payload.size(), 4);
    zassert_equal(payload[3], 4);
}

ZTEST(can_frame_payload, test_assign_replaces_content) {
    CanFramePayload payload({ 1, 2, 3, 4, 5, 6, 7, 8 });

    std::array<uint8_t, 2> shorter = { 0xAA, 0xBB };
    payload.Assign(shorter);

    zassert_equal(payload.size(), 2);
    zassert_equal(payload[0], 0xAA);
    zassert_equal(payload[1], 0xBB);
    // Stale bytes from the previous, longer content must not leak through.
    zassert_equal(payload.data()[2], 0);
    zassert_equal(payload.data()[7], 0);
}

ZTEST(can_frame_payload, test_oversized_input_is_truncated_not_overflowing) {
    const std::vector<uint8_t> bytes(CAN_FRAME_MAX_DATA_LENGTH * 4, 0xEE);
    CanFramePayload payload(bytes);

    zassert_equal(payload.size(), CAN_FRAME_MAX_DATA_LENGTH);
    zassert_equal(payload[CAN_FRAME_MAX_DATA_LENGTH - 1], 0xEE);
}

ZTEST(can_frame_payload, test_resize_shrinks_and_clears) {
    CanFramePayload payload({ 1, 2, 3, 4 });
    payload.Resize(2);

    zassert_equal(payload.size(), 2);
    zassert_equal(payload.data()[2], 0);

    payload.Clear();
    zassert_true(payload.empty());
}

ZTEST(can_frame_payload, test_resize_is_clamped_to_capacity) {
    CanFramePayload payload;
    payload.Resize(CAN_FRAME_MAX_DATA_LENGTH * 2);

    zassert_equal(payload.size(), CAN_FRAME_MAX_DATA_LENGTH);
}

ZTEST(can_frame_payload, test_span_conversion_matches_size) {
    CanFramePayload payload({ 9, 8, 7 });
    const std::span<const uint8_t> view = payload;

    zassert_equal(view.size(), 3);
    zassert_equal(view[0], 9);
    zassert_equal(view[2], 7);
}

ZTEST(can_frame_payload, test_iteration_stops_at_size) {
    CanFramePayload payload({ 4, 4, 4 });

    size_t count = 0;
    for(const uint8_t byte : payload) {
        zassert_equal(byte, 4);
        count++;
    }

    zassert_equal(count, 3);
}

ZTEST(can_frame_payload, test_equality) {
    CanFramePayload left({ 1, 2, 3 });
    CanFramePayload right({ 1, 2, 3 });
    CanFramePayload shorter({ 1, 2 });

    zassert_true(left == right);
    zassert_false(left == shorter);
}

ZTEST(can_frame_payload, test_copy_is_independent) {
    CanFramePayload original({ 1, 2, 3 });
    CanFramePayload copy = original;

    copy[0] = 0xFF;

    zassert_equal(original[0], 1);
    zassert_equal(copy[0], 0xFF);
}
```

## src/can_id.cpp
```c
#include <cstdint>

#include <zephyr/ztest.h>

#include "subsys/canbus/can_filter.h"
#include "subsys/canbus/can_id.h"

using eerie_leap::subsys::canbus::CanFilter;
using eerie_leap::subsys::canbus::CanId;

ZTEST_SUITE(can_id, NULL, NULL, NULL, NULL, NULL);

ZTEST(can_id, test_factories_set_the_format) {
    zassert_false(CanId::Standard(0x123).is_extended);
    zassert_true(CanId::Extended(0x123).is_extended);
    zassert_equal(CanId::Extended(0x123).id, 0x123);
}

ZTEST(can_id, test_validity_follows_the_format_width) {
    zassert_true(CanId::Standard(0x7FF).IsValid());
    zassert_false(CanId::Standard(0x800).IsValid());
    zassert_true(CanId::Extended(0x1FFFFFFF).IsValid());
    zassert_false(CanId::Extended(0x20000000).IsValid());
}

ZTEST(can_id, test_key_distinguishes_formats) {
    zassert_not_equal(CanId::Standard(0x123).Key(), CanId::Extended(0x123).Key());
    zassert_equal(CanId::Extended(0x123).Key(), CanId::Extended(0x123).Key());
    zassert_not_equal(CanId::Standard(0x123), CanId::Extended(0x123));
}

ZTEST_SUITE(can_filter, NULL, NULL, NULL, NULL, NULL);

ZTEST(can_filter, test_id_converts_to_an_exact_filter) {
    const CanFilter standard = CanId::Standard(0x123);
    const CanFilter extended = CanId::Extended(0x123);

    zassert_equal(standard.id, 0x123);
    zassert_false(standard.is_extended);
    zassert_equal(standard.mask, 0x7FF);
    zassert_true(extended.is_extended);
    zassert_equal(extended.mask, 0x1FFFFFFF);
    zassert_true(standard.IsExact());
    zassert_true(extended.IsExact());
    zassert_false(CanFilter::Masked(CanId::Extended(0x123), 0x1FFFFF00).IsExact());
}

ZTEST(can_filter, test_masked_filter_matches_one_format_only) {
    const CanFilter filter = CanFilter::Masked(CanId::Extended(0x1FF00700), 0x1FFFFF00);

    zassert_true(filter.Matches(CanId::Extended(0x1FF00700)));
    zassert_true(filter.Matches(CanId::Extended(0x1FF007AB)));
    zassert_false(filter.Matches(CanId::Extended(0x1FF008AB)));
    zassert_false(filter.Matches(CanId::Standard(0x700)));
}

ZTEST(can_filter, test_validity_covers_id_and_mask) {
    zassert_true(CanFilter::Masked(CanId::Standard(0x700), 0x700).IsValid());
    zassert_false(CanFilter::Masked(CanId::Standard(0x700), 0xF00).IsValid());
    zassert_false(CanFilter::Masked(CanId::Standard(0x900), 0x700).IsValid());
}

ZTEST(can_filter, test_normalization_ignores_bits_outside_the_mask) {
    const CanFilter a = CanFilter::Masked(CanId::Extended(0x1FF007AB), 0x1FFFFF00);
    const CanFilter b = CanFilter::Masked(CanId::Extended(0x1FF00700), 0x1FFFFF00);

    zassert_not_equal(a, b);
    zassert_equal(a.Normalized(), b.Normalized());
}

ZTEST(can_filter, test_overlap_detection) {
    const CanFilter target_7 = CanFilter::Masked(CanId::Extended(0x1FF00700), 0x1FFFFF00);
    const CanFilter target_8 = CanFilter::Masked(CanId::Extended(0x1FF00800), 0x1FFFFF00);
    const CanFilter wide = CanFilter::Masked(CanId::Extended(0x1FF00000), 0x1FF00000);

    zassert_true(target_7.Overlaps(CanId::Extended(0x1FF00705)));
    zassert_false(target_7.Overlaps(CanId::Extended(0x1FF00805)));
    zassert_false(target_7.Overlaps(target_8));
    zassert_true(target_7.Overlaps(wide));
    zassert_true(wide.Overlaps(target_7), "Overlap must be symmetric");
    zassert_false(
        target_7.Overlaps(CanFilter::Masked(CanId::Standard(0x700), 0x700)),
        "Filters of different formats never overlap"
    );
    zassert_false(CanFilter(CanId::Standard(0x100)).Overlaps(CanId::Standard(0x101)));
    zassert_true(CanFilter(CanId::Standard(0x100)).Overlaps(CanId::Standard(0x100)));
}
```

## src/canbus_config.cpp
```c
#include <stdexcept>

#include <zephyr/ztest.h>

#include "subsys/canbus/canbus.h"

using eerie_leap::subsys::canbus::CAN_FRAME_MAX_DATA_LENGTH;
using eerie_leap::subsys::canbus::Canbus;
using eerie_leap::subsys::canbus::CanbusConfig;
using eerie_leap::subsys::canbus::CanbusType;

ZTEST_SUITE(canbus_config, NULL, NULL, NULL, NULL, NULL);

ZTEST(canbus_config, test_null_device_is_rejected) {
    bool threw = false;

    try {
        Canbus canbus(CanbusConfig(nullptr, CanbusType::CLASSICAL_CAN, 500000));
    } catch(const std::invalid_argument&) {
        threw = true;
    }

    zassert_true(threw, "Constructing with a null device must throw");
}

ZTEST(canbus_config, test_max_data_length_per_type) {
    zassert_equal(Canbus::GetMaxDataLength(CanbusType::CLASSICAL_CAN), 8);
    zassert_equal(Canbus::GetMaxDataLength(CanbusType::CANFD), CAN_FRAME_MAX_DATA_LENGTH);
}

ZTEST(canbus_config, test_classical_bitrates_are_supported) {
    zassert_true(Canbus::IsBitrateSupported(CanbusType::CLASSICAL_CAN, 500000));
    zassert_true(Canbus::IsBitrateSupported(CanbusType::CLASSICAL_CAN, 250000));
    zassert_true(Canbus::IsBitrateSupported(CanbusType::CLASSICAL_CAN, 10000));
}

ZTEST(canbus_config, test_arbitrary_bitrates_are_rejected) {
    zassert_false(Canbus::IsBitrateSupported(CanbusType::CLASSICAL_CAN, 123456));
    zassert_false(Canbus::IsBitrateSupported(CanbusType::CANFD, 3000000));
}

ZTEST(canbus_config, test_canfd_only_bitrates) {
    // The high data phase rates are CAN FD only.
    zassert_true(Canbus::IsBitrateSupported(CanbusType::CANFD, 8000000));
    zassert_false(Canbus::IsBitrateSupported(CanbusType::CLASSICAL_CAN, 8000000));
}

ZTEST(canbus_config, test_zero_bitrate_means_auto_detect) {
    zassert_true(Canbus::IsBitrateSupported(CanbusType::CLASSICAL_CAN, 0));
    zassert_true(Canbus::IsBitrateSupported(CanbusType::CANFD, 0));
}

ZTEST(canbus_config, test_canfd_config_defaults_data_bitrate_to_bitrate) {
    CanbusConfig config(nullptr, CanbusType::CANFD, 500000);

    zassert_equal(config.data_bitrate, 0, "The struct itself must not guess");
    zassert_equal(config.extra_modes, 0);
}
```

## src/canbus_proxy.cpp
```c
#include <memory>
#include <stdexcept>

#include <zephyr/device.h>
#include <zephyr/devicetree.h>
#include <zephyr/drivers/can.h>
#include <zephyr/ztest.h>

#include "subsys/canbus/canbus_proxy.hpp"

using eerie_leap::subsys::canbus::Canbus;
using eerie_leap::subsys::canbus::CanbusConfig;
using eerie_leap::subsys::canbus::CanbusProxy;
using eerie_leap::subsys::canbus::CanbusType;

ZTEST_SUITE(canbus_proxy, NULL, NULL, NULL, NULL, NULL);

namespace {

// The controller is never started here; Canbus only needs the device to exist.
std::unique_ptr<Canbus> MakeCanbus() {
    return std::make_unique<Canbus>(
        CanbusConfig(DEVICE_DT_GET(DT_NODELABEL(can_loopback0)), CanbusType::CLASSICAL_CAN, 500000)
    );
}

} // namespace

ZTEST(canbus_proxy, test_holds_and_exposes_instance) {
    auto canbus = MakeCanbus();
    const auto* raw = canbus.get();

    CanbusProxy proxy(std::move(canbus));

    zassert_true(proxy.IsValid());
    zassert_equal(proxy.Get(), raw);
    zassert_equal(proxy.operator->(), raw);
}

ZTEST(canbus_proxy, test_release_empties_the_proxy) {
    CanbusProxy proxy(MakeCanbus());

    const auto released = proxy.Release();

    zassert_not_null(released.get());
    zassert_false(proxy.IsValid());
    zassert_is_null(proxy.Get());
}

ZTEST(canbus_proxy, test_dereferencing_an_empty_proxy_throws) {
    CanbusProxy proxy(MakeCanbus());
    const auto released = proxy.Release();

    bool threw = false;
    try {
        (void)proxy->GetState();
    } catch(const std::runtime_error&) {
        threw = true;
    }

    zassert_true(threw, "Dereferencing an empty proxy must throw, not return null");
}

ZTEST(canbus_proxy, test_update_replaces_instance) {
    CanbusProxy proxy(MakeCanbus());

    auto replacement = MakeCanbus();
    const auto* raw = replacement.get();

    proxy.Update(std::move(replacement));

    zassert_true(proxy.IsValid());
    zassert_equal(proxy.Get(), raw);
}

ZTEST(canbus_proxy, test_updated_handlers_are_notified) {
    CanbusProxy proxy(MakeCanbus());

    int notifications = 0;
    Canbus* last = nullptr;

    const int handler_id = proxy.RegisterUpdatedHandler([&](Canbus* canbus) {
        notifications++;
        last = canbus;
    });
    zassert_true(handler_id > 0);

    auto replacement = MakeCanbus();
    const auto* raw = replacement.get();
    proxy.Update(std::move(replacement));

    zassert_equal(notifications, 1);
    zassert_equal(last, raw);

    const auto released = proxy.Release();
    zassert_equal(notifications, 2);
    zassert_is_null(last, "Release() must report that the proxy is now empty");

    zassert_true(proxy.UnregisterUpdatedHandler(handler_id));
    zassert_false(proxy.UnregisterUpdatedHandler(handler_id));
}
```

## src/canbus_rx_entry.cpp
```c
#include <cerrno>
#include <cstdint>
#include <cstring>
#include <type_traits>

#include <zephyr/drivers/can.h>
#include <zephyr/ztest.h>

#include "subsys/canbus/canbus_rx_entry.h"
#include "subsys/canbus/canbus_time.h"

using eerie_leap::subsys::canbus::CanbusRxEntry;
using eerie_leap::subsys::canbus::CanbusRxKind;
using eerie_leap::subsys::canbus::NowUs;

ZTEST_SUITE(canbus_rx_entry, NULL, NULL, NULL, NULL, NULL);

namespace {

can_frame MakeFrame() {
    can_frame frame{};
    frame.id = 0x18FF1234;
    frame.dlc = 3;
    frame.flags = CAN_FRAME_IDE | CAN_FRAME_FDF;
    frame.data[0] = 0x11;
    frame.data[1] = 0x22;
    frame.data[2] = 0x33;

    return frame;
}

} // namespace

ZTEST(canbus_rx_entry, test_entry_is_trivially_copyable) {
    // k_msgq copies the entry byte for byte.
    zassert_true(std::is_trivially_copyable_v<CanbusRxEntry>);
}

ZTEST(canbus_rx_entry, test_received_round_trips_its_fields) {
    const CanbusRxEntry entry = CanbusRxEntry::Received(MakeFrame(), 123456789012ULL);

    zassert_equal(entry.kind, CanbusRxKind::RECEIVED);
    zassert_equal(entry.time_us, 123456789012ULL);
    zassert_equal(entry.frame.id, 0x18FF1234);
    zassert_equal(entry.frame.dlc, 3);
    zassert_equal(entry.frame.flags, CAN_FRAME_IDE | CAN_FRAME_FDF);
    zassert_equal(entry.frame.data[2], 0x33);
    zassert_equal(entry.tx_error, 0);
    zassert_equal(entry.err_cnt.tx_err_cnt, 0);
    zassert_equal(entry.err_cnt.rx_err_cnt, 0);
}

ZTEST(canbus_rx_entry, test_tx_echo_round_trips_its_fields_and_error) {
    const CanbusRxEntry entry = CanbusRxEntry::TxEcho(MakeFrame(), 42, -ENETDOWN);

    zassert_equal(entry.kind, CanbusRxKind::TX_ECHO);
    zassert_equal(entry.time_us, 42);
    zassert_equal(entry.frame.id, 0x18FF1234);
    zassert_equal(entry.frame.data[0], 0x11);
    zassert_equal(entry.tx_error, -ENETDOWN);

    zassert_equal(CanbusRxEntry::TxEcho(MakeFrame(), 0, 0).tx_error, 0);
}

ZTEST(canbus_rx_entry, test_tx_error_is_clamped_to_int8) {
    zassert_equal(CanbusRxEntry::TxEcho(MakeFrame(), 0, -100000).tx_error, INT8_MIN);
    zassert_equal(CanbusRxEntry::TxEcho(MakeFrame(), 0, 100000).tx_error, INT8_MAX);
    zassert_equal(CanbusRxEntry::TxEcho(MakeFrame(), 0, -128).tx_error, -128);
    zassert_equal(CanbusRxEntry::TxEcho(MakeFrame(), 0, 127).tx_error, 127);
}

ZTEST(canbus_rx_entry, test_state_change_round_trips_its_fields) {
    const CanbusRxEntry entry = CanbusRxEntry::StateChange(
        CAN_STATE_ERROR_PASSIVE, { .tx_err_cnt = 130, .rx_err_cnt = 7 }, 99
    );

    zassert_equal(entry.kind, CanbusRxKind::STATE_CHANGE);
    zassert_equal(entry.state, CAN_STATE_ERROR_PASSIVE);
    zassert_equal(entry.err_cnt.tx_err_cnt, 130);
    zassert_equal(entry.err_cnt.rx_err_cnt, 7);
    zassert_equal(entry.time_us, 99);
    zassert_equal(entry.frame.id, 0, "A state entry carries no frame");
    zassert_equal(entry.tx_error, 0);
}

ZTEST(canbus_rx_entry, test_a_byte_copy_keeps_the_entry) {
    // What k_msgq_put() and k_msgq_get() do.
    const CanbusRxEntry original = CanbusRxEntry::TxEcho(MakeFrame(), 7, -5);
    CanbusRxEntry copy;
    std::memcpy(&copy, &original, sizeof(copy));

    zassert_equal(copy.kind, CanbusRxKind::TX_ECHO);
    zassert_equal(copy.time_us, 7);
    zassert_equal(copy.tx_error, -5);
    zassert_equal(copy.frame.id, original.frame.id);
    zassert_equal(copy.frame.data[1], 0x22);
}

ZTEST(canbus_rx_entry, test_default_entry_is_an_empty_received_frame) {
    const CanbusRxEntry entry;

    zassert_equal(entry.kind, CanbusRxKind::RECEIVED);
    zassert_equal(entry.time_us, 0);
    zassert_equal(entry.frame.id, 0);
    zassert_equal(entry.tx_error, 0);
}

ZTEST(canbus_rx_entry, test_now_us_does_not_go_back) {
    const uint64_t first = NowUs();
    k_sleep(K_MSEC(10));
    const uint64_t second = NowUs();

    zassert_true(second >= first);
    zassert_true(second - first < 10ULL * 1000 * 1000, "NowUs() must be in microseconds, not cycles");
}
```

## src/canbus_type.cpp
```c
#include <zephyr/ztest.h>

#include "subsys/canbus/canbus_type.h"

using eerie_leap::subsys::canbus::CanbusType;
using eerie_leap::subsys::canbus::IsCanbusTypeValid;

ZTEST_SUITE(canbus_type, NULL, NULL, NULL, NULL, NULL);

ZTEST(canbus_type, test_persisted_type_ids_are_unchanged) {
    zassert_equal(static_cast<uint8_t>(CanbusType::NONE), 0);
    zassert_equal(static_cast<uint8_t>(CanbusType::CLASSICAL_CAN), 1);
    zassert_equal(static_cast<uint8_t>(CanbusType::CANFD), 2);
}

ZTEST(canbus_type, test_defined_types_are_valid) {
    zassert_true(IsCanbusTypeValid(CanbusType::NONE));
    zassert_true(IsCanbusTypeValid(CanbusType::CLASSICAL_CAN));
    zassert_true(IsCanbusTypeValid(CanbusType::CANFD));
}

ZTEST(canbus_type, test_sentinel_and_unknown_types_are_invalid) {
    zassert_false(IsCanbusTypeValid(CanbusType::COUNT));
    zassert_false(IsCanbusTypeValid(static_cast<CanbusType>(200)));
    zassert_false(IsCanbusTypeValid(static_cast<CanbusType>(UINT8_MAX)));
}
```
