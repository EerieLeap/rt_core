## CMakeLists.txt
```
cmake_minimum_required(VERSION 3.20.0)

include(${CMAKE_CURRENT_SOURCE_DIR}/../../../rt_core_test.cmake)

find_package(Zephyr REQUIRED HINTS $ENV{ZEPHYR_BASE})
project(unit_subsys_time)

file(GLOB_RECURSE TEST_SOURCES src/*.c src/*.cpp)

target_sources(app PRIVATE ${TEST_SOURCES})
```

## prj.conf
```kconfig
CONFIG_ZTEST=y

# Language and Compiler
CONFIG_CPP=y
CONFIG_PICOLIBC=y
CONFIG_STD_CPP23=y
CONFIG_REQUIRES_FULL_LIBCPP=y
CONFIG_CPP_EXCEPTIONS=y
CONFIG_CPP_RTTI=y

# Logging And Debugging
CONFIG_THREAD_ANALYZER=y
CONFIG_THREAD_NAME=y
CONFIG_SYS_HEAP_RUNTIME_STATS=y
CONFIG_TIMING_FUNCTIONS=y

# Memory
CONFIG_HEAP_MEM_POOL_SIZE=100000

# C++ exception unwinding needs considerably more stack than the ztest defaults.
CONFIG_MAIN_STACK_SIZE=8192
CONFIG_ZTEST_STACK_SIZE=8192

# Elapsed time assertions rely on sub-millisecond tick resolution.
CONFIG_SYS_CLOCK_TICKS_PER_SEC=10000

CONFIG_EERIE_LEAP_RT_CORE=y
CONFIG_EERIE_LEAP_TIME=y
```

## src/time.cpp
```c
#include <chrono>
#include <memory>
#include <regex>

#include <zephyr/kernel.h>
#include <zephyr/ztest.h>

#include "subsys/time/time_helpers.hpp"
#include "subsys/time/i_time_provider.h"
#include "subsys/time/boot_elapsed_time_provider.h"

using namespace std::chrono;
using namespace eerie_leap::subsys::time;

ZTEST_SUITE(time, NULL, NULL, NULL, NULL, NULL);

ZTEST(time, test_GetFormattedString_not_empty) {
    std::shared_ptr<ITimeProvider> time_provider = std::make_shared<BootElapsedTimeProvider>();
    auto current_time = time_provider->GetTime();

    auto formatted_time = TimeHelpers::GetFormattedString(current_time);

    zassert_not_equal(formatted_time.size(), 0);
    const std::regex time_pattern(R"(\d{4}-\d{2}-\d{2} \d{2}:\d{2}:\d{2}.*)");
    zassert_true(std::regex_match(formatted_time, time_pattern));
}

ZTEST(time, test_GetCurrentTime_returns_valid_elapsed_time) {
    std::shared_ptr<ITimeProvider> time_provider = std::make_shared<BootElapsedTimeProvider>();

    auto current_time1 = time_provider->GetTime();
    k_msleep(1);
    auto current_time2 = time_provider->GetTime();

    // k_msleep only guarantees a lower bound, and QEMU targets built with
    // icount sleep let the guest clock follow the (shared) host clock while
    // idle, so the upper bound only has to catch a mis-scaled clock.
    zassert_true(current_time2 - current_time1 >= 1ms);
    zassert_true(current_time2 - current_time1 <= 100ms);
}
```

## src/time_helpers.cpp
```c
#include <chrono>
#include <cstdint>
#include <regex>
#include <string>

#include <zephyr/kernel.h>
#include <zephyr/ztest.h>

#include "subsys/time/time_helpers.hpp"

using namespace std::chrono;
using namespace eerie_leap::subsys::time;

namespace {

// NOLINTNEXTLINE(bugprone-throwing-static-initialization): test fixture built before main; a failed allocation aborts the run either way
const std::regex TIMESTAMP_PATTERN(R"(\d{4}-\d{2}-\d{2} \d{2}:\d{2}:\d{2}\.\d{1,3})");

} // namespace

ZTEST_SUITE(time_helpers, NULL, NULL, NULL, NULL, NULL);

ZTEST(time_helpers, test_GetFormattedString_matches_expected_pattern) {
    const auto formatted_time = TimeHelpers::GetFormattedString(TimeHelpers::FromMilliseconds(1761106217000ms));

    zassert_not_equal(formatted_time.size(), 0);
    zassert_true(std::regex_match(formatted_time, TIMESTAMP_PATTERN), "unexpected format: %s", formatted_time.c_str());
}

ZTEST(time_helpers, test_GetFormattedString_appends_millisecond_remainder) {
    // The date part depends on the host time zone, so only the fraction is asserted verbatim.
    zassert_true(TimeHelpers::GetFormattedString(TimeHelpers::FromMilliseconds(1761106217000ms)).ends_with(".0"));
    zassert_true(TimeHelpers::GetFormattedString(TimeHelpers::FromMilliseconds(1761106217001ms)).ends_with(".1"));
    zassert_true(TimeHelpers::GetFormattedString(TimeHelpers::FromMilliseconds(1761106217999ms)).ends_with(".999"));
}

ZTEST(time_helpers, test_GetFormattedString_ignores_sub_millisecond_precision) {
    const auto base = TimeHelpers::FromNanoseconds(1761106217123000000ns);
    const auto skewed = TimeHelpers::FromNanoseconds(1761106217123999999ns);

    zassert_true(TimeHelpers::GetFormattedString(base) == TimeHelpers::GetFormattedString(skewed));
}

ZTEST(time_helpers, test_GetFormattedString_differs_for_different_days) {
    const auto day = TimeHelpers::FromMilliseconds(1761106217000ms);
    const auto next_day = TimeHelpers::FromMilliseconds(1761106217000ms + 24h);

    zassert_true(TimeHelpers::GetFormattedString(day) != TimeHelpers::GetFormattedString(next_day));
}

ZTEST(time_helpers, test_ToMilliseconds_returns_duration_since_epoch) {
    zassert_equal(TimeHelpers::ToMilliseconds(std::chrono::system_clock::time_point()).count(), 0);
    zassert_equal(TimeHelpers::ToMilliseconds(TimeHelpers::FromMilliseconds(1761106217000ms)).count(), 1761106217000);
}

ZTEST(time_helpers, test_ToMilliseconds_truncates_towards_epoch) {
    zassert_equal(TimeHelpers::ToMilliseconds(TimeHelpers::FromNanoseconds(1999999ns)).count(), 1);
    zassert_equal(TimeHelpers::ToMilliseconds(TimeHelpers::FromNanoseconds(999999ns)).count(), 0);
}

ZTEST(time_helpers, test_FromMilliseconds_round_trips) {
    for(const auto value : { 0ms, 1ms, 999ms, 1000ms, 1761106217000ms })
        zassert_equal(TimeHelpers::ToMilliseconds(TimeHelpers::FromMilliseconds(value)).count(), value.count());
}

ZTEST(time_helpers, test_ToNanoseconds_returns_duration_since_epoch) {
    zassert_equal(TimeHelpers::ToNanoseconds(std::chrono::system_clock::time_point()).count(), 0);
    zassert_equal(TimeHelpers::ToNanoseconds(TimeHelpers::FromMilliseconds(1234ms)).count(), 1234000000);
}

ZTEST(time_helpers, test_FromNanoseconds_round_trips) {
    for(const auto value : { 0ns, 1ns, 999ns, 1000ns, 1761106217123456789ns })
        zassert_equal(TimeHelpers::ToNanoseconds(TimeHelpers::FromNanoseconds(value)).count(), value.count());
}

ZTEST(time_helpers, test_millisecond_and_nanosecond_conversions_agree) {
    const auto tp = TimeHelpers::FromMilliseconds(1761106217123ms);

    zassert_equal(TimeHelpers::ToNanoseconds(tp).count(), TimeHelpers::ToMilliseconds(tp).count() * 1000000);
}

ZTEST(time_helpers, test_ToUint32_returns_milliseconds_since_epoch) {
    zassert_equal(TimeHelpers::ToUint32(std::chrono::system_clock::time_point()), 0U);
    zassert_equal(TimeHelpers::ToUint32(TimeHelpers::FromMilliseconds(4294967295ms)), 4294967295U);
}

ZTEST(time_helpers, test_ToUint32_wraps_past_the_32_bit_range) {
    // 49.7 days worth of milliseconds is all a uint32 holds; callers get the wrapped remainder.
    zassert_equal(TimeHelpers::ToUint32(TimeHelpers::FromMilliseconds(4294967296ms)), 0U);
    zassert_equal(TimeHelpers::ToUint32(TimeHelpers::FromMilliseconds(4294967297ms)), 1U);
}

ZTEST(time_helpers, test_ToUint64_returns_nanoseconds_since_epoch) {
    zassert_equal(TimeHelpers::ToUint64(std::chrono::system_clock::time_point()), 0ULL);
    zassert_equal(TimeHelpers::ToUint64(TimeHelpers::FromMilliseconds(1761106217123ms)), 1761106217123000000ULL);
}

ZTEST(time_helpers, test_ToUint64_keeps_sub_millisecond_precision) {
    zassert_equal(TimeHelpers::ToUint64(TimeHelpers::FromNanoseconds(1761106217123456789ns)), 1761106217123456789ULL);
}

ZTEST(time_helpers, test_MeasureExecutionTimeUs_invokes_the_callable) {
    int calls = 0;

    TimeHelpers::MeasureExecutionTimeUs([&calls] {
        ++calls;
    });

    zassert_equal(calls, 1);
}

ZTEST(time_helpers, test_MeasureExecutionTimeUs_returns_non_negative_duration) {
    const auto elapsed_us = TimeHelpers::MeasureExecutionTimeUs([] {});

    zassert_true(elapsed_us >= 0.0F, "measured %f us", (double)elapsed_us);
}

ZTEST(time_helpers, test_MeasureExecutionTimeUs_measures_busy_work) {
    const auto elapsed_us = TimeHelpers::MeasureExecutionTimeUs([] {
        k_busy_wait(5000);
    });

    // Emulated targets are noisy, so only the order of magnitude is checked.
    zassert_true(elapsed_us > 0.0F, "measured %f us", (double)elapsed_us);
    zassert_true(elapsed_us < 5000000.0F, "measured %f us", (double)elapsed_us);
}

ZTEST(time_helpers, test_MeasureExecutionTimeUs_can_be_called_repeatedly) {
    for(int i = 0; i < 3; ++i) {
        int calls = 0;

        const auto elapsed_us = TimeHelpers::MeasureExecutionTimeUs([&calls] {
            ++calls;
        });

        zassert_equal(calls, 1, "iteration %d", i);
        zassert_true(elapsed_us >= 0.0F, "iteration %d measured %f us", i, (double)elapsed_us);
    }
}
```

## src/time_providers.cpp
```c
#include <chrono>
#include <memory>

#include <zephyr/kernel.h>
#include <zephyr/ztest.h>

#include "subsys/time/boot_elapsed_time_provider.h"
#include "subsys/time/i_time_provider.h"
#include "subsys/time/rtc_provider.h"
#include "subsys/time/time_helpers.hpp"

using namespace std::chrono;
using namespace eerie_leap::subsys::time;

namespace {

// The RTC is not backed by hardware yet; RtcProvider offsets uptime by this fixed epoch.
constexpr auto RTC_EPOCH = milliseconds(1761106217000);

// k_msleep only guarantees a lower bound, and QEMU targets built with icount
// sleep let the guest clock follow the (shared) host clock while idle, so the
// upper bounds below only have to catch a mis-scaled clock.
constexpr auto SLEEP_SLACK = 100ms;

// Two readings around a busy wait shorter than a millisecond: a provider truncated to whole
// milliseconds reports 0 or 1 ms, one at the kernel tick's resolution the wait itself.
template<typename TProvider>
void AssertSubMillisecondResolution() {
#if CONFIG_SYS_CLOCK_TICKS_PER_SEC >= 4000
    TProvider time_provider;

    // Start on a fresh tick so the wait spans whole ticks only. A sleep, not a spin: native_sim
    // advances its clock only when a thread sleeps or busy-waits.
    k_sleep(K_TICKS(1));

    const auto before = time_provider.GetTime();
    k_busy_wait(250);
    const auto after = time_provider.GetTime();

    const auto elapsed_us = duration_cast<microseconds>(after - before).count();
    zassert_true(
        elapsed_us >= 200 && elapsed_us < 1000,
        "a 250 us wait must read as 200..999 us, not whole milliseconds (got %lld us)",
        static_cast<long long>(elapsed_us)
    );
#else
    ztest_test_skip();
#endif
}

} // namespace

ZTEST_SUITE(boot_elapsed_time_provider, NULL, NULL, NULL, NULL, NULL);

ZTEST(boot_elapsed_time_provider, test_GetTime_returns_valid_elapsed_time) {
    const std::shared_ptr<ITimeProvider> time_provider = std::make_shared<BootElapsedTimeProvider>();

    const auto current_time1 = time_provider->GetTime();
    k_msleep(1);
    const auto current_time2 = time_provider->GetTime();

    zassert_true(current_time2 - current_time1 >= 1ms);
    zassert_true(current_time2 - current_time1 <= SLEEP_SLACK);
}

ZTEST(boot_elapsed_time_provider, test_GetTime_tracks_the_kernel_uptime) {
    BootElapsedTimeProvider time_provider;

    const auto uptime_before = k_uptime_get();
    const auto reported = TimeHelpers::ToMilliseconds(time_provider.GetTime()).count();
    const auto uptime_after = k_uptime_get();

    zassert_between_inclusive(reported, uptime_before, uptime_after);
}

ZTEST(boot_elapsed_time_provider, test_GetTime_is_monotonic) {
    BootElapsedTimeProvider time_provider;

    auto previous = time_provider.GetTime();
    for(int i = 0; i < 16; ++i) {
        const auto current = time_provider.GetTime();

        zassert_true(current >= previous, "time went backwards at iteration %d", i);

        previous = current;
    }
}

ZTEST(boot_elapsed_time_provider, test_GetTime_advances_by_the_slept_amount) {
    BootElapsedTimeProvider time_provider;

    const auto before = time_provider.GetTime();
    k_msleep(20);
    const auto after = time_provider.GetTime();

    zassert_true(after - before >= 20ms);
    zassert_true(after - before <= 20ms + SLEEP_SLACK);
}

ZTEST(boot_elapsed_time_provider, test_independent_instances_agree) {
    BootElapsedTimeProvider first;
    BootElapsedTimeProvider second;

    zassert_true(abs(second.GetTime() - first.GetTime()) <= 10ms);
}

ZTEST_SUITE(rtc_provider, NULL, NULL, NULL, NULL, NULL);

ZTEST(rtc_provider, test_GetTime_is_at_or_after_the_rtc_epoch) {
    const std::shared_ptr<ITimeProvider> time_provider = std::make_shared<RtcProvider>();

    zassert_true(TimeHelpers::ToMilliseconds(time_provider->GetTime()) >= RTC_EPOCH);
}

ZTEST(rtc_provider, test_GetTime_offsets_the_boot_elapsed_time_by_the_epoch) {
    RtcProvider rtc_provider;
    BootElapsedTimeProvider boot_provider;

    const auto offset = rtc_provider.GetTime() - boot_provider.GetTime();

    zassert_true(abs(offset - RTC_EPOCH) <= 10ms);
}

ZTEST(rtc_provider, test_GetTime_is_monotonic) {
    RtcProvider rtc_provider;

    auto previous = rtc_provider.GetTime();
    for(int i = 0; i < 16; ++i) {
        const auto current = rtc_provider.GetTime();

        zassert_true(current >= previous, "time went backwards at iteration %d", i);

        previous = current;
    }
}

ZTEST(rtc_provider, test_GetTime_advances_by_the_slept_amount) {
    RtcProvider rtc_provider;

    const auto before = rtc_provider.GetTime();
    k_msleep(20);
    const auto after = rtc_provider.GetTime();

    zassert_true(after - before >= 20ms);
    zassert_true(after - before <= 20ms + SLEEP_SLACK);
}

ZTEST(rtc_provider, test_GetTime_is_ahead_of_the_boot_elapsed_time) {
    const std::shared_ptr<ITimeProvider> rtc_provider = std::make_shared<RtcProvider>();
    const std::shared_ptr<ITimeProvider> boot_provider = std::make_shared<BootElapsedTimeProvider>();

    zassert_true(rtc_provider->GetTime() > boot_provider->GetTime());
}

ZTEST(boot_elapsed_time_provider, test_GetTime_resolves_below_a_millisecond) {
    AssertSubMillisecondResolution<BootElapsedTimeProvider>();
}

ZTEST(rtc_provider, test_GetTime_resolves_below_a_millisecond) {
    AssertSubMillisecondResolution<RtcProvider>();
}
```

## src/time_service.cpp
```c
#include <chrono>
#include <memory>

#include <zephyr/ztest.h>

#include "subsys/time/boot_elapsed_time_provider.h"
#include "subsys/time/i_time_provider.h"
#include "subsys/time/i_time_service.h"
#include "subsys/time/rtc_provider.h"
#include "subsys/time/time_helpers.hpp"
#include "subsys/time/time_service.h"

using namespace std::chrono;
using namespace eerie_leap::subsys::time;

namespace {

class StubTimeProvider : public ITimeProvider {
public:
    explicit StubTimeProvider(milliseconds value, milliseconds step = 0ms) :
        value_(value),
        step_(step) {}

    std::chrono::system_clock::time_point GetTime() override {
        const auto current = value_;
        value_ += step_;
        ++calls_;

        return TimeHelpers::FromMilliseconds(current);
    }

    int Calls() const {
        return calls_;
    }

private:
    milliseconds value_;
    milliseconds step_;
    int calls_ = 0;
};

struct Fixture {
    std::shared_ptr<StubTimeProvider> rtc_provider;
    std::shared_ptr<StubTimeProvider> boot_provider;
    std::shared_ptr<TimeService> service;
};

Fixture
MakeFixture(milliseconds rtc_value = 1761106217000ms, milliseconds boot_value = 1234ms, milliseconds step = 0ms) {
    const auto rtc_provider = std::make_shared<StubTimeProvider>(rtc_value, step);
    const auto boot_provider = std::make_shared<StubTimeProvider>(boot_value, step);

    return { rtc_provider, boot_provider, std::make_shared<TimeService>(rtc_provider, boot_provider) };
}

} // namespace

ZTEST_SUITE(time_service, NULL, NULL, NULL, NULL, NULL);

ZTEST(time_service, test_GetCurrentTime_returns_the_rtc_provider_time) {
    const auto fixture = MakeFixture();

    zassert_equal(TimeHelpers::ToMilliseconds(fixture.service->GetCurrentTime()).count(), 1761106217000);
}

ZTEST(time_service, test_GetTimeSinceBoot_returns_the_boot_provider_time) {
    const auto fixture = MakeFixture();

    zassert_equal(TimeHelpers::ToMilliseconds(fixture.service->GetTimeSinceBoot()).count(), 1234);
}

ZTEST(time_service, test_GetCurrentTime_only_queries_the_rtc_provider) {
    const auto fixture = MakeFixture();

    fixture.service->GetCurrentTime();

    zassert_equal(fixture.rtc_provider->Calls(), 1);
    zassert_equal(fixture.boot_provider->Calls(), 0);
}

ZTEST(time_service, test_GetTimeSinceBoot_only_queries_the_boot_provider) {
    const auto fixture = MakeFixture();

    fixture.service->GetTimeSinceBoot();

    zassert_equal(fixture.boot_provider->Calls(), 1);
    zassert_equal(fixture.rtc_provider->Calls(), 0);
}

ZTEST(time_service, test_Initialize_does_not_query_the_providers) {
    const auto fixture = MakeFixture();

    TimeService::Initialize();

    zassert_equal(fixture.rtc_provider->Calls(), 0);
    zassert_equal(fixture.boot_provider->Calls(), 0);
}

ZTEST(time_service, test_values_are_not_cached_between_calls) {
    const auto fixture = MakeFixture(1000ms, 10ms, 5ms);

    zassert_equal(TimeHelpers::ToMilliseconds(fixture.service->GetCurrentTime()).count(), 1000);
    zassert_equal(TimeHelpers::ToMilliseconds(fixture.service->GetCurrentTime()).count(), 1005);
    zassert_equal(TimeHelpers::ToMilliseconds(fixture.service->GetTimeSinceBoot()).count(), 10);
    zassert_equal(TimeHelpers::ToMilliseconds(fixture.service->GetTimeSinceBoot()).count(), 15);
    zassert_equal(fixture.rtc_provider->Calls(), 2);
    zassert_equal(fixture.boot_provider->Calls(), 2);
}

ZTEST(time_service, test_the_same_provider_can_back_both_clocks) {
    const auto provider = std::make_shared<StubTimeProvider>(500ms);
    const auto service = std::make_shared<TimeService>(provider, provider);

    zassert_equal(TimeHelpers::ToMilliseconds(service->GetCurrentTime()).count(), 500);
    zassert_equal(TimeHelpers::ToMilliseconds(service->GetTimeSinceBoot()).count(), 500);
    zassert_equal(provider->Calls(), 2);
}

ZTEST(time_service, test_service_keeps_the_providers_alive) {
    std::shared_ptr<ITimeService> service;

    {
        const auto provider = std::make_shared<StubTimeProvider>(777ms);
        service = std::make_shared<TimeService>(provider, provider);
    }

    zassert_equal(TimeHelpers::ToMilliseconds(service->GetCurrentTime()).count(), 777);
}

ZTEST(time_service, test_service_is_usable_through_the_interface) {
    const std::shared_ptr<ITimeService> service = std::make_shared<TimeService>(
        std::make_shared<RtcProvider>(), std::make_shared<BootElapsedTimeProvider>()
    );

    zassert_true(service->GetCurrentTime() > service->GetTimeSinceBoot());
    zassert_true(TimeHelpers::ToMilliseconds(service->GetTimeSinceBoot()) >= 0ms);
}

ZTEST(time_service, test_the_wall_clock_is_unset_until_it_is_set) {
    const auto fixture = MakeFixture();

    zassert_false(fixture.service->GetWallClockOffset().has_value());
}

ZTEST(time_service, test_SetWallClock_keeps_the_clock_and_stores_the_difference) {
    const auto fixture = MakeFixture(1000000ms);

    fixture.service->SetWallClock(TimeHelpers::FromMilliseconds(1700000000000ms));

    zassert_equal(TimeHelpers::ToMilliseconds(fixture.service->GetCurrentTime()).count(), 1000000);
    const auto offset = fixture.service->GetWallClockOffset();
    zassert_true(offset.has_value());
    zassert_equal(duration_cast<milliseconds>(*offset).count(), 1700000000000 - 1000000);
}

ZTEST(time_service, test_the_offset_is_negative_when_real_time_is_behind_the_clock) {
    const auto fixture = MakeFixture(5000ms);

    fixture.service->SetWallClock(TimeHelpers::FromMilliseconds(2000ms));

    const auto offset = fixture.service->GetWallClockOffset();
    zassert_true(offset.has_value());
    zassert_equal(duration_cast<milliseconds>(*offset).count(), -3000);
}

ZTEST(time_service, test_a_second_SetWallClock_replaces_the_first) {
    const auto fixture = MakeFixture(1000ms);

    fixture.service->SetWallClock(TimeHelpers::FromMilliseconds(4000ms));
    fixture.service->SetWallClock(TimeHelpers::FromMilliseconds(9000ms));

    const auto offset = fixture.service->GetWallClockOffset();
    zassert_true(offset.has_value());
    zassert_equal(duration_cast<milliseconds>(*offset).count(), 8000);
}

ZTEST(time_service, test_the_wall_clock_is_reachable_through_the_interface) {
    const auto provider = std::make_shared<StubTimeProvider>(100ms);
    const std::shared_ptr<ITimeService> service = std::make_shared<TimeService>(provider, provider);

    service->SetWallClock(TimeHelpers::FromMilliseconds(600ms));

    const auto offset = service->GetWallClockOffset();
    zassert_true(offset.has_value());
    zassert_equal(duration_cast<milliseconds>(*offset).count(), 500);
}
```
