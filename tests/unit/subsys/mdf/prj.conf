## CMakeLists.txt
```
cmake_minimum_required(VERSION 3.20.0)

set(RT_CORE_TEST_FLASH_DISK ON)
include(${CMAKE_CURRENT_SOURCE_DIR}/../../../rt_core_test.cmake)

find_package(Zephyr REQUIRED HINTS $ENV{ZEPHYR_BASE})
project(unit_subsys_mdf)

file(GLOB_RECURSE TEST_SOURCES src/*.c src/*.cpp)

target_sources(app PRIVATE ${TEST_SOURCES})

# MemoryStreamBuf: std::stringbuf seeks do not link on every supported platform.
target_include_directories(app PRIVATE ${CMAKE_CURRENT_SOURCE_DIR}/../../../common)
```

## Kconfig
```
menu "Zephyr"
source "Kconfig.zephyr"
endmenu

config EERIE_LEAP_FS_SD_THREAD_STACK_SIZE
	int "SD thread stack size"
	default 2048

config EERIE_LEAP_SD_CHECK_INTERVAL_MS
	int "SD check interval ms"
	default 1000

config MDF_TEST_DUMP_DIR
	string "Host directory the mdf_file suite writes a complete file into (empty: skipped)"
	default ""
	depends on ARCH_POSIX
	help
	  Only native_sim reaches the host file system: it links the host libc, so std::ofstream
	  writes there. Other platforms do not link std::ofstream at all.
```

## prj.conf
```kconfig
CONFIG_ZTEST=y

# Language and Compiler
CONFIG_CPP=y
CONFIG_PICOLIBC=y
CONFIG_STD_CPP23=y
CONFIG_REQUIRES_FULL_LIBCPP=y
CONFIG_CPP_EXCEPTIONS=y
CONFIG_CPP_RTTI=y

# Memory
CONFIG_HEAP_MEM_POOL_SIZE=100000

# C++ exception unwinding needs considerably more stack than the ztest defaults.
CONFIG_MAIN_STACK_SIZE=8192
CONFIG_ZTEST_STACK_SIZE=8192

# Logging And Debugging
CONFIG_LOG=y
CONFIG_TEST_RANDOM_GENERATOR=y
CONFIG_THREAD_ANALYZER=y
CONFIG_THREAD_ANALYZER_USE_LOG=y
CONFIG_THREAD_NAME=y
CONFIG_SYS_HEAP_RUNTIME_STATS=y
CONFIG_THREAD_ANALYZER_ISR_STACK_USAGE=n
CONFIG_TIMING_FUNCTIONS=y

# FS Config
CONFIG_DISK_DRIVERS=y
CONFIG_DISK_DRIVER_FLASH=y
CONFIG_FLASH=y
CONFIG_FLASH_MAP=y
CONFIG_FILE_SYSTEM=y
CONFIG_FILE_SYSTEM_MKFS=y
CONFIG_DISK_ACCESS=y

CONFIG_FAT_FILESYSTEM_ELM=y
CONFIG_FS_FATFS_MKFS=y
CONFIG_FS_FATFS_MOUNT_MKFS=y

CONFIG_EERIE_LEAP_RT_CORE=y
CONFIG_EERIE_LEAP_DEVICE_TREE=y
CONFIG_EERIE_LEAP_FS=y
CONFIG_EERIE_LEAP_MDF=y
CONFIG_EERIE_LEAP_RANDOM=y
CONFIG_EERIE_LEAP_TIME=y
```

## src/mdf_helpers.cpp
```c
#include <cstdint>
#include <iterator>
#include <stdexcept>

#include <zephyr/ztest.h>

#include "subsys/mdf/mdf4/channel_block.h"
#include "subsys/mdf/mdf_data_type.h"
#include "subsys/mdf/mdf_helpers.h"
#include "subsys/mdf/mdf_value.h"

using namespace eerie_leap::subsys::mdf;
using eerie_leap::subsys::mdf::mdf4::ChannelBlock;

// The mapping is constexpr, so a regression breaks the build rather than a test run.
static_assert(GetMdfDataType(MdfValue{ int32_t{} }) == MdfDataType::Int32);
static_assert(GetMdfDataType(MdfValue{ int64_t{} }) == MdfDataType::Int64);
static_assert(GetMdfDataType(MdfValue{ uint32_t{} }) == MdfDataType::Uint32);
static_assert(GetMdfDataType(MdfValue{ uint64_t{} }) == MdfDataType::Uint64);
static_assert(GetMdfDataType(MdfValue{ float{} }) == MdfDataType::Float32);
static_assert(GetMdfDataType(MdfValue{ double{} }) == MdfDataType::Float64);

ZTEST_SUITE(mdf_helpers, NULL, NULL, NULL, NULL, NULL);

ZTEST(mdf_helpers, test_ChannelDataTypeMapping) {
    const struct {
        MdfDataType data_type;
        ChannelBlock::DataType expected_type;
        uint32_t expected_bit_count;
    } cases[] = {
        { MdfDataType::Int32, ChannelBlock::DataType::SignedIntegerLe, 32 },
        { MdfDataType::Int64, ChannelBlock::DataType::SignedIntegerLe, 64 },
        { MdfDataType::Uint32, ChannelBlock::DataType::UnsignedIntegerLe, 32 },
        { MdfDataType::Uint64, ChannelBlock::DataType::UnsignedIntegerLe, 64 },
        { MdfDataType::Float32, ChannelBlock::DataType::FloatLe, 32 },
        { MdfDataType::Float64, ChannelBlock::DataType::FloatLe, 64 },
        { MdfDataType::ByteArray, ChannelBlock::DataType::ByteArray, 0 },
    };

    for(const auto& test_case : cases) {
        const auto mapped = MdfHelpers::ToMdf4ChannelDataType(test_case.data_type);

        zassert_equal(
            mapped.data_type, test_case.expected_type, "data type %u", static_cast<unsigned>(test_case.data_type)
        );
        zassert_equal(
            mapped.bit_count, test_case.expected_bit_count, "bit count for data type %u",
            static_cast<unsigned>(test_case.data_type)
        );
    }
}

ZTEST(mdf_helpers, test_ChannelDataTypeMappingRejectsUnsupportedTypes) {
    for(const auto data_type : { MdfDataType::None, static_cast<MdfDataType>(200) }) {
        bool threw = false;
        try {
            MdfHelpers::ToMdf4ChannelDataType(data_type);
        } catch(const std::runtime_error&) {
            threw = true;
        }
        zassert_true(threw, "data type %u has no channel representation", static_cast<unsigned>(data_type));
    }
}

ZTEST(mdf_helpers, test_ValueTypeMatchesTheChannelItIsWrittenTo) {
    // Every value alternative has to resolve to a channel whose width fits the value.
    const MdfValue values[] = { int32_t{ -1 }, int64_t{ -1 }, uint32_t{ 1 }, uint64_t{ 1 }, 1.0F, 1.0 };

    const size_t expected_sizes[] = { 4, 8, 4, 8, 4, 8 };

    for(size_t i = 0; i < std::size(values); i++) {
        const auto mapped = MdfHelpers::ToMdf4ChannelDataType(GetMdfDataType(values[i]));
        zassert_equal(mapped.bit_count / 8, expected_sizes[i], "value alternative %zu", i);
    }
}
```

## src/mdf_serialization.cpp
```c
#include <cstdint>
#include <ios>
#include <memory>
#include <sstream>
#include <stdexcept>
#include <string>
#include <vector>

#include <zephyr/ztest.h>

#include "subsys/mdf/mdf4/data_block.h"
#include "subsys/mdf/mdf4/text_block.h"
#include "subsys/mdf/utilities/block_links.h"
#include "subsys/mdf/utilities/block_links_empty.h"

#include "mdf_test_support.h"

using namespace eerie_leap::subsys::mdf;
using namespace eerie_leap::subsys::mdf::mdf4;
using namespace eerie_leap::subsys::mdf::utilities;
using namespace mdf_test;

namespace {

enum class TestLink : int {
    First = 0,
    Second
};

std::shared_ptr<TestBlock> MakeBlock(const std::string& id, uint64_t payload_size = 0) {
    return std::make_shared<TestBlock>(id, payload_size);
}

} // namespace

ZTEST_SUITE(mdf_serialization, NULL, NULL, NULL, NULL, NULL);

ZTEST(mdf_serialization, test_ResolveAddressLaysBlocksOutInDepthFirstOrder) {
    const auto root = MakeBlock("RT", 8);   // 32 bytes
    const auto first = MakeBlock("AA", 16); // 40 bytes
    const auto second = MakeBlock("BB", 0); // 24 bytes
    const auto nested = MakeBlock("CC", 0); // 24 bytes

    first->AddChild(nested);
    root->AddChild(first);
    root->AddChild(second);

    const auto end = root->ResolveAddress(100);

    zassert_equal(root->GetAddress(), 100);
    zassert_equal(first->GetAddress(), 132);
    zassert_equal(nested->GetAddress(), 172, "children are laid out before the next sibling");
    zassert_equal(second->GetAddress(), 196);
    zassert_equal(end, 220, "the returned address is one past the last block");
}

ZTEST(mdf_serialization, test_ResolveAddressVisitsSharedChildOnce) {
    const auto root = MakeBlock("RT");
    const auto first = MakeBlock("AA");
    const auto second = MakeBlock("BB");
    const auto shared = MakeBlock("SH");

    first->AddChild(shared);
    second->AddChild(shared);
    root->AddChild(first);
    root->AddChild(second);

    const auto end = root->ResolveAddress(64);

    zassert_equal(shared->GetAddress(), 112, "the shared block is placed under the first parent");
    zassert_equal(second->GetAddress(), 136);
    zassert_equal(end, 160, "a shared block only takes up space once");
}

// A *_next sibling comes after every child of the block before it, which is the order the
// recursive traversal produced when the next link was the last child.
ZTEST(mdf_serialization, test_NextChainIsLaidOutAfterTheChildren) {
    const auto root = MakeBlock("RT");
    const auto first = MakeBlock("AA");
    const auto first_child = MakeBlock("AC");
    const auto second = MakeBlock("BB");
    const auto second_child = MakeBlock("BC");
    const auto third = MakeBlock("CC");

    root->AddChild(first);
    first->AddChild(first_child);
    first->SetNext(second);
    second->AddChild(second_child);
    second->SetNext(third);

    const auto end = root->ResolveAddress(0);
    zassert_equal(end, 6ULL * BLOCK_HEADER_SIZE);

    const std::vector<std::shared_ptr<TestBlock>> expected_order{ root, first, first_child, second, second_child,
        third };
    for(size_t i = 0; i < expected_order.size(); i++) {
        zassert_equal(
            expected_order[i]->GetAddress(), static_cast<uint64_t>(i) * BLOCK_HEADER_SIZE,
            "block %s is not at position %zu", expected_order[i]->GetId().c_str(), i
        );
    }

    auto stream = MakeStream();
    zassert_equal(root->WriteToStream(stream), end, "every block of the chain is written once");

    const auto data = stream.Str();
    for(const auto& block : expected_order) {
        zassert_equal(
            BlockId(AsBytes(data), block->GetAddress()), "##" + block->GetId(),
            "block %s is not at its resolved address", block->GetId().c_str()
        );
    }

    root->Reset();
    for(const auto& block : expected_order) {
        zassert_equal(block->GetAddress(), 0, "block %s keeps an address after a reset", block->GetId().c_str());
        zassert_false(block->IsSerialized(), "block %s stays serialized after a reset", block->GetId().c_str());
    }
}

// The VLSD channel group a CAN channel points at is also a sibling on the channel group chain.
ZTEST(mdf_serialization, test_ChainTraversalsTerminateOnAChildThatIsAlsoASibling) {
    const auto head = MakeBlock("AA");
    const auto sibling = MakeBlock("BB");
    const auto last = MakeBlock("CC");

    head->AddChild(sibling);
    head->SetNext(sibling);
    sibling->SetNext(last);
    last->AddChild(head);

    const auto end = head->ResolveAddress(64);
    zassert_equal(end, 64 + 3 * BLOCK_HEADER_SIZE, "each block takes up space once");

    auto stream = MakeStream();
    head->WriteToStream(stream);
    zassert_equal(stream.Str().size(), 3 * BLOCK_HEADER_SIZE, "no block is written twice");

    head->Reset();
    zassert_false(last->IsSerialized(), "the reset reaches the end of the chain");

    head->ClearChildren();
    head->SetNext(nullptr);
    last->ClearChildren();
}

ZTEST(mdf_serialization, test_WriteToStreamPlacesEveryBlockAtItsResolvedAddress) {
    const auto root = MakeBlock("RT");
    const auto first = MakeBlock("AA");
    const auto second = MakeBlock("BB");
    const auto shared = MakeBlock("SH");

    first->AddChild(shared);
    second->AddChild(shared);
    root->AddChild(first);
    root->AddChild(second);

    root->ResolveAddress(0);

    auto stream = MakeStream();
    const auto bytes_written = root->WriteToStream(stream);

    const auto data = stream.Str();
    zassert_equal(bytes_written, data.size(), "the reported size must match what reached the stream");
    zassert_equal(data.size(), 4 * BLOCK_HEADER_SIZE, "the shared block is written exactly once");

    for(const auto& block : { root, first, shared, second }) {
        zassert_true(block->IsSerialized(), "block %s was not written", block->GetId().c_str());
        zassert_equal(
            BlockId(AsBytes(data), block->GetAddress()), "##" + block->GetId(),
            "block %s is not at its resolved address", block->GetId().c_str()
        );
    }
}

ZTEST(mdf_serialization, test_ResetClearsTheWholeTree) {
    const auto root = MakeBlock("RT");
    const auto child = MakeBlock("AA");
    root->AddChild(child);

    root->ResolveAddress(64);

    auto stream = MakeStream();
    root->WriteToStream(stream);

    zassert_true(root->IsSerialized());
    zassert_true(child->IsSerialized());

    root->Reset();

    zassert_equal(root->GetAddress(), 0);
    zassert_false(root->IsSerialized());
    zassert_equal(child->GetAddress(), 0);
    zassert_false(child->IsSerialized());
}

ZTEST(mdf_serialization, test_ResetTerminatesOnCircularReferences) {
    // A channel referencing a VLSD channel group that chains back to the channel forms a cycle.
    const auto first = MakeBlock("AA");
    const auto second = MakeBlock("BB");
    first->AddChild(second);
    second->AddChild(first);

    first->ResolveAddress(64);

    auto stream = MakeStream();
    first->WriteToStream(stream);

    zassert_equal(stream.Str().size(), 2 * BLOCK_HEADER_SIZE, "a cycle must not write a block twice");

    first->Reset();

    zassert_false(first->IsSerialized());
    zassert_false(second->IsSerialized());

    first->ClearChildren();
    second->ClearChildren();
}

ZTEST(mdf_serialization, test_ResolveAndWriteCanBeRepeated) {
    const auto root = MakeBlock("RT");
    const auto child = MakeBlock("AA");
    root->AddChild(child);

    auto first_stream = MakeStream();
    root->ResolveAddress(0);
    root->WriteToStream(first_stream);

    root->Reset();

    auto second_stream = MakeStream();
    root->ResolveAddress(0);
    root->WriteToStream(second_stream);

    zassert_equal(first_stream.Str(), second_stream.Str(), "rewriting the tree must be deterministic");
}

ZTEST(mdf_serialization, test_WriteToStreamThrowsOnShortWrite) {
    const auto root = MakeBlock("RT");
    root->ResolveAddress(0);

    LimitedStreamBuf stream(BLOCK_HEADER_SIZE - 1);

    bool threw = false;
    try {
        root->WriteToStream(stream);
    } catch(const std::ios_base::failure&) {
        threw = true;
    }
    zassert_true(threw, "a truncated write must not be reported as success");
}

ZTEST(mdf_serialization, test_RewriteToStreamRequiresAPreviousWrite) {
    DataBlock block;
    auto stream = MakeStream();

    bool threw = false;
    try {
        block.RewriteToStream(stream);
    } catch(const std::runtime_error&) {
        threw = true;
    }
    zassert_true(threw, "a block that was never written has no address to patch");
}

ZTEST(mdf_serialization, test_RewriteToStreamPatchesInPlace) {
    const auto root = MakeBlock("RT");
    const auto data_block = std::make_shared<DataBlock>();
    root->AddChild(data_block);

    root->ResolveAddress(0);

    auto stream = MakeStream();
    const auto bytes_written = root->WriteToStream(stream);

    // Records would be appended here before the length is known.
    const std::string records(48, '\x5A');
    stream.sputn(records.data(), static_cast<std::streamsize>(records.size()));

    data_block->SetDataSizeBytes(records.size());
    zassert_equal(data_block->RewriteToStream(stream), BLOCK_HEADER_SIZE, "only the header is rewritten");

    const auto data = stream.Str();
    zassert_equal(data.size(), bytes_written + records.size(), "patching must not grow the stream");
    zassert_equal(
        Read<uint64_t>(AsBytes(data), data_block->GetAddress() + BLOCK_LENGTH_OFFSET),
        BLOCK_HEADER_SIZE + records.size()
    );
    zassert_mem_equal(
        data.data() + data.size() - records.size(), records.data(), records.size(),
        "the appended records must stay untouched"
    );
}

ZTEST(mdf_serialization, test_RewriteToStreamThrowsWhenTheStreamCannotSeek) {
    DataBlock block;
    block.ResolveAddress(0);

    NonSeekableStreamBuf stream;
    block.WriteToStream(stream);

    bool threw = false;
    try {
        block.RewriteToStream(stream);
    } catch(const std::ios_base::failure&) {
        threw = true;
    }
    zassert_true(threw, "finalization needs a seekable stream and must say so");
}

ZTEST(mdf_serialization, test_BlockLinksTrackFixedAndExtraLinks) {
    BlockLinks<TestLink, 2> links;

    zassert_equal(links.Count(), 2);
    zassert_equal(links.GetLinksSizeBytes(), 2ULL * LINK_SIZE);
    zassert_is_null(links.GetLink(TestLink::First).get());

    const auto first = MakeBlock("AA");
    links.SetLink(TestLink::First, first);
    zassert_equal(links.GetLink(TestLink::First), std::static_pointer_cast<IBlock>(first));

    links.AddExtraLink(MakeBlock("BB"));
    zassert_equal(links.Count(), 3, "extra links are appended after the fixed ones");
    zassert_equal(links.GetLinksSizeBytes(), 3ULL * LINK_SIZE);
    zassert_equal(links.GetLinks().size(), 3);
}

ZTEST(mdf_serialization, test_BlockLinksRejectAnOutOfRangeLinkType) {
    BlockLinks<TestLink, 2> links;

    bool threw = false;
    try {
        links.SetLink(static_cast<TestLink>(2), MakeBlock("AA"));
    } catch(const std::out_of_range&) {
        threw = true;
    }
    zassert_true(threw, "writing past the fixed link area would corrupt the extra links");

    threw = false;
    try {
        (void)links.GetLink(static_cast<TestLink>(-1));
    } catch(const std::out_of_range&) {
        threw = true;
    }
    zassert_true(threw, "a negative link type must be rejected");
}

ZTEST(mdf_serialization, test_BlockLinksSerializeAddresses) {
    BlockLinks<TestLink, 2> links;

    const auto first = MakeBlock("AA");
    first->ResolveAddress(256);
    links.SetLink(TestLink::First, first);

    const auto buffer = links.Serialize();
    zassert_equal(Read<uint64_t>({ buffer.get(), static_cast<size_t>(links.GetLinksSizeBytes()) }, 0), 256);
    zassert_equal(
        Read<uint64_t>({ buffer.get(), static_cast<size_t>(links.GetLinksSizeBytes()) }, LINK_SIZE), 0,
        "unset links stay null"
    );
}

ZTEST(mdf_serialization, test_BlockLinksRejectUnresolvedAddresses) {
    BlockLinks<TestLink, 2> links;
    links.SetLink(TestLink::First, MakeBlock("AA"));

    bool threw = false;
    try {
        (void)links.Serialize();
    } catch(const std::runtime_error&) {
        threw = true;
    }
    zassert_true(threw, "serializing a link before its target has an address would produce a dangling offset");
}

ZTEST(mdf_serialization, test_EmptyBlockLinksHaveNoLinkArea) {
    const BlockLinksEmpty links;

    zassert_equal(links.Count(), 0);
    zassert_equal(links.GetLinksSizeBytes(), 0);
    zassert_equal(links.GetLinks().size(), 0);
}
```

## src/mdf_test_support.h
```c
#pragma once

#include <algorithm>
#include <cstdint>
#include <cstring>
#include <exception>
#include <memory>
#include <span>
#include <sstream>
#include <streambuf>
#include <string>
#include <vector>

#include <zephyr/ztest.h>

#include "memory_stream_buf.h"

#include "subsys/mdf/i_serializable_block.h"
#include "subsys/mdf/mdf4/block_base.h"

namespace mdf_test {

using eerie_leap::subsys::mdf::ISerializableBlock;
using eerie_leap::subsys::mdf::mdf4::BlockBase;

constexpr size_t ID_BLOCK_SIZE = 64;

// Common part of every ##XX block: id(4) + reserved(4) + length(8) + link count(8).
constexpr size_t BLOCK_HEADER_SIZE = 24;
constexpr size_t BLOCK_LENGTH_OFFSET = 8;
constexpr size_t BLOCK_LINK_COUNT_OFFSET = 16;
constexpr size_t BLOCK_LINKS_OFFSET = 24;
constexpr size_t LINK_SIZE = 8;

template<typename T>
T Read(std::span<const uint8_t> data, size_t offset) {
    T value{};
    zassert_true(offset + sizeof(T) <= data.size(), "read past the end of the buffer");
    std::memcpy(&value, data.data() + offset, sizeof(T));

    return value;
}

inline std::span<const uint8_t> AsBytes(const std::string& data) {
    // NOLINTNEXTLINE(cppcoreguidelines-pro-type-reinterpret-cast): views a byte buffer as text and a string as bytes
    return { reinterpret_cast<const uint8_t*>(data.data()), data.size() };
}

// A span into a temporary string would dangle before the first assertion runs.
std::span<const uint8_t> AsBytes(std::string&&) = delete;

inline std::string AsText(std::span<const uint8_t> data, size_t offset, size_t size) {
    zassert_true(offset + size <= data.size(), "read past the end of the buffer");
    // NOLINTNEXTLINE(cppcoreguidelines-pro-type-reinterpret-cast): views a byte buffer as text and a string as bytes
    return { reinterpret_cast<const char*>(data.data() + offset), size };
}

inline std::vector<uint8_t> Serialize(const ISerializableBlock& block) {
    const auto size = block.GetSerializedSize();
    const auto buffer = block.Serialize();

    return { buffer.get(), buffer.get() + size };
}

// Link fields hold absolute addresses, so a block that has links must be resolved before serializing.
inline std::vector<uint8_t> ResolveAndSerialize(ISerializableBlock& block, uint64_t base_address = ID_BLOCK_SIZE) {
    block.ResolveAddress(base_address);

    return Serialize(block);
}

inline std::string BlockId(std::span<const uint8_t> data, size_t offset = 0) {
    return AsText(data, offset, 4);
}

using rt_core_test::MemoryStreamBuf;

inline MemoryStreamBuf MakeStream() {
    return MemoryStreamBuf{};
}

// Any other exception type propagates so an unexpected failure is not mistaken for the expected one.
template<typename Exception = std::exception>
bool Throws(auto&& action) {
    try {
        action();
    } catch(const Exception&) {
        return true;
    }

    return false;
}

// Minimal concrete block used to exercise the shared base class behaviour.
class TestBlock : public BlockBase {
private:
    uint64_t payload_size_;
    std::shared_ptr<ISerializableBlock> next_;
    std::vector<std::shared_ptr<ISerializableBlock>> children_;

public:
    explicit TestBlock(const std::string& id, uint64_t payload_size = 0) :
        BlockBase(id),
        payload_size_(payload_size) {}

    void AddChild(std::shared_ptr<ISerializableBlock> child) {
        children_.push_back(std::move(child));
    }

    void ClearChildren() {
        children_.clear();
    }

    void SetNext(std::shared_ptr<ISerializableBlock> next) {
        next_ = std::move(next);
    }

    uint64_t GetBlockSize() const override {
        return GetBaseSize() + payload_size_;
    }

    std::unique_ptr<uint8_t[]> Serialize() const override {
        return SerializeBase();
    }

    std::shared_ptr<ISerializableBlock> GetNext() const override {
        return next_;
    }

    std::vector<std::shared_ptr<ISerializableBlock>> GetChildren() const override {
        return children_;
    }
};

// Neither helper supports seeking. The default std::streambuf seek implementations are not
// linkable on every supported platform, so they are overridden rather than inherited.
class UnseekableStreamBuf : public std::streambuf {
protected:
    pos_type seekoff(off_type, std::ios_base::seekdir, std::ios_base::openmode) override {
        return { static_cast<off_type>(-1) };
    }

    pos_type seekpos(pos_type, std::ios_base::openmode) override {
        return { static_cast<off_type>(-1) };
    }
};

// Accepts at most `limit` bytes so short writes can be exercised.
class LimitedStreamBuf : public UnseekableStreamBuf {
private:
    size_t limit_;
    std::vector<uint8_t> data_;

protected:
    std::streamsize xsputn(const char* s, std::streamsize n) override {
        const auto remaining = static_cast<std::streamsize>(limit_ - std::min(limit_, data_.size()));
        const auto accepted = std::min(n, remaining);
        data_.insert(data_.end(), s, s + accepted);

        return accepted;
    }

public:
    explicit LimitedStreamBuf(size_t limit) :
        limit_(limit) {}

    size_t Size() const {
        return data_.size();
    }
};

// cg_cycle_count follows the 6 links and cg_record_id of a ##CG block.
constexpr size_t CG_CYCLE_COUNT_OFFSET = BLOCK_LINKS_OFFSET + 6 * LINK_SIZE + 8;

// A seekable in-memory stream that records, at every sync(), what a reader would have found on
// the medium: the file identifier, the length field of the DT block and the cycle count of the CG
// block at the addresses the test sets once the header is written. Optionally refuses to sync.
class SyncProbeStreamBuf : public MemoryStreamBuf {
public:
    struct Snapshot {
        std::string identifier;
        uint64_t data_block_length;
        uint64_t cycle_count;
    };

private:
    size_t data_block_address_ = 0;
    size_t channel_group_address_ = 0;
    bool fail_sync_ = false;
    std::vector<Snapshot> snapshots_;

    static uint64_t ReadField(const std::string& content, size_t offset) {
        uint64_t value = 0;
        if(offset + sizeof(value) <= content.size())
            std::memcpy(&value, content.data() + offset, sizeof(value));

        return value;
    }

protected:
    int sync() override {
        const auto content = Str();

        snapshots_.push_back(
            Snapshot{ content.substr(0, 8), ReadField(content, data_block_address_ + BLOCK_LENGTH_OFFSET),
                ReadField(content, channel_group_address_ + CG_CYCLE_COUNT_OFFSET) }
        );

        return fail_sync_ ? -1 : 0;
    }

public:
    SyncProbeStreamBuf() = default;

    void SetDataBlockAddress(size_t address) {
        data_block_address_ = address;
    }
    void SetChannelGroupAddress(size_t address) {
        channel_group_address_ = address;
    }
    void FailSync() {
        fail_sync_ = true;
    }

    const std::vector<Snapshot>& Snapshots() const {
        return snapshots_;
    }
};

// Counts the calls that hand bytes to the stream: a record has to arrive in one sputn().
class WriteCountingStreamBuf : public MemoryStreamBuf {
private:
    size_t write_count_ = 0;

protected:
    std::streamsize xsputn(const char* s, std::streamsize n) override {
        write_count_++;
        return MemoryStreamBuf::xsputn(s, n);
    }

    int_type overflow(int_type c) override {
        write_count_++;
        return MemoryStreamBuf::overflow(c);
    }

public:
    size_t WriteCount() const {
        return write_count_;
    }
};

// Accepts every write but does not implement seeking.
class NonSeekableStreamBuf : public UnseekableStreamBuf {
private:
    size_t size_ = 0;

protected:
    std::streamsize xsputn(const char*, std::streamsize n) override {
        size_ += static_cast<size_t>(n);
        return n;
    }

public:
    size_t Size() const {
        return size_;
    }
};

} // namespace mdf_test
```
