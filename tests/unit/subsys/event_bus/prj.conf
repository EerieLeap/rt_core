## CMakeLists.txt
```
cmake_minimum_required(VERSION 3.20.0)

include(${CMAKE_CURRENT_SOURCE_DIR}/../../../rt_core_test.cmake)

find_package(Zephyr REQUIRED HINTS $ENV{ZEPHYR_BASE})
project(unit_subsys_event_bus)

file(GLOB_RECURSE TEST_SOURCES src/*.c src/*.cpp)

target_sources(app PRIVATE ${TEST_SOURCES})
```

## prj.conf
```kconfig
CONFIG_ZTEST=y

# Language and Compiler
CONFIG_CPP=y
CONFIG_PICOLIBC=y
CONFIG_STD_CPP23=y
CONFIG_REQUIRES_FULL_LIBCPP=y
CONFIG_CPP_EXCEPTIONS=y
CONFIG_CPP_RTTI=y

# Memory
CONFIG_HEAP_MEM_POOL_SIZE=100000

# C++ exception unwinding needs considerably more stack than the ztest defaults.
CONFIG_MAIN_STACK_SIZE=8192
CONFIG_ZTEST_STACK_SIZE=8192

# Logging And Debugging
CONFIG_LOG=y
CONFIG_TEST_RANDOM_GENERATOR=y
CONFIG_THREAD_NAME=y

# ThreadBase::InitializeStack() falls back to k_thread_stack_alloc().
CONFIG_THREAD_STACK_INFO=y
CONFIG_DYNAMIC_THREAD=y
CONFIG_DYNAMIC_THREAD_ALLOC=y

CONFIG_EERIE_LEAP_RT_CORE=y
CONFIG_EERIE_LEAP_EVENT_BUS=y
```

## src/acceptance_cache.cpp
```c
#include <cstdint>
#include <limits>

#include <zephyr/ztest.h>

#include "subsys/event_bus/acceptance_cache.h"

using eerie_leap::subsys::event_bus::AcceptanceCache;

ZTEST_SUITE(event_bus_acceptance_cache, NULL, NULL, NULL, NULL, NULL);

ZTEST(event_bus_acceptance_cache, test_an_empty_cache_knows_no_key) {
    const AcceptanceCache<4> cache;

    zassert_false(cache.Find(0).has_value());
    zassert_false(cache.Find(7).has_value());
    zassert_equal(cache.GetCount(), 0);
}

ZTEST(event_bus_acceptance_cache, test_a_stored_answer_is_found_until_the_generation_moves) {
    AcceptanceCache<4> cache;
    cache.Revalidate(0);

    cache.Store(10, true);
    cache.Store(20, false);

    zassert_true(cache.Find(10).value());
    zassert_false(cache.Find(20).value());
    zassert_equal(cache.GetCount(), 2);

    cache.Revalidate(1);

    zassert_false(cache.Find(10).has_value());
    zassert_false(cache.Find(20).has_value());
    zassert_equal(cache.GetCount(), 0);
}

ZTEST(event_bus_acceptance_cache, test_the_same_generation_keeps_the_answers) {
    AcceptanceCache<4> cache;
    cache.Revalidate(5);

    cache.Store(10, true);
    cache.Revalidate(5);
    cache.Revalidate(5);

    zassert_true(cache.Find(10).value());
    zassert_equal(cache.GetCount(), 1);
}

ZTEST(event_bus_acceptance_cache, test_a_full_cache_forgets_every_answer_before_storing) {
    AcceptanceCache<2> cache;

    cache.Store(1, true);
    cache.Store(2, false);
    zassert_equal(cache.GetCount(), 2);

    cache.Store(3, true);

    zassert_false(cache.Find(1).has_value());
    zassert_false(cache.Find(2).has_value());
    zassert_true(cache.Find(3).value());
    zassert_equal(cache.GetCount(), 1);
}

ZTEST(event_bus_acceptance_cache, test_storing_a_known_key_replaces_its_answer) {
    AcceptanceCache<2> cache;

    cache.Store(1, true);
    cache.Store(2, true);
    cache.Store(1, false);

    // A full cache still takes a known key without forgetting the others.
    zassert_equal(cache.GetCount(), 2);
    zassert_false(cache.Find(1).value());
    zassert_true(cache.Find(2).value());
}

ZTEST(event_bus_acceptance_cache, test_keys_are_found_whatever_order_they_are_stored_in) {
    AcceptanceCache<4> cache;
    constexpr uint32_t K_MAX = std::numeric_limits<uint32_t>::max();

    cache.Store(7, true);
    cache.Store(0, false);
    cache.Store(K_MAX, true);
    cache.Store(3, false);

    zassert_equal(cache.GetCount(), 4);
    zassert_true(cache.Find(7).value());
    zassert_false(cache.Find(0).value());
    zassert_true(cache.Find(K_MAX).value());
    zassert_false(cache.Find(3).value());
    zassert_false(cache.Find(5).has_value());
    zassert_false(cache.Find(K_MAX - 1).has_value());
}
```

## src/event.cpp
```c
#include <cstdint>
#include <string>
#include <variant>

#include <zephyr/ztest.h>

#include "subsys/event_bus/event.h"

#include "test_events.h"

using eerie_leap::subsys::event_bus::Event;
using eerie_leap::subsys::event_bus::EventHandler;
using eerie_leap::subsys::event_bus::EventPayload;

using event_bus_tests::TestEventType;
using event_bus_tests::TestPayloadType;

namespace {

using TestEvent = Event<TestEventType, TestPayloadType>;

constexpr uint32_t SOURCE_ONE = 0xA001;
constexpr uint32_t SOURCE_TWO = 0xA002;

} // namespace

ZTEST_SUITE(event_bus_event, NULL, NULL, NULL, NULL, NULL);

ZTEST(event_bus_event, test_an_event_keeps_its_type_and_source) {
    const TestEvent event{ .source_id = SOURCE_ONE, .type = TestEventType::Beta, .payload = {} };

    zassert_equal(event.type, TestEventType::Beta);
    zassert_true(event.payload.empty());
    zassert_equal(event.source_id, SOURCE_ONE);
}

ZTEST(event_bus_event, test_a_payload_holds_one_entry_per_payload_type) {
    TestEvent event{ .source_id = SOURCE_ONE, .type = TestEventType::Alpha, .payload = {} };

    event.payload[TestPayloadType::Value] = 42;
    event.payload[TestPayloadType::Label] = std::string("degrees");
    event.payload[TestPayloadType::Flag] = true;

    zassert_equal(event.payload.size(), 3U);
    zassert_equal(std::get<int>(event.payload.at(TestPayloadType::Value)), 42);
    zassert_equal(std::get<std::string>(event.payload.at(TestPayloadType::Label)), std::string("degrees"));
    zassert_true(std::get<bool>(event.payload.at(TestPayloadType::Flag)));
}

ZTEST(event_bus_event, test_reassigning_a_payload_entry_replaces_the_stored_alternative) {
    EventPayload<TestPayloadType> payload;

    payload[TestPayloadType::Value] = 42;
    payload[TestPayloadType::Value] = 1.5F;

    zassert_equal(payload.size(), 1U);
    zassert_true(std::holds_alternative<float>(payload.at(TestPayloadType::Value)));
    zassert_equal(std::get<float>(payload.at(TestPayloadType::Value)), 1.5F);
}

ZTEST(event_bus_event, test_the_payload_variant_keeps_int_and_uint32_apart) {
    EventPayload<TestPayloadType> payload;

    payload[TestPayloadType::Value] = static_cast<uint32_t>(7);

    zassert_true(std::holds_alternative<uint32_t>(payload.at(TestPayloadType::Value)));
    zassert_false(std::holds_alternative<int>(payload.at(TestPayloadType::Value)));
    zassert_equal(std::get<uint32_t>(payload.at(TestPayloadType::Value)), 7U);
}

ZTEST(event_bus_event, test_an_event_handler_receives_the_event_by_reference) {
    const TestEvent* observed = nullptr;

    const EventHandler<TestEventType, TestPayloadType> handler = [&observed](const TestEvent& event) {
        observed = &event;
    };

    TestEvent event{
        .source_id = SOURCE_TWO, .type = TestEventType::Gamma, .payload = { { TestPayloadType::Value, 11 } }
    };

    handler(event);

    zassert_equal(observed, &event);
    zassert_equal(std::get<int>(observed->payload.at(TestPayloadType::Value)), 11);
}
```

## src/event_binding.cpp
```c
#include <cstdint>
#include <memory_resource>
#include <string>
#include <utility>
#include <variant>

#include <zephyr/ztest.h>

#include "utilities/string/string_helpers.h"
#include "utilities/type/config_value.h"

#include "subsys/event_bus/event.h"
#include "subsys/event_bus/event_binding.h"
#include "subsys/event_bus/event_binding_subscription.h"
#include "subsys/event_bus/event_channel_id.h"

using eerie_leap::subsys::event_bus::EventBinding;
using eerie_leap::subsys::event_bus::EventChannelId;
using eerie_leap::subsys::event_bus::EventData;
using eerie_leap::subsys::event_bus::IsSelectorValue;
using eerie_leap::subsys::event_bus::IsValidEventChannelId;
using eerie_leap::subsys::event_bus::LAST_EVENT_CHANNEL_ID;
using eerie_leap::subsys::event_bus::SelectorMatches;
using eerie_leap::subsys::event_bus::ToSelectorValue;
using eerie_leap::utilities::string::StringHelpers;
using eerie_leap::utilities::type::ConfigValue;

namespace {

// Every alternative a selector must not take.
ConfigValue NonSelectors(size_t index) {
    switch(index) {
        case 0:
            return ConfigValue{};
        case 1:
            return ConfigValue{ 1.5 };
        case 2:
            return ConfigValue{ std::pmr::vector<int>{ 1, 2 } };
        case 3:
            return ConfigValue{ std::pmr::vector<std::pmr::string>{ "a" } };
        default:
            return ConfigValue{ std::pmr::unordered_map<std::pmr::string, std::pmr::string>{ { "a", "b" } } };
    }
}

constexpr size_t NON_SELECTOR_COUNT = 5;

} // namespace

ZTEST_SUITE(event_bus_event_binding, NULL, NULL, NULL, NULL, NULL);

// Stored configurations carry these numbers; renumbering would rebind every stored binding.
ZTEST(event_bus_event_binding, test_EventChannelId_keeps_its_persisted_values) {
    zassert_equal(std::to_underlying(EventChannelId::None), 0U);
    zassert_equal(std::to_underlying(EventChannelId::Sensors), 1U);
    zassert_equal(std::to_underlying(EventChannelId::Logging), 2U);
    zassert_equal(std::to_underlying(EventChannelId::Navigation), 3U);
    zassert_equal(std::to_underlying(EventChannelId::Settings), 4U);
}

ZTEST(event_bus_event_binding, test_IsValidEventChannelId_accepts_only_named_channels) {
    zassert_false(IsValidEventChannelId(EventChannelId::None));
    zassert_false(IsValidEventChannelId(static_cast<EventChannelId>(5)));
    zassert_false(IsValidEventChannelId(static_cast<EventChannelId>(99)));

    zassert_true(IsValidEventChannelId(EventChannelId::Sensors));
    zassert_true(IsValidEventChannelId(EventChannelId::Logging));
    zassert_true(IsValidEventChannelId(EventChannelId::Navigation));
    zassert_true(IsValidEventChannelId(EventChannelId::Settings));
}

// The registry sizes its table from the last id, so the bound must stop exactly there.
ZTEST(event_bus_event_binding, test_IsValidEventChannelId_stops_at_the_last_id) {
    const auto last = std::to_underlying(LAST_EVENT_CHANNEL_ID);

    zassert_true(IsValidEventChannelId(LAST_EVENT_CHANNEL_ID));
    zassert_false(IsValidEventChannelId(static_cast<EventChannelId>(last + 1)));
}

ZTEST(event_bus_event_binding, test_a_binding_has_a_selector_only_with_a_value) {
    EventBinding binding;
    zassert_false(binding.HasSelector());

    // 0 is a live payload key, so the key alone cannot mean "selected".
    binding.selector_key = 3;
    zassert_false(binding.HasSelector());

    binding.selector_value = 0;
    zassert_true(binding.HasSelector());
}

ZTEST(event_bus_event_binding, test_IsSelectorValue_accepts_text_integers_and_bools) {
    zassert_true(IsSelectorValue(ConfigValue{ std::pmr::string("sensor_1") }));
    zassert_true(IsSelectorValue(ConfigValue{ 7 }));
    zassert_true(IsSelectorValue(ConfigValue{ true }));

    for(size_t i = 0; i < NON_SELECTOR_COUNT; ++i)
        zassert_false(IsSelectorValue(NonSelectors(i)), "Alternative %u accepted.", static_cast<unsigned>(i));
}

ZTEST(event_bus_event_binding, test_ToSelectorValue_hashes_text_as_payloads_carry_ids) {
    auto selector = ToSelectorValue(ConfigValue{ std::pmr::string("sensor_1") });

    zassert_true(selector.has_value());
    zassert_true(std::holds_alternative<uint32_t>(*selector));
    zassert_equal(std::get<uint32_t>(*selector), StringHelpers::GetHash("sensor_1"));
}

ZTEST(event_bus_event_binding, test_ToSelectorValue_keeps_integers_and_bools) {
    auto number = ToSelectorValue(ConfigValue{ 7 });
    zassert_true(number.has_value());
    zassert_true(std::holds_alternative<int>(*number));
    zassert_equal(std::get<int>(*number), 7);

    auto flag = ToSelectorValue(ConfigValue{ true });
    zassert_true(flag.has_value());
    zassert_true(std::holds_alternative<bool>(*flag));
    zassert_true(std::get<bool>(*flag));
}

ZTEST(event_bus_event_binding, test_ToSelectorValue_rejects_what_cannot_select) {
    for(size_t i = 0; i < NON_SELECTOR_COUNT; ++i)
        zassert_false(
            ToSelectorValue(NonSelectors(i)).has_value(), "Alternative %u resolved.", static_cast<unsigned>(i)
        );
}

ZTEST(event_bus_event_binding, test_a_hash_selector_matches_only_the_same_uint32) {
    const uint32_t hash = StringHelpers::GetHash("sensor_1");
    const EventData selector{ hash };

    zassert_true(SelectorMatches(selector, EventData{ hash }));
    zassert_false(SelectorMatches(selector, EventData{ hash + 1 }));
    zassert_false(SelectorMatches(selector, EventData{ static_cast<int>(hash) }));
    zassert_false(SelectorMatches(selector, EventData{ std::string("sensor_1") }));
}

ZTEST(event_bus_event_binding, test_an_integer_selector_matches_the_same_int_or_uint32) {
    const EventData selector{ 7 };

    zassert_true(SelectorMatches(selector, EventData{ 7 }));
    zassert_true(SelectorMatches(selector, EventData{ uint32_t{ 7 } }));

    zassert_false(SelectorMatches(selector, EventData{ 8 }));
    zassert_false(SelectorMatches(selector, EventData{ uint32_t{ 8 } }));
    zassert_false(SelectorMatches(selector, EventData{ 7.0F }));
    zassert_false(SelectorMatches(selector, EventData{ true }));
}

ZTEST(event_bus_event_binding, test_a_bool_selector_matches_only_the_same_bool) {
    const EventData selector{ true };

    zassert_true(SelectorMatches(selector, EventData{ true }));

    zassert_false(SelectorMatches(selector, EventData{ false }));
    zassert_false(SelectorMatches(selector, EventData{ 1 }));
    zassert_false(SelectorMatches(selector, EventData{ uint32_t{ 1 } }));
}
```

## src/event_channel_accepts.cpp
```c
#include <array>
#include <cstddef>
#include <cstdint>
#include <string>
#include <utility>
#include <variant>

#include <zephyr/ztest.h>

#include "subsys/event_bus/erased_payload_view.h"
#include "subsys/event_bus/event.h"
#include "subsys/event_bus/event_channel.h"
#include "subsys/event_bus/i_event_bus.h"
#include "subsys/event_bus/subscription_handle.h"

#include "test_events.h"

using eerie_leap::subsys::event_bus::AnySubscription;
using eerie_leap::subsys::event_bus::CreateScopedSubscription;
using eerie_leap::subsys::event_bus::ErasedPayloadView;
using eerie_leap::subsys::event_bus::EventChannel;
using eerie_leap::subsys::event_bus::EventData;
using eerie_leap::subsys::event_bus::IEventBus;
using eerie_leap::subsys::event_bus::SubscriptionHandle;

using event_bus_tests::TestEventType;
using event_bus_tests::TestPayloadType;

namespace {

// No bus thread runs here: nothing is registered except through OnRegistered(), and DrainOne()
// runs on the test thread. A short ring keeps the 64-bit targets' heap use small.
class TestChannel : public EventChannel<TestEventType, TestPayloadType> {
public:
    explicit TestChannel(std::string name) :
        EventChannel(std::move(name), TestEventType::Gamma, TestPayloadType::Flag, 4) {}
};

class CountingBus : public IEventBus {
public:
    int wakes = 0;

    void Wake() override {
        ++wakes;
    }
};

using TestEvent = TestChannel::EventMessage;

constexpr uint32_t K_SOURCE = 0xACCE;
constexpr uint32_t OTHER_SOURCE = 0xBEEF;

TestEvent MakeEvent(TestEventType type, uint32_t value, uint32_t source_id = K_SOURCE) {
    return TestEvent{ .source_id = source_id, .type = type, .payload = { { TestPayloadType::Value, value } } };
}

bool ValueIs(const TestEvent& event, uint32_t expected) {
    const auto* it = event.payload.find(TestPayloadType::Value);

    return it != event.payload.end()
        && std::holds_alternative<uint32_t>(it->second)
        && std::get<uint32_t>(it->second) == expected;
}

} // namespace

ZTEST_SUITE(event_bus_event_channel_accepts, NULL, NULL, NULL, NULL, NULL);

ZTEST(event_bus_event_channel_accepts, test_Accepts_is_false_without_a_subscriber_of_the_event_type) {
    TestChannel channel("accepts_none");

    zassert_false(channel.Accepts(MakeEvent(TestEventType::Alpha, 1)));

    AnySubscription subscription = CreateScopedSubscription(channel, TestEventType::Beta, [](const TestEvent&) {});
    zassert_not_null(subscription.get());

    // Another type's subscriber says nothing about this one.
    zassert_false(channel.Accepts(MakeEvent(TestEventType::Alpha, 1)));
    zassert_true(channel.Accepts(MakeEvent(TestEventType::Beta, 1)));
}

ZTEST(event_bus_event_channel_accepts, test_Accepts_runs_the_filters_of_the_event_type) {
    TestChannel channel("accepts_filter");

    AnySubscription subscription = CreateScopedSubscription(
        channel, TestEventType::Alpha,
        [](const TestEvent& event) {
            return ValueIs(event, 1);
        },
        [](const TestEvent&) {}
    );

    zassert_true(channel.Accepts(MakeEvent(TestEventType::Alpha, 1)));
    zassert_false(channel.Accepts(MakeEvent(TestEventType::Alpha, 2)));
}

ZTEST(event_bus_event_channel_accepts, test_a_subscriber_without_a_filter_accepts_every_event) {
    TestChannel channel("accepts_unfiltered");

    auto typed = channel.Subscribe(TestEventType::Alpha, [](const TestEvent&) {});
    zassert_true(typed.has_value());
    zassert_true(channel.Accepts(MakeEvent(TestEventType::Alpha, 7)));
    zassert_true(channel.Unsubscribe(*typed));

    zassert_false(channel.Accepts(MakeEvent(TestEventType::Alpha, 7)));

    AnySubscription erased = channel.SubscribeErased(
        std::to_underlying(TestEventType::Alpha), {}, [](const ErasedPayloadView&) {}
    );
    zassert_not_null(erased.get());
    zassert_true(channel.Accepts(MakeEvent(TestEventType::Alpha, 7)));
    zassert_true(channel.Accepts(TestEvent{ .source_id = K_SOURCE, .type = TestEventType::Alpha, .payload = {} }));
}

ZTEST(event_bus_event_channel_accepts, test_Accepts_is_true_when_any_subscriber_accepts) {
    TestChannel channel("accepts_any");

    AnySubscription first = CreateScopedSubscription(
        channel, TestEventType::Alpha,
        [](const TestEvent& event) {
            return ValueIs(event, 1);
        },
        [](const TestEvent&) {}
    );
    AnySubscription second = CreateScopedSubscription(
        channel, TestEventType::Alpha,
        [](const TestEvent& event) {
            return ValueIs(event, 2);
        },
        [](const TestEvent&) {}
    );

    zassert_true(channel.Accepts(MakeEvent(TestEventType::Alpha, 1)));
    zassert_true(channel.Accepts(MakeEvent(TestEventType::Alpha, 2)));
    zassert_false(channel.Accepts(MakeEvent(TestEventType::Alpha, 3)));
}

ZTEST(event_bus_event_channel_accepts, test_Accepts_queues_nothing_and_calls_no_handler) {
    TestChannel channel("accepts_quiet");
    CountingBus bus;
    int handled = 0;

    channel.OnRegistered(&bus);

    {
        AnySubscription subscription = CreateScopedSubscription(
            channel, TestEventType::Alpha, [&handled](const TestEvent&) {
                ++handled;
            }
        );

        zassert_true(channel.Accepts(MakeEvent(TestEventType::Alpha, 1)));
        zassert_equal(handled, 0);
        zassert_equal(bus.wakes, 0);
        zassert_false(channel.DrainOne(), "Accepts() must not queue the event");

        // The control: a publish does queue, wake and deliver.
        channel.PublishAsync(MakeEvent(TestEventType::Alpha, 1));
        zassert_equal(bus.wakes, 1);
        zassert_true(channel.DrainOne());
        zassert_equal(handled, 1);
    }

    channel.OnRegistered(nullptr);
}

ZTEST(event_bus_event_channel_accepts, test_Accepts_is_false_again_once_the_last_subscriber_leaves) {
    TestChannel channel("accepts_leave");

    AnySubscription subscription = CreateScopedSubscription(channel, TestEventType::Alpha, [](const TestEvent&) {});
    zassert_true(channel.Accepts(MakeEvent(TestEventType::Alpha, 1)));

    subscription.reset();

    zassert_false(channel.Accepts(MakeEvent(TestEventType::Alpha, 1)));
}

ZTEST(event_bus_event_channel_accepts, test_the_erased_Accepts_builds_the_event_it_would_publish) {
    TestChannel channel("accepts_erased");

    // Like a binding selector: the erased filter looks up one payload key.
    AnySubscription selector = channel.SubscribeErased(
        std::to_underlying(TestEventType::Alpha),
        [](const ErasedPayloadView& view) {
            const auto* label = view.Find(std::to_underlying(TestPayloadType::Label));

            return label != nullptr && std::holds_alternative<uint32_t>(*label) && std::get<uint32_t>(*label) == 42U;
        },
        [](const ErasedPayloadView&) {}
    );
    zassert_not_null(selector.get());

    const std::array<std::pair<uint32_t, EventData>, 2> matching = {
        { { std::to_underlying(TestPayloadType::Label), EventData{ 42U } },
            { std::to_underlying(TestPayloadType::Value), EventData{ 1.5F } } }
    };
    const std::array<std::pair<uint32_t, EventData>, 1> other = {
        { { std::to_underlying(TestPayloadType::Label), EventData{ 43U } } }
    };

    zassert_true(channel.Accepts(std::to_underlying(TestEventType::Alpha), K_SOURCE, matching));
    zassert_false(channel.Accepts(std::to_underlying(TestEventType::Alpha), K_SOURCE, other));
    zassert_false(channel.Accepts(std::to_underlying(TestEventType::Beta), K_SOURCE, matching));

    // A typed filter may select on the publisher, so the erased form carries the source too.
    AnySubscription by_source = CreateScopedSubscription(
        channel, TestEventType::Beta,
        [](const TestEvent& event) {
            return event.source_id == K_SOURCE;
        },
        [](const TestEvent&) {}
    );

    zassert_true(channel.Accepts(std::to_underlying(TestEventType::Beta), K_SOURCE, other));
    zassert_false(channel.Accepts(std::to_underlying(TestEventType::Beta), OTHER_SOURCE, other));
}

ZTEST(event_bus_event_channel_accepts, test_the_generation_moves_on_every_subscribe_and_unsubscribe) {
    TestChannel channel("generation_moves");

    uint32_t generation = channel.GetSubscriptionGeneration();

    auto typed = channel.Subscribe(TestEventType::Alpha, [](const TestEvent&) {});
    zassert_true(typed.has_value());
    zassert_not_equal(channel.GetSubscriptionGeneration(), generation, "a typed subscribe must move it");
    generation = channel.GetSubscriptionGeneration();

    AnySubscription erased = channel.SubscribeErased(
        std::to_underlying(TestEventType::Beta), {}, [](const ErasedPayloadView&) {}
    );
    zassert_not_null(erased.get());
    zassert_not_equal(channel.GetSubscriptionGeneration(), generation, "an erased subscribe must move it");
    generation = channel.GetSubscriptionGeneration();

    zassert_true(channel.Unsubscribe(*typed));
    zassert_not_equal(channel.GetSubscriptionGeneration(), generation, "an unsubscribe must move it");
    generation = channel.GetSubscriptionGeneration();

    erased.reset();
    zassert_not_equal(channel.GetSubscriptionGeneration(), generation, "destroying a scoped subscription must move it");
}

ZTEST(event_bus_event_channel_accepts, test_the_generation_stays_on_publish_accepts_and_a_failed_unsubscribe) {
    TestChannel channel("generation_stays");

    // Stays, so a stale Alpha handle is looked for in a list that is not empty.
    AnySubscription staying = CreateScopedSubscription(channel, TestEventType::Alpha, [](const TestEvent&) {});
    zassert_not_null(staying.get());

    auto typed = channel.Subscribe(TestEventType::Alpha, [](const TestEvent&) {});
    zassert_true(typed.has_value());
    const size_t id = typed->GetId();
    zassert_true(channel.Unsubscribe(*typed));

    const uint32_t generation = channel.GetSubscriptionGeneration();

    (void)channel.Accepts(MakeEvent(TestEventType::Alpha, 1));
    channel.PublishAsync(MakeEvent(TestEventType::Alpha, 1));

    // Returns before the lock.
    zassert_false(channel.Unsubscribe(*typed), "the handle is already invalidated");

    // Valid handles that find nothing under the lock.
    SubscriptionHandle<TestEventType> stale{ id, TestEventType::Alpha };
    zassert_false(channel.Unsubscribe(stale), "its subscription is already gone");
    SubscriptionHandle<TestEventType> unsubscribed_type{ id, TestEventType::Gamma };
    zassert_false(channel.Unsubscribe(unsubscribed_type), "nobody subscribes to Gamma");

    zassert_equal(channel.GetSubscriptionGeneration(), generation);
}
```

## src/event_filter.cpp
```c
#include <string>

#include <zephyr/ztest.h>

#include "subsys/event_bus/event.h"
#include "subsys/event_bus/event_filter.h"

#include "test_events.h"

using eerie_leap::subsys::event_bus::AcceptAllFilter;
using eerie_leap::subsys::event_bus::Event;
using eerie_leap::subsys::event_bus::EventFilter;

using event_bus_tests::TestEventType;
using event_bus_tests::TestPayloadType;

namespace {

using TestEvent = Event<TestEventType, TestPayloadType>;

constexpr uint32_t SOURCE_ONE = 0xA001;
constexpr uint32_t SOURCE_TWO = 0xA002;

struct SourceFilter {
    uint32_t source_id;

    bool operator()(const TestEvent& event) const {
        return event.source_id == source_id;
    }
};

struct MissingCallOperator {};

struct NonBooleanFilter {
    std::string_view operator()(const TestEvent&) const {
        return "no";
    }
};

static_assert(EventFilter<AcceptAllFilter<TestEventType, TestPayloadType>, TestEventType, TestPayloadType>);
static_assert(EventFilter<SourceFilter, TestEventType, TestPayloadType>);
static_assert(!EventFilter<MissingCallOperator, TestEventType, TestPayloadType>);
static_assert(!EventFilter<NonBooleanFilter, TestEventType, TestPayloadType>);

TestEvent MakeEvent(TestEventType type, uint32_t source_id) {
    return TestEvent{ .source_id = source_id, .type = type, .payload = {} };
}

} // namespace

ZTEST_SUITE(event_bus_event_filter, NULL, NULL, NULL, NULL, NULL);

ZTEST(event_bus_event_filter, test_AcceptAllFilter_accepts_every_event) {
    const AcceptAllFilter<TestEventType, TestPayloadType> filter;

    zassert_true(filter(MakeEvent(TestEventType::Alpha, SOURCE_ONE)));
    zassert_true(filter(MakeEvent(TestEventType::Beta, SOURCE_TWO)));
    zassert_true(filter(MakeEvent(TestEventType::Gamma, 0)));
}

ZTEST(event_bus_event_filter, test_a_custom_filter_selects_events_by_source) {
    const SourceFilter filter{ SOURCE_ONE };

    zassert_true(filter(MakeEvent(TestEventType::Alpha, SOURCE_ONE)));
    zassert_false(filter(MakeEvent(TestEventType::Alpha, SOURCE_TWO)));
}
```

## src/subscription.cpp
```c
#include <cstddef>
#include <string>

#include <zephyr/ztest.h>

#include "subsys/event_bus/event.h"
#include "subsys/event_bus/event_filter.h"
#include "subsys/event_bus/subscription.h"

#include "test_events.h"

using eerie_leap::subsys::event_bus::AcceptAllFilter;
using eerie_leap::subsys::event_bus::Event;
using eerie_leap::subsys::event_bus::Subscription;

using event_bus_tests::TestEventType;
using event_bus_tests::TestPayloadType;

namespace {

using TestEvent = Event<TestEventType, TestPayloadType>;
using TestSubscription = Subscription<TestEventType, TestPayloadType>;

constexpr uint32_t SOURCE_ONE = 0xA001;
constexpr uint32_t SOURCE_TWO = 0xA002;
constexpr uint32_t SOURCE_THREE = 0xA003;

struct SourceFilter {
    uint32_t source_id;

    bool operator()(const TestEvent& event) const {
        return event.source_id == source_id;
    }
};

TestEvent MakeEvent(TestEventType type, uint32_t source_id) {
    return TestEvent{ .source_id = source_id, .type = type, .payload = {} };
}

} // namespace

ZTEST_SUITE(event_bus_subscription, NULL, NULL, NULL, NULL, NULL);

ZTEST(event_bus_subscription, test_a_subscription_keeps_its_id_and_event_type) {
    const TestSubscription subscription(
        7, TestEventType::Beta, AcceptAllFilter<TestEventType, TestPayloadType>{}, [](const TestEvent&) {}
    );

    zassert_equal(subscription.id, static_cast<size_t>(7));
    zassert_equal(subscription.event_type, TestEventType::Beta);
}

ZTEST(event_bus_subscription, test_a_subscription_erases_the_filter_type_but_keeps_its_behaviour) {
    const TestSubscription subscription(1, TestEventType::Alpha, SourceFilter{ SOURCE_ONE }, [](const TestEvent&) {});

    zassert_true(subscription.filter(MakeEvent(TestEventType::Alpha, SOURCE_ONE)));
    zassert_false(subscription.filter(MakeEvent(TestEventType::Alpha, SOURCE_TWO)));
}

ZTEST(event_bus_subscription, test_a_subscription_invokes_the_handler_with_the_event) {
    int calls = 0;
    uint32_t observed_source = 0;

    const TestSubscription subscription(
        1, TestEventType::Alpha, AcceptAllFilter<TestEventType, TestPayloadType>{},
        [&calls, &observed_source](const TestEvent& event) {
            ++calls;
            observed_source = event.source_id;
        }
    );

    subscription.handler(MakeEvent(TestEventType::Alpha, SOURCE_THREE));

    zassert_equal(calls, 1);
    zassert_equal(observed_source, SOURCE_THREE);
}
```

## src/subscription_handle.cpp
```c
#include <cstddef>
#include <type_traits>
#include <utility>

#include <zephyr/ztest.h>

#include "subsys/event_bus/subscription_handle.h"

#include "test_events.h"

using eerie_leap::subsys::event_bus::SubscriptionHandle;

using event_bus_tests::TestEventType;

namespace {

using TestSubscriptionHandle = SubscriptionHandle<TestEventType>;

} // namespace

ZTEST_SUITE(event_bus_subscription_handle, NULL, NULL, NULL, NULL, NULL);

ZTEST(event_bus_subscription_handle, test_a_new_handle_is_valid_and_keeps_its_id_and_event_type) {
    const TestSubscriptionHandle handle(3, TestEventType::Beta);

    zassert_equal(handle.GetId(), static_cast<size_t>(3));
    zassert_equal(handle.GetEventType(), TestEventType::Beta);
    zassert_true(handle.IsValid());
}

ZTEST(event_bus_subscription_handle, test_Invalidate_marks_the_handle_unusable_without_losing_its_identity) {
    TestSubscriptionHandle handle(3, TestEventType::Beta);

    handle.Invalidate();

    zassert_false(handle.IsValid());
    zassert_equal(handle.GetId(), static_cast<size_t>(3));
    zassert_equal(handle.GetEventType(), TestEventType::Beta);
}

ZTEST(event_bus_subscription_handle, test_Invalidate_can_be_repeated) {
    TestSubscriptionHandle handle(3, TestEventType::Beta);

    handle.Invalidate();
    handle.Invalidate();

    zassert_false(handle.IsValid());
}

ZTEST(event_bus_subscription_handle, test_moving_a_handle_transfers_the_validity_to_the_destination) {
    TestSubscriptionHandle source(5, TestEventType::Gamma);
    const TestSubscriptionHandle moved(std::move(source));

    zassert_true(moved.IsValid());
    zassert_equal(moved.GetId(), static_cast<size_t>(5));
    zassert_equal(moved.GetEventType(), TestEventType::Gamma);
    // NOLINTNEXTLINE(bugprone-use-after-move, clang-analyzer-cplusplus.Move): the moved-from handle must be released
    zassert_false(source.IsValid());
}

ZTEST(event_bus_subscription_handle, test_moving_an_invalidated_handle_keeps_the_destination_invalid) {
    TestSubscriptionHandle source(5, TestEventType::Gamma);
    source.Invalidate();

    const TestSubscriptionHandle moved(std::move(source));

    zassert_false(moved.IsValid());
    zassert_equal(moved.GetId(), static_cast<size_t>(5));
}

static_assert(!std::is_copy_constructible_v<TestSubscriptionHandle>);
static_assert(!std::is_copy_assignable_v<TestSubscriptionHandle>);
static_assert(std::is_move_constructible_v<TestSubscriptionHandle>);
```

## src/test_events.h
```c
#pragma once

#include <cstdint>

namespace event_bus_tests {

enum class TestEventType : uint32_t {
    Alpha = 0,
    Beta = 1,
    Gamma = 2
};

enum class TestPayloadType : uint32_t {
    Value = 0,
    Label = 1,
    Flag = 2
};

} // namespace event_bus_tests
```
